## subsys/usb/host/class/Kconfig
```kconfig
# Copyright (c) 2025 Nordic Semiconductor ASA
#
# SPDX-License-Identifier: Apache-2.0

rsource "Kconfig.uvc"
rsource "Kconfig.cdc_ecm"
```

## subsys/usb/host/class/Kconfig.cdc_ecm
```kconfig
# Copyright 2025 NXP
# Copyright (c) 2025 Linumiz GmbH
#
# SPDX-License-Identifier: Apache-2.0

config USBH_CDC_ECM_CLASS
	bool "USB Communication Device Class - Ethernet Control Mode (CDC-ECM) implementation [EXPERIMENTAL]"
	depends on DT_HAS_ZEPHYR_CDC_ECM_HOST_ENABLED
	select EXPERIMENTAL
	select NET_L2_ETHERNET
	select NET_L2_ETHERNET_MGMT
	help
	  USB Host Communication Device Class - Ethernet Control Mode (CDC-ECM) implementation.

if USBH_CDC_ECM_CLASS

config USBH_CDC_ECM_STACK_SIZE
	int "USB CDC-ECM thread stack size"
	default 1024
	help
	  USB CDC-ECM thread stack size.

config USBH_CDC_ECM_DATA_TX_BUF_COUNT
	int "Number of tx buffers per CDC-ECM instance"
    	default 8
    	help
      	  increase if you see "buffer pool exhausted" warnings.

config USBH_CDC_ECM_DATA_RX_BUF_COUNT
	int "Number of rx buffers per CDC-ECM instance"
    	default 16
    	help
      	  increase if you see "buffer pool exhausted" warnings.

config USBH_CDC_ECM_DATA_BUF_POOL_SIZE
	int "USB CDC-ECM buffer pool size"
	default 1514
	range 60 9000
	help
	  USB CDC-ECM buffer pool size in bytes.

module = USBH_CDC_ECM
module-str = "usbh cdc_ecm"
default-count = 1
source "subsys/logging/Kconfig.template.log_config"

endif # USBH_CDC_ECM_CLASS
```

## subsys/usb/host/class/Kconfig.cdc_ecm_host
```kconfig
#
# Copyright 2025 NXP
#
# SPDX-License-Identifier: Apache-2.0
#

config USBH_CDC_ECM_CLASS
	bool "USB Host CDC ECM class driver"
	depends on DT_HAS_ZEPHYR_USBH_CDC_ECM_ENABLED
	select NET_L2_ETHERNET
	select NET_IPV4
	help
	  Enable USB Host CDC ECM (Ethernet Control Model) class driver.
	  This allows the system to use USB devices that implement CDC ECM
	  as network interfaces, such as smartphones, tablets, or USB-to-Ethernet
	  adapters.

if USBH_CDC_ECM_CLASS


module = USBH_CDC_ECM_CLASS
module-str = usbh cdc ecm
default-count = 1
source "subsys/logging/Kconfig.template.log_config"

endif # USBH_CDC_ECM_CLASS
```

## subsys/usb/host/class/Kconfig.msc_host
```kconfig
#
# Copyright 2025 NXP
#
# SPDX-License-Identifier: Apache-2.0
#

config USBH_MSC_CLASS
	bool "USB Host MSC class driver"
	depends on DT_HAS_ZEPHYR_MSC_HOST_ENABLED
	select DISK_ACCESS
	help
	  Enable USB Host Mass Storage Class driver.

if USBH_MSC_CLASS

config USBH_MSC_MAX_INTERFACE
	int "Maximum number of MSC interfaces"
	default 4
	range 1 16
	help
	  Maximum number of MSC interfaces that can be supported.
	  This defines the array size for storing interface descriptors

module = USBH_MSC_CLASS
module-str = usbh msc
default-count = 1
source "subsys/logging/Kconfig.template.log_config"

endif # USBH_MSC_CLASS
```

## subsys/usb/host/class/Kconfig.uac2
```kconfig
# Copyright 2025 Nordic Semiconductor ASA
# SPDX-License-Identifier: Apache-2.0

config USBH_UAC2_CLASS
	bool "USB host Audio Class 2.0 support [EXPERIMENTAL]"
	select EXPERIMENTAL
	help
	  USB Host Audio Class 2.0 implementation.

if USBH_UAC2_CLASS

config USBH_UAC2_INSTANCES_COUNT
	int "Number of UAC2 host instances"
	default 4
	range 1 8
	help
	  Maximum number of UAC2 devices that can be connected simultaneously.

config USBH_UAC2_STREAM_IN_CONCURRENT_TRANSFERS
	int "Number of concurrent isochronous transfers for audio stream in"
	default 4
	range 1 8
	help
	  Number of concurrent transfers for audio input (device to host).

config USBH_UAC2_STREAM_OUT_CONCURRENT_TRANSFERS
	int "Number of concurrent isochronous transfers for audio stream out"
	default 4
	range 1 8
	help
	  Number of concurrent transfers for audio output (host to device).

config USBH_UAC2_MAX_RANGE_SUBRANGES
	int "Maximum number of subranges in RANGE requests"
	default 8
	range 1 16
	help
	  Maximum number of subranges when querying control ranges.
	  Devices may report multiple discrete values as subranges.
	  Higher values increase stack usage.

module = USBH_UAC2
module-str = usbh_uac2
source "subsys/logging/Kconfig.template.log_config"

endif # USBH_UAC2_CLASS
```

## tests/bluetooth/classic/b2b/map_general_rfcomm/testcase.yaml
```yaml
tests:
  bluetooth.classic.map.general_rfcomm:
    platform_allow:
    - native_sim
    integration_platforms:
    - native_sim
    tags:
    - bluetooth
    - map
    harness: pytest
    harness_config:
      pytest_dut_scope: session
      fixture: usb_hci
    timeout: 300
  bluetooth.classic.map.general_rfcomm.no_blobs:
    platform_allow:
    - mimxrt1170_evk@B/mimxrt1176/cm7
    tags:
    - bluetooth
    - map
    extra_args:
    - CONFIG_BUILD_ONLY_NO_BLOBS=y
    timeout: 300
    build_only: true
```

## tests/bluetooth/classic/b2b/map_mse_mas_l2cap/testcase.yaml
```yaml
tests:
  bluetooth.classic.map.mse_mas_l2cap:
    platform_allow:
    - native_sim
    integration_platforms:
    - native_sim
    tags:
    - bluetooth
    - map
    harness: pytest
    harness_config:
      pytest_dut_scope: session
      fixture: usb_hci
    timeout: 1200
  bluetooth.classic.map.mse_mas_l2cap.no_blobs:
    platform_allow:
    - mimxrt1170_evk@B/mimxrt1176/cm7
    tags:
    - bluetooth
    - map
    extra_args:
    - CONFIG_BUILD_ONLY_NO_BLOBS=y
    timeout: 1200
    build_only: true
```

## tests/bluetooth/classic/gap_peripheral/testcase.yaml
```yaml
tests:
  bluetooth.classic.gap.p:
    integration_platforms:
    - native_sim
    tags:
    - bluetooth
    - gap
    harness: pytest
    harness_config:
      pytest_dut_scope: session
      fixture: usb_hci
    timeout: 600
```

## tests/bluetooth/classic/l2cap_br/testcase.yaml
```yaml
tests:
  l2cap.t:
    integration_platforms:
      - native_sim
    tags:
      - bluetooth
      - l2cap
    harness: pytest
    harness_config:
      pytest_dut_scope: session
      fixture: usb_hci
    timeout: 360
```

## tests/bluetooth/classic/l2cap_credit/testcase.yaml
```yaml
tests:
  bluetooth.classic.l2cap.credit:
    platform_allow:
      - mimxrt1170_evk@B/mimxrt1176/cm7
    integration_platforms:
      - mimxrt1170_evk@B/mimxrt1176/cm7
    tags:
      - bluetooth
      - sdp
      - b2b
    build_only: false
    harness: pytest
    harness_config:
      pytest_dut_scope: session
      fixture: usb_hci
    timeout: 180
    extra_args: CONF_FILE="prj_br.conf"
```

## tests/bluetooth/classic/l2cap_default_assemble/testcase.yaml
```yaml
tests:
  bluetooth.classic.l2cap.b2b:
    platform_allow:
      - native_sim
      - mimxrt1170_evk@B/mimxrt1176/cm7
    integration_platforms:
      - mimxrt1170_evk@B/mimxrt1176/cm7
    tags:
      - bluetooth
      - l2cap
      - b2b
    build_only: false
    harness: pytest
    harness_config:
      pytest_dut_scope: session
      fixture: usb_hci
    timeout: 900
```

## tests/drivers/clock_mgmt/clock_mgmt_api/testcase.yaml
```yaml
tests:
  drivers.clock_mgmt.api:
    tags:
      - drivers
      - clock_mgmt
    integration_platforms:
      - lpcxpresso55s69/lpc55s69/cpu0
```

## tests/drivers/disk/disk_access/boards/frdm_rw612_w25n01gv_ftl.conf
```kconfig
# Copyright 2026 NXP
# SPDX-License-Identifier: Apache-2.0

# FRDM-RW612 W25N01GV NAND + Dhara FTL disk driver configuration
# Used by: tests/drivers/disk/disk_access (drivers.disk.ftl.frdm_rw612_w25n01gv)

# FlexSPI NAND driver
CONFIG_FLASH_MCUX_FLEXSPI_NAND=y
# Must be > FLASH_INIT_PRIORITY (50) so FlexSPI controller is ready first
CONFIG_FLASH_MCUX_FLEXSPI_NAND_INIT_PRIORITY=51

# Disk / FTL stack
CONFIG_DISK_DRIVERS=y
CONFIG_DISK_DRIVER_FTL=y

# Increase main stack for disk_access test with large NAND sector size (2048 B)
CONFIG_MAIN_STACK_SIZE=4096
```

## tests/drivers/dma/loop_transfer/boards/frdm_mcxa153.conf
```kconfig
# Copyright 2026 NXP
# SPDX-License-Identifier: Apache-2.0

# Reduce transfer size to fit in limited RAM (MCXA153 has limited SRAM)
CONFIG_DMA_LOOP_TRANSFER_SIZE=1024
```

## tests/drivers/gpio/pca_series/testcase.yaml
```yaml
# Copyright 2026
# SPDX-License-Identifier: Apache-2.0

tests:
  drivers.gpio.pca_series.mini_cache:
    tags:
      - drivers
      - gpio
      - i2c
      - emul
    integration_platforms:
      - qemu_cortex_m3
    platform_allow:
      - native_sim
      - qemu_cortex_m3
  drivers.gpio.pca_series.full_cache:
    tags:
      - drivers
      - gpio
      - i2c
      - emul
    integration_platforms:
      - qemu_cortex_m3
    platform_allow:
      - native_sim
      - qemu_cortex_m3
    extra_args:
      - EXTRA_CONF_FILE=cache_all.conf
```

## tests/drivers/rtc/rtc_api/boards/frdm_mcxe31b.conf
```kconfig
CONFIG_RTC_ALARM=y
CONFIG_RTC_INIT_PRIORITY=70
CONFIG_TEST_RTC_ALARM_TIME_MASK=255
```

## tests/drivers/rtc/rtc_api/testcase.yaml
```yaml
# Copyright (c) 2022 Bjarki Arge Andreasen
# Copyright 2025 NXP
# SPDX-License-Identifier: Apache-2.0

tests:
  drivers.rtc.rtc_api:
    tags:
      - drivers
      - rtc
      - api
    filter: dt_alias_exists("rtc")
    depends_on: rtc
    timeout: 100
    platform_exclude:
      - qemu_x86_64

  drivers.rtc.rtc_api.rtc_counter:
    tags:
      - drivers
      - rtc
      - api
    filter: dt_alias_exists("rtc")
    depends_on: rtc
    timeout: 100
    platform_allow:
      - frdm_mcxw71
      - lpcxpresso55s69/lpc55s69/cpu0
      - mimxrt1010_evk
      - mimxrt1015_evk
      - mimxrt1020_evk
      - mimxrt1024_evk
      - mimxrt1040_evk
      - mimxrt1050_evk
      - mimxrt1060_evk
      - mimxrt1062_fmurt6
      - mimxrt1064_evk
    extra_configs:
      - CONFIG_RTC_ALARM=y
      - CONFIG_RTC_INIT_PRIORITY=70
      - CONFIG_TEST_RTC_ALARM_TIME_MASK=255
```

## tests/subsys/pm/device_runtime_api/dts/bindings/test-power-domain.yaml
```yaml
# Copyright (c) 2025 NXP
# SPDX-License-Identifier: Apache-2.0

include: [base.yaml, pm.yaml]

description: 
  This binding provides resource required to build and run power domain tests
  for device runtime API in Zephyr.

compatible: "test-power-domain"
```
