/*
 * Copyright 2022-2024 NXP
 *
 * SPDX-License-Identifier: Apache-2.0
 */

/dts-v1/;
#include "s32z2xxdc2_s32z270_rtu0.dtsi"

/ {
	cpus {
		/* RTU cores configured in lockstep mode */
		/delete-node/ cpu@2;
		/delete-node/ cpu@3;
	};
};
