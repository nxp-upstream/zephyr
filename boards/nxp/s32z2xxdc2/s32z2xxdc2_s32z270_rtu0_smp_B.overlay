/*
 * Copyright 2024 NXP
 *
 * SPDX-License-Identifier: Apache-2.0
 */

 / {
	chosen {
		zephyr,console = &uart0;
		zephyr,shell-uart = &uart0;
	};

	cpus {
		/* RTU cores configured in lockstep mode */
		/delete-node/ cpu@2;
		/delete-node/ cpu@3;
	};
};

&uart0 {
	pinctrl-0 = <&uart0_default>;
	pinctrl-names = "default";
	status = "okay";
};
