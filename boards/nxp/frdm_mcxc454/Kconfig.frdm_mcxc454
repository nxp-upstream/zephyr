## dts/bindings/clock-monitor/nxp,sfa.yaml
```yaml
# SPDX-FileCopyrightText: 2026 NXP
# SPDX-License-Identifier: Apache-2.0

description: |
  NXP Signal Frequency Analyser (SFA).

  Measures a clock under test (the clock_monitor target) against a reference
  clock with two 32-bit counters, driven through the MCUX SDK fsl_sfa HAL.
  Both clock_monitor modes are supported:

    - MEASURE: one frequency measurement per start(), completion IRQ.
    - WINDOW: the SFA monitor mode (CTRL[MONITOR_EN]) re-measures until the
      result leaves the low/high limits, then raises FREQ_GT_MAX or
      FREQ_LT_MIN. The driver re-arms after each event.

  The driver picks the counting method per configure(). When target-frequency
  is known and below reference-frequency it uses CTRL[MODE] = 0 (time a fixed
  number of target edges in reference ticks, good for slow clocks); otherwise
  CTRL[MODE] = 1 (count target edges during a fixed reference window).

  The reference and target inputs are fixed per instance; select another pair
  in a board overlay. clock_monitor_set_source() is not supported.

  The driver does not enable either clock. The application must have both
  running before configure()/start(); a target left off counts no edges and is
  reported as CLOCK_LOST.

  Selector values for each SoC are in
  <zephyr/dt-bindings/clock-monitor/nxp-sfa.h>.

compatible: "nxp,sfa"

include: base.yaml

properties:
  reg:
    required: true

  interrupts:
    required: true

  clocks:
    required: true
    description: |
      SFA peripheral gate clock, enabled by the driver via clock_control_on().

  reference-select:
    type: int
    required: true
    description: |
      CTRL2[REF_CLK_SEL] value of the reference clock (NXP_SFA_*_REF_*).

  reference-frequency:
    type: int
    required: true
    description: |
      Reference clock rate in Hz. The driver converts the counters to Hz with
      it, so it must match the real clock.

  target-select:
    type: int
    required: true
    description: |
      CTRL[CUT_SEL] value of the clock under test (NXP_SFA_*_CUT_*).

  target-frequency:
    type: int
    description: |
      Nominal rate of the clock under test in Hz. Picks the counting method,
      and is the WINDOW centre when expected_hz is 0. Leave it out when the
      rate is unknown; MEASURE then uses CTRL[MODE] = 1 and WINDOW needs an
      explicit expected_hz.
```

## dts/bindings/clock/nxp,sirc.yaml
```yaml
# Copyright 2026 NXP
# SPDX-License-Identifier: Apache-2.0

description: Slow internal RC oscillator

compatible: "nxp,sirc"

include: [base.yaml]

properties:
  reg:
    required: true

  standby-enable:
    type: boolean
    description: |
      Keep the SIRC running in Standby mode, by setting
      MISCELLANEOUS_IN[STANDBY_ENABLE].

      The SIRC is enabled out of reset and cannot be disabled in Run mode, so
      Standby is the only mode its state can be chosen for. Leave the property
      out to stop the SIRC on Standby entry; set it when a peripheral clocked
      from the SIRC has to keep running through Standby.
```

## dts/bindings/clock/nxp,sxosc.yaml
```yaml
# Copyright 2026 NXP
# SPDX-License-Identifier: Apache-2.0

description: Slow external crystal oscillator

compatible: "nxp,sxosc"

include: [base.yaml]

properties:
  reg:
    required: true

  startup-delay:
    required: true
    type: int
    description: |
      Crystal stabilization time, programmed into SXOSC_CTRL[EOCV].

      The oscillator releases its clock one cycle after its counter reaches
      EOCV times 128, so this has to cover the startup time of the crystal
      that is fitted. Valid range is 0 to 255.

      The SXOSC has no bypass mode: it only ever stabilizes with a 32.768 kHz
      crystal wired to OSC32K_EXTAL/OSC32K_XTAL. Enabling this node on a
      board without one leaves SXOSC_STAT[OSC_STAT] clear forever, so bound
      the wait with CONFIG_CLOCK_RETRY_TIMES to get an error instead of a
      hang during initialization.
```

## dts/bindings/memory-controllers/nxp,ahb-sramc.yaml
```yaml
# Copyright 2026 NXP
# SPDX-License-Identifier: Apache-2.0

description: |
  NXP AHB SRAM Controller (AHB_SRAMC).

  Controller for external asynchronous parallel SRAM (or SRAM-like FPGA)
  devices, found on i.MX RT266x. The controller is a peripheral in its own
  right, with VERID/MCR/LR registers plus one CFG0/CFG1 register pair per
  chip select, and is driven through the MCUXpresso SDK "sramc_1" HAL.

  This is a different hardware block from the one behind "nxp,sramc": that
  one lives inside the BLK_CTRL_WAKEUPMIX block on i.MX RT118x, has a single
  shared set of timing registers, and uses the SDK "sramc" HAL. The two are
  not interchangeable.

  Each chip select that carries an external device is described as a child
  node whose "reg" is the chip-select index. Bus timings are per chip select;
  the data-port width, address mode, ADV# polarity and AHB bus timeout are
  properties of the controller, because the hardware keeps them in the shared
  MCR register and cannot vary them per chip select.

  Timings are given in nanoseconds, straight off the SRAM part's datasheet.
  The driver reads the controller's functional clock (hclk) rate at init,
  converts each one into the matching register field, and picks the timing
  prescaler itself -- the smallest granularity in which every field of that
  chip select still fits, which is also the one with the least rounding.
  That keeps the devicetree independent of both the clock tree and the
  register encoding.

  Example for a 16-bit ADMUX SRAM on chip select 0 of an i.MX RT266x, whose
  chip-select windows are at 0x25000000 (CS0) and 0x25020000 (CS1), 128 KB
  each:

    &sramc {
        pinctrl-0 = <&pinmux_sramc>;
        pinctrl-names = "default";
        port-size = <16>;
        address-mode = "admux";
        status = "okay";

        sramc_cs0: sram@0 {
            reg = <0>;
            memory-region = <&ext_sram0>;

            ce-setup-time-ns = <0>;
            ce-hold-time-ns = <0>;
            address-setup-time-ns = <10>;
            address-hold-time-ns = <5>;
            turnaround-time-ns = <10>;
            write-enable-low-time-ns = <45>;
            write-enable-high-time-ns = <10>;
            read-enable-low-time-ns = <55>;
            read-enable-high-time-ns = <10>;
        };
    };

    / {
        ext_sram0: memory@25000000 {
            compatible = "zephyr,memory-region", "mmio-sram";
            reg = <0x25000000 DT_SIZE_K(128)>;
            zephyr,memory-region = "EXT_SRAM0";
            zephyr,memory-attr = <DT_MEM_ARM(ATTR_MPU_RAM)>;
        };
    };

  The window has to be a separate "zephyr,memory-region" node rather than the
  chip-select node itself: the chip-select windows are not inside the
  peripheral address aperture this controller sits in, so they cannot be
  address-translated as its children. Declaring them as regions is what gives
  the external SRAM a linker MEMORY{} entry, an MPU region and
  __<NAME>_start/_end symbols. Note that this driver runs at POST_KERNEL, so a
  region here can host explicitly placed sections, a heap or a buffer pool,
  but not anything the C runtime has to initialize before drivers come up.

compatible: "nxp,ahb-sramc"

include: [base.yaml, pinctrl-device.yaml]

properties:
  reg:
    required: true

  clocks:
    required: true
    description: |
      The controller's functional clock (hclk). Its rate is what every timing
      field is counted in, so the driver reads it to convert the nanosecond
      timings below.

  "#address-cells":
    required: true
    const: 1

  "#size-cells":
    required: true
    const: 0

  port-size:
    type: int
    required: true
    enum: [8, 16]
    description: |
      External data-port width in bits. Must match the data width of the
      connected SRAM. Required because an 8-bit device driven at 16 bits is
      silently corrupted, and the hardware has no way to detect the mismatch.
      Shared by every chip select (MCR[PS]).

  address-mode:
    type: string
    required: true
    enum:
      - "admux"       # Address/data multiplexed
      - "non-admux"   # Address/data not multiplexed
    description: |
      Whether the low address bits are multiplexed onto the data lines.
      Required because it decides which pins the board has to route: admux
      needs SRAMC_ADVB and a turnaround time, non-admux needs the dedicated
      SRAMC_ADDR lines instead. Shared by every chip select (MCR[AM]).

  adv-polarity:
    type: string
    default: "active-low"
    enum:
      - "active-low"
      - "active-high"
    description: |
      Polarity of the ADV# address-valid strobe, used in admux mode only.
      The default is the register's power-on reset value, and is the polarity
      the signal's name implies; it is independent of every other property
      here. Shared by every chip select (MCR[ADVP]).

  bus-timeout:
    type: int
    default: 0
    min: 0
    max: 255
    description: |
      AHB bus timeout, in units of 1024 hclk cycles. An AHB access that is
      not granted within that many cycles completes with a bus error, which
      reaches the CPU as a fault. Zero -- the register's power-on reset value
      -- disables the timeout counter entirely, which is why this is a single
      property rather than a separate enable flag that could disagree with
      the count. Shared by every chip select (MCR[BTO] and MCR[BTOEN]).

  nxp,function-clock-always-on:
    type: boolean
    description: |
      Disable the controller's internal clock gating, so its functional clock
      runs even when no access is in flight (MCR[CG_DIS]). Omit it to leave
      gating enabled, which is the reset behaviour and the lower-power one.

child-binding:
  description: |
    An external device on one of the controller's chip selects. All of its
    timings are required: they come from the connected part's datasheet, there
    is no value that is safe for an unknown part, and the register fields they
    program share a per-chip-select prescaler, so they only make sense as a
    set.

  properties:
    reg:
      type: int
      required: true
      description: |
        Chip-select index this device is wired to. The number of chip selects
        is SoC specific -- i.MX RT266x has two, CS0 and CS1.

    memory-region:
      type: phandle
      required: true
      description: |
        The "zephyr,memory-region" node describing this chip select's
        memory-mapped window. Required: without it the window has no linker
        region, no MPU region and no start/end symbols, and the driver has no
        base address to report through the MEMC API.

    ce-setup-time-ns:
      type: int
      required: true
      description: |
        Time CE# is asserted before the access starts (CFG0_CS[CES]). May be 0.

    ce-hold-time-ns:
      type: int
      required: true
      description: |
        Time CE# stays asserted after the access ends (CFG0_CS[CEH]). May be 0.

    address-setup-time-ns:
      type: int
      required: true
      description: |
        Time the address is driven before the access strobe (CFG0_CS[AS]).
        May be 0, except in admux mode where the hardware always inserts one
        clock cycle.

    address-hold-time-ns:
      type: int
      required: true
      description: |
        Time the address is held after its setup phase (CFG0_CS[AH]). The
        field counts from one granularity period, so 0 selects that minimum
        rather than no hold at all.

    turnaround-time-ns:
      type: int
      required: true
      description: |
        Dead time during which neither the controller nor the device drives
        the data lines (CFG0_CS[TA]). Needed in admux mode, where the lines
        change direction between address and data; the field counts from one
        granularity period, so 0 selects that minimum.

    write-enable-low-time-ns:
      type: int
      required: true
      description: |
        WE# asserted time, which is the write pulse width (CFG1_CS[WEL]).
        Counts from one granularity period, so 0 selects that minimum.

    write-enable-high-time-ns:
      type: int
      required: true
      description: |
        WE# deasserted time between writes (CFG1_CS[WEH]). Counts from one
        granularity period, so 0 selects that minimum.

    read-enable-low-time-ns:
      type: int
      required: true
      description: |
        OE# asserted time, which has to cover the part's access time
        (CFG1_CS[REL]). Counts from one granularity period, so 0 selects that
        minimum.

    read-enable-high-time-ns:
      type: int
      required: true
      description: |
        OE# deasserted time between reads (CFG1_CS[REH]). Counts from one
        granularity period, so 0 selects that minimum.

    wait-pin:
      type: int
      min: 0
      max: 3
      description: |
        Index of the SRAMC_WP wait pin this device drives. Setting it enables
        wait-state monitoring for this chip select (CFG0_CS[WM_EN] and
        [WP_MUX]) and makes wait-mode required; omit it for a device that does
        not use a wait signal. The controller decodes four pins, but a given
        SoC routes fewer -- i.MX RT266x brings out SRAMC_WP0 and SRAMC_WP1
        only.

    wait-mode:
      type: string
      enum:
        - "level"
        - "level-and-counter"
        - "level-or-counter"
        - "edge"
        - "edge-and-counter"
        - "edge-or-counter"
      description: |
        What ends a wait state (CFG0_CS[WM_SEL]): the wait pin alone, or the
        pin combined with the internal access counter -- "and" waits for both
        to finish, "or" for either. The counter is the read-enable-low time on
        reads and the write-enable-low time on writes. Required when wait-pin
        is set, ignored otherwise.

    wait-active-high:
      type: boolean
      description: |
        The wait pin is asserted high (CFG0_CS[WP_POL]). Omit it for a
        low-asserted wait pin, which is the reset behaviour. Ignored unless
        wait-pin is set.
```

## dts/bindings/mipi-dsi/nxp,mipi-dsi-split.yaml
```yaml
#
# SPDX-FileCopyrightText: Copyright 2026 NXP
#
# SPDX-License-Identifier: Apache-2.0
#
description: NXP MCUX MIPI DSI (split_1 controller)

compatible: "nxp,mipi-dsi-split"

include: mipi-dsi-host.yaml

properties:
  interrupts:
    required: true

  nxp,lcdif:
    type: phandle
    description:
      Instance of the LCDIF/DCIF peripheral. Only required when using the MIPI
      in video mode

  dpi-pixel-packet:
    type: string
    enum:
      - "16-bit"
      - "18-bit"
      - "18-bit-loose"
      - "24-bit"
    description:
      MIPI DSI pixel packet type send through DPI interface.

  dpi-video-mode:
    type: string
    enum:
      - "non-burst-sync-pulse"
      - "non-burst-sync-event"
      - "burst"
    description:
      DPI video mode.

  dpi-bllp-mode:
    type: string
    enum:
      - "blank"
      - "null"
      - "vertical-low-power"
      - "horizontal-low-power"
    description:
      Behavior in BLLP (Blanking or Low-Power Interval).

  autoinsert-eotp:
    type: boolean
    description:
      Automatically insert an EoTp short packet when switching from HS to LP mode.

  dphy-ref-frequency:
    type: int
    default: 0
    description:
      Maximum clock speed supported by the device, in Hz. Leave at default
      if no DPHY PLL is present

  noncontinuous-hs-clk:
    type: boolean
    description:
      Enable non-continuous high speed clock. Saves power but introduces latency
      when transitioning to high speed mode.
```
