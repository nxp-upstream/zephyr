## dts/bindings/p_state/nxp,rt2k-pmu-pstate.yaml
```yaml
# SPDX-FileCopyrightText: Copyright 2026 NXP
# SPDX-License-Identifier: Apache-2.0

description: |
  NXP RT2K PMU performance state (pstate): one of the run modes the PMU and the
  power controller switch between.

compatible: "nxp,rt2k-pmu-pstate"

include:
  - "zephyr,pstate.yaml"

properties:
  load-threshold:
    required: true

  cpu-frequency-level:
    type: string
    required: true
    enum:
      - low
      - normal
      - high
    description: |
      Run mode of this performance state: low is Low Power Run, normal is
      Normal Run and high is HP (Over Drive) Run.
```

## dts/bindings/power-domain/nxp,pdcon-power-domain.yaml
```yaml
# SPDX-FileCopyrightText: Copyright 2026 NXP
# SPDX-License-Identifier: Apache-2.0

description: |
  NXP PDCON (Power Domain Controller) power domain.

  One of the domains PDCON can switch off while the CPU runs. The domain has no
  register block of its own, so the node has no reg; domain-name says which
  domain it is.

compatible: "nxp,pdcon-power-domain"

include: power-domain.yaml

properties:
  domain-name:
    type: string
    required: true
    enum:
      - "Npu"
      - "Comm"
      - "Media"
    description: |
      Domain this node controls: the NPU, communication or media domain. The
      value is spelled as the suffix of the matching power_domain_t member of
      the MCUX HAL ("Npu" for kPOWER_DomainNpu), so the HAL value follows from
      it without a lookup table.
```

## dts/bindings/regulator/nxp,rt2k-pmu-regulator.yaml
```yaml
# SPDX-FileCopyrightText: Copyright 2026 NXP
# SPDX-License-Identifier: Apache-2.0

description: |
  NXP RT2K PMU (Power Management Unit) on-chip regulators.

  Each regulator is a child node without a compatible, identified by its node
  name:

  - dcdc: VDD_CORE buck converter
  - ldo0v8: VDD_0V8 LDO
  - ldo1v8: VDD_1V8 LDO
  - ldovdda: VDDA_1V8 LDO
  - ldoa0v8, ldoq0v8: LDOA_0V8 and LDOQ_0V8 supplies. They have no voltage or
    mode setting; the only control is whether they stay powered in low-power
    modes.

compatible: "nxp,rt2k-pmu-regulator"

include: base.yaml

properties:
  reg:
    required: true

child-binding:
  include:
    - name: regulator.yaml
      property-allowlist:
        - regulator-always-on
        - regulator-boot-on
        - regulator-min-microvolt
        - regulator-max-microvolt

  description: Output of an on-chip PMU regulator
```

## dts/bindings/retained_mem/nxp,rfsys.yaml
```yaml
# Copyright 2026 NXP
#
# SPDX-License-Identifier: Apache-2.0

title: NXP System Register File (RFSYS)

description: |
  Retained memory area backed by the NXP system register file (RFSYS).

  RFSYS is a small array of 32-bit registers that stays powered in every
  power mode, keeps its contents across a low-voltage detect event and is
  only cleared by a power-on reset. It has no clock gate and no enable bit,
  so the generic "zephyr,retained-reg" driver handles it as is; list that
  compatible second to bind it.

  The reg size is the usable size of the area in bytes, not the size of the
  peripheral slot: four registers on MCXC041, eight on the other MCX C
  parts.

compatible: "nxp,rfsys"

include: ["base.yaml", "zephyr,retained-reg.yaml"]

properties:
  reg:
    required: true
```

## dts/bindings/wuc/nxp,powercon-wuc.yaml
```yaml
# SPDX-FileCopyrightText: Copyright 2026 NXP
# SPDX-License-Identifier: Apache-2.0

description: |
  NXP POWERCON (Power Controller) acting as a Wakeup Controller (WUC).

  POWERCON gates which sources can wake the SoC from a low-power mode:
  interrupts through the CMC0 interrupt wakeup mask, DMA requests through the
  CMC1 (MAIN domain) and CMC2 (WAKE domain) DMA wakeup masks. The "id" cell
  consumed through "wakeup-ctrls" properties encodes one source: bits [31:28]
  select the path and the remaining bits are the source index on it, the NVIC
  interrupt number for the interrupt path. Write it with the macros of
  <zephyr/dt-bindings/wuc/wuc_nxp_powercon.h>.

compatible: "nxp,powercon-wuc"

include: [base.yaml, wuc-controller.yaml]

properties:
  reg:
    required: true

  '#wakeup-ctrl-cells':
    type: int
    const: 1
    description: |
      Number of cells in wakeup-ctrls property.

wakeup-ctrl-cells:
  - id
```

## samples/subsys/task_wdt/Kconfig
```kconfig
# SPDX-FileCopyrightText: Copyright 2026 NXP
# SPDX-License-Identifier: Apache-2.0

config TASK_WDT_HW_FALLBACK_PAUSE_HALTED_BY_DBG
	default n if WDT_MCUX_WWDT && (SOC_FAMILY_MCXN || SOC_FAMILY_MCXA)

source "Kconfig.zephyr"
```

## samples/subsys/video/capture/Kconfig
```kconfig
# Copyright (c) 2024 Espressif Systems (Shanghai) Co., Ltd.
# SPDX-License-Identifier: Apache-2.0

mainmenu "Video capture sample application"

menu "Video capture configuration"

config VIDEO_SOURCE_CROP_LEFT
	int "Crop area left value"
	default 0
	help
	   Left value of the crop area within the video source.

config VIDEO_SOURCE_CROP_TOP
	int "Crop area top value"
	default 0
	help
	   Top value of the crop area within the video source.

config VIDEO_SOURCE_CROP_WIDTH
	int "Crop area width value"
	default 0
	help
	   Width value of the crop area within the video source.
	   If set to 0, the crop is not applied.

config VIDEO_SOURCE_CROP_HEIGHT
	int "Crop area height value"
	default 0
	help
	   Height value of the crop area within the video source.
	   If set to 0, the crop is not applied.

config VIDEO_FRAME_HEIGHT
	int "Height of the video frame"
	default 0
	help
	  Height of the video frame. If set to 0, the default height is used.

config VIDEO_FRAME_WIDTH
	int "Width of the video frame"
	default 0
	help
	  Width of the video frame. If set to 0, the default width is used.

config VIDEO_PIXEL_FORMAT
	string "Pixel format of the video frame"
	help
	  Pixel format of the video frame. If not set, the default pixel format is used.

config VIDEO_CTRL_HFLIP
	bool "Mirror the video frame horizontally"
	help
	  If set, mirror the video frame horizontally

config VIDEO_CTRL_VFLIP
	bool "Mirror the video frame vertically"
	help
	  If set, mirror the video frame vertically

config VIDEO_SHELL_AND_CAPTURE
	bool "Capture video even if the video shell is enabled"
	depends on VIDEO_SHELL
	default n
	help
	  If set, the video capture is enabled even if the video shell is also enabled.

config VIDEO_CAM_NUM_BUFS
	int "Number of video buffers used for the camera"
	default 2
	help
	  Number of buffers in the video buffer pool used for the camera device.
	  The rest of the buffer pool will be used for other purposes such as transformation.

choice VIDEO_TRANSFORM
	prompt "Video transform implementation"
	bool
	help
	  The captured frame will go through m2m transforms defined in a separate .c file.
	  The implementation could include "transform.h" which provides helper functions
	  for setting up and executing the transformation.

config VIDEO_TRANSFORM_NONE
	bool "No transform"
	help
	  Display the captured frames as they come out of the video source.

config VIDEO_TRANSFORM_SW_YUYV
	bool "Software YUYV to RGB565 conversion"
	help
	  Convert the YUYV frames coming from the video source into the RGB565 frames the
	  display drivers accept, on the CPU. Needed for video sources such as USB webcams
	  that do not offer a pixel format the display accepts, on boards without a hardware
	  pixel converter.

endchoice

endmenu

source "Kconfig.zephyr"
```
