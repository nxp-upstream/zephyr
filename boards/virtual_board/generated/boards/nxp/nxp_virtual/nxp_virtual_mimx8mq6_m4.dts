/* Auto-generated by gen_nxp_virtual_board.py */
/* Master DTS template: boards/nxp/imx8mq_evk/imx8mq_evk_mimx8mq6_m4.dts */
/*
 * Copyright (c) 2021, Kwon Tae-young <tykwon@m2i.co.kr>
 *
 * SPDX-License-Identifier: Apache-2.0
 */

/dts-v1/;

#include <nxp/nxp_imx8mq_m4.dtsi>
#include "imx8mq_evk-pinctrl.dtsi"

/ {
	model = "NXP Virtual Board (mimx8mq6/m4)";
	compatible = "nxp,mimx8mq6";

	aliases {
		uart-2 = &uart2;
	};

	chosen {
		zephyr,flash = &tcml_code;
		zephyr,sram = &tcmu_sys;
		zephyr,console = &uart2;
		zephyr,shell-uart = &uart2;
	};
};

&uart2 {
	status = "okay";
	current-speed = <115200>;
	pinctrl-0 = <&uart2_default>;
	pinctrl-names = "default";
};
