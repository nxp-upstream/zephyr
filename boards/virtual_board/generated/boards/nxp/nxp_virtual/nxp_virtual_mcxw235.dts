/* SPDX-FileCopyrightText: 2025 NXP */
/* SPDX-License-Identifier: Apache-2.0 */
/* Auto-generated by gen_nxp_virtual_board.py */
/dts-v1/;

#include <nxp/nxp_mcxw236_ns.dtsi>

/ {
	model = "NXP Virtual Board (mcxw235)";
	compatible = "nxp,mcxw235";
};

&os_timer {
	status = "disabled";
};

&systick {
	status = "okay";
};

/ {
	chosen {
		zephyr,flash = &flash0;
		zephyr,sram = &sram0;
		zephyr,flash-controller = &iap;
	};
};
