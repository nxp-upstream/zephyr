/* SPDX-FileCopyrightText: 2025 NXP */
/* SPDX-License-Identifier: Apache-2.0 */
/* Auto-generated by gen_nxp_virtual_board.py */
/dts-v1/;

#include <nxp/nxp_imxrt700_hifi1.dtsi>

/ {
	model = "NXP Virtual Board (mimxrt798s/hifi1)";
	compatible = "nxp,mimxrt798s";
};
