/* Auto-generated by gen_nxp_virtual_board.py */
/* Master DTS template: boards/nxp/imx91_qsb/imx91_qsb_mimx9111.dts */
/*
 * Copyright 2025 NXP
 *
 * SPDX-License-Identifier: Apache-2.0
 */

/dts-v1/;

#include <nxp/nxp_mimx9111.dtsi>
#include "imx91_qsb-pinctrl.dtsi"

/ {
	model = "NXP Virtual Board (mimx9111)";
	compatible = "nxp,mimx9111";

	chosen {
		zephyr,console = &lpuart1;
		zephyr,shell-uart = &lpuart1;
		/* sram node actually locates at DDR DRAM */
		zephyr,sram = &dram;
	};

	dram: memory@80000000 {
		reg = <0x80000000 DT_SIZE_M(1)>;
	};
};

&lpuart1 {
	status = "okay";
	current-speed = <115200>;
	pinctrl-0 = <&uart1_default>;
	pinctrl-names = "default";
};
