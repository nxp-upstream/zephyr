/* SPDX-FileCopyrightText: 2025 NXP */
/* SPDX-License-Identifier: Apache-2.0 */
/* Auto-generated by gen_nxp_virtual_board.py */
/dts-v1/;

#include <nxp/nxp_mcxw72.dtsi>

/ {
	model = "NXP Virtual Board (mcxw727c/cpu0)";
	compatible = "nxp,mcxw727c";
};

/ {
	chosen {
		zephyr,flash = &flash;
		zephyr,sram = &stcm0;
		zephyr,flash-controller = &fmu;
	};
};

/ {
	cpus {
		/delete-node/ cpu@1;
	};
};
