/* SPDX-FileCopyrightText: 2025 NXP */
/* SPDX-License-Identifier: Apache-2.0 */
/* Auto-generated by gen_nxp_virtual_board.py */
/dts-v1/;

#include <nxp/nxp_imx8m.dtsi>

/ {
	model = "NXP Virtual Board (mimx8ml8/adsp)";
	compatible = "nxp,mimx8ml8";
};
