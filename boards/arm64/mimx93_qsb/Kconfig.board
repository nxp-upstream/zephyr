## boards/arm64/mimx93_qsb/Kconfig.board
```kconfig
# Copyright 2022 NXP
# SPDX-License-Identifier: Apache-2.0

config BOARD_MIMX93_QSB_A55
	bool "NXP i.MX93 QSB A55"
	depends on SOC_SERIES_MIMX9_A55
	select SOC_PART_NUMBER_MIMX9322CVUXK
```

## boards/arm64/mimx93_qsb/Kconfig.defconfig
```kconfig
# Copyright 2022 NXP
# SPDX-License-Identifier: Apache-2.0

if BOARD_MIMX93_QSB_A55

config BOARD
	default "mimx93_qsb_a55"

config SOC
	default "mimx9322"

config SOC_PART_NUMBER_MIMX9322CVWXM
	default y

endif # BOARD_MIMX93_9X9_QSB_A55
```

## boards/nxp/frdm_imxrt700/Kconfig.defconfig
```kconfig
# FRDM-IMXRT700 board

# Copyright 2026 NXP
# SPDX-License-Identifier: Apache-2.0

if BOARD_FRDM_IMXRT700

if SOC_MIMXRT798S_CM33_CPU0

# The XIP boot flash (W25Q25PW quad SPI NOR on XSPI0) is described as a
# bare soc-nv-flash node because the nxp,xspi-nor driver does not support
# this part yet. The automatic XIP detection in
# soc/nxp/common/Kconfig.xspi_xip keys off the flash node sitting under a
# controller under the nxp,xspi node, so it does not trigger here. Enable
# it explicitly: it compiles the XSPI clock setup code and relocates it to
# SRAM, so that the PLL/XSPI clock reconfiguration in
# board_early_init_hook() never executes from the flash it reclocks.
config FLASH_MCUX_XSPI_XIP
	default y

endif

endif
```

## boards/nxp/kw45b41z_evk/Kconfig.board
```kconfig
# Copyright 2023 NXP
# SPDX-License-Identifier: Apache-2.0

config BOARD_KW45B41Z_EVK
	bool "NXP KW45 EVK"
	depends on SOC_SERIES_KINETIS_KW45
	select SOC_PART_NUMBER_KW45B41Z83AFTA
```

## boards/nxp/kw45b41z_evk/Kconfig.defconfig
```kconfig
# KW45B41Z-EVK board

# Copyright 2024 NXP
# SPDX-License-Identifier: Apache-2.0

if BOARD_KW45B41Z_EVK

choice BT_HCI_BUS_TYPE
	default BT_NXP
endchoice

config BT_DIS_MANUF
	default "NXP"

endif # BOARD_KW45B41Z_EVK
```

## boards/nxp/kw45b41z_evk/kw45b41z_evk_defconfig
```kconfig
#
# Copyright 2023 NXP
#
# SPDX-License-Identifier: Apache-2.0
#

CONFIG_SOC_KW45B41Z83=y
CONFIG_SOC_SERIES_KINETIS_KW45=y
CONFIG_BOARD_KW45B41Z_EVK=y
CONFIG_ARM_MPU=y
CONFIG_TRUSTED_EXECUTION_SECURE=y
CONFIG_PINCTRL=y
CONFIG_SERIAL=y
CONFIG_CONSOLE=y
CONFIG_UART_CONSOLE=y
CONFIG_GPIO=y
```

## boards/nxp/mimxrt1060_ind400/board.yml
```yaml
boards:
  - name: mimxrt1060_ind400
    full_name: MIMXRT1060-IND400
    vendor: nxp
    socs:
      - name: mimxrt1062
        variants:
          - name: "qspi"
```

## boards/nxp/mimxrt700_evk/Kconfig
```kconfig
# Copyright 2025 NXP
# SPDX-License-Identifier: Apache-2.0

config BOARD_MIMXRT700_EVK
	select BOARD_EARLY_INIT_HOOK if \
		BOARD_MIMXRT700_EVK_MIMXRT798S_CM33_CPU0 || \
		BOARD_MIMXRT700_EVK_MIMXRT798S_CM33_CPU1

config MIMXRT700_EVK_QSPI_FLASH
	bool
	help
	  Selected automatically by the "w25q512nw" board revision (mimxrt700_evk@w25q512nw).
	  Installs the W25Q512NWEIQ quad SPI NOR flash-configuration block (FCB) for
	  XSPI0 instead of the default octal MX25UM51345G, so the boot ROM brings up
	  XSPI0 for quad XIP from the on-board QSPI flash. Requires board rework to
	  populate the QSPI flash path.
```

## boards/nxp/mimxrt700_evk/board.yml
```yaml
board:
  name: mimxrt700_evk
  full_name: MIMXRT700-EVK
  vendor: nxp
  revision:
    format: custom
    default: ""
    revisions:
    - name: ""
    - name: "w25q512nw"
  socs:
  - name: mimxrt798s
```

## boards/nxp/s32k5xxcvb/s32k5xxcvb_s32k566_m7_defconfig
```kconfig
# Copyright 2025 NXP
# SPDX-License-Identifier: Apache-2.0

# Enable MPU
CONFIG_ARM_MPU=y
CONFIG_CLOCK_CONTROL=y

# Run from Code MRAM
CONFIG_XIP=y

CONFIG_SERIAL=y
CONFIG_CONSOLE=y
CONFIG_UART_CONSOLE=y
```

## boards/nxp/s32z2xxdc2/s32z2xxdc2_s32z270_rtu0_smp_defconfig
```kconfig
# Copyright 2024 NXP
# SPDX-License-Identifier: Apache-2.0

CONFIG_XIP=n
CONFIG_ISR_STACK_SIZE=512
CONFIG_SYS_CLOCK_TICKS_PER_SEC=1000
CONFIG_SYS_CLOCK_HW_CYCLES_PER_SEC=8000000
CONFIG_ARM_MPU=y
CONFIG_PINCTRL=y
CONFIG_SERIAL=y
CONFIG_CONSOLE=y

# SMP enabled
CONFIG_SMP=y
CONFIG_USE_SWITCH=y

# SMP limitation
CONFIG_FPU=n
CONFIG_DCACHE=n

# RTU cores configured in lock-step
CONFIG_MP_MAX_NUM_CPUS=2
```

## boards/nxp/x_mr_kw45_ble_lr/Kconfig.x_mr_kw45_ble_lr
```kconfig
# Copyright 2025 NXP
# SPDX-License-Identifier: Apache-2.0

config BOARD_X_MR_KW45_BLE_LR
        bool "NXP X-MR-KW45-BLE-LR"
        select SOC_KW45B41Z
        select SOC_PART_NUMBER_KW45B41Z83
```

## boards/nxp/x_mr_kw45_ble_lr/board.yml
```yaml
board:
  name: x_mr_kw45_ble_lr
  full_name: X-MR-KW45-BLE-LR
  vendor: nxp
  socs:
    - name: kw45b41z
```

## boards/shields/adafruit_dpi_display_kippah/Kconfig.shield
```kconfig
# Copyright 2023 NXP
# SPDX-License-Identifier: Apache-2.0

config SHIELD_NXP_X_RPI_CAM_INT
	def_bool $(shields_list_contains,adafruit_dpi_display_kippah)
```

## boards/shields/g1120b0mipi/boards/mimxrt700_evk_mimxrt798s_cm33_cpu0.conf
```kconfig
CONFIG_REGULATOR=y
CONFIG_DCACHE=n
# Memory manager settings
CONFIG_LV_Z_MEM_POOL_SIZE=92160

CONFIG_LV_MEM_SIZE_KILOBYTES=70
CONFIG_LV_MEM_POOL_EXPAND_SIZE_KILOBYTES=0
CONFIG_LV_MEM_ADR=0x0

CONFIG_LV_USE_LOG=y
CONFIG_LV_LOG_LEVEL_ERROR=y
CONFIG_LV_LOG_USE_TIMESTAMP=n
CONFIG_LV_LOG_USE_FILE_LINE=y
CONFIG_LV_LOG_TRACE_MEM=n
CONFIG_LV_LOG_TRACE_TIMER=n
CONFIG_LV_LOG_TRACE_INDEV=n
CONFIG_LV_LOG_TRACE_DISP_REFR=n
CONFIG_LV_LOG_TRACE_EVENT=n
CONFIG_LV_LOG_TRACE_OBJ_CREATE=n
CONFIG_LV_LOG_TRACE_LAYOUT=n
CONFIG_LV_LOG_TRACE_ANIM=n
CONFIG_LV_LOG_TRACE_CACHE=n
```

## boards/shields/nxp_lcd_spec/Kconfig.shield
```kconfig
#
# Copyright 2026 NXP
#
# SPDX-License-Identifier: Apache-2.0
#

config SHIELD_NXP_LCD_SPEC
	def_bool $(shields_list_contains,nxp_lcd_spec)
```

## boards/shields/nxp_x_rpi_cam_int/Kconfig.shield
```kconfig
# Copyright 2023 NXP
# SPDX-License-Identifier: Apache-2.0

config SHIELD_NXP_X_RPI_CAM_INT
	def_bool $(shields_list_contains,nxp_x_rpi_cam_int)
```

## drivers/audio/Kconfig.dmic_mcux_pdm
```kconfig
# Copyright 2025 NXP
# SPDX-License-Identifier: Apache-2.0

config AUDIO_DMIC_MCUX_PDM
	bool "DMIC driver for MCUX"
	default y
	depends on DT_HAS_NXP_MCUX_PDM_ENABLED
	select DMA
	select PINCTRL
	help
	  Enable support for DMIC on NXP MCUX SoC's

if AUDIO_DMIC_MCUX_PDM

config DMIC_MCUX_PDM_DMA_BUFFERS
	int "Number of buffers to reserve for DMIC DMA"
	default 1
	range 1 16
	help
	  This determines how many buffers the driver should allocate and
	  reserve for the DMA engine. The memory slab used with the DMIC
	  API should provide at least one more buffer than this value, since
	  a buffer will always be in the RX queue.

config DMIC_MCUX_PDM_QUEUE_SIZE
	int "Size of DMIC buffer queue"
	default 8
	help
	  This sets the size of the RX buffer queue for the DMIC. Up to this
	  many buffers may be queued by the DMIC once it is triggered, before
	  the application must read buffers to avoid data being dropped.

endif # AUDIO_DMIC_MCUX_PDM
```

## drivers/audio/spdif/Kconfig
```kconfig
# Copyright (c) 2026 NXP
# SPDX-License-Identifier: Apache-2.0

menuconfig AUDIO_SPDIF_MCUX
	bool "NXP MCUX SPDIF controller driver"
	default y
	depends on DT_HAS_NXP_MCUX_SPDIF_ENABLED
	select PINCTRL
	select CLOCK_CONTROL
	select DMA
	help
	  Enable support for the NXP MCUX SPDIF transceiver block.

if AUDIO_SPDIF_MCUX

config AUDIO_SPDIF_TX_BLOCK_COUNT
	int "SPDIF TX queue length"
	default 4

config AUDIO_SPDIF_RX_BLOCK_COUNT
	int "SPDIF RX queue length"
	default 4

config AUDIO_SPDIF_HAS_PLL_SETTING
	bool "Program the audio PLL/root clock in the driver"
	default y

endif # AUDIO_SPDIF_MCUX
```

## drivers/cache/Kconfig
```kconfig
# Copyright (c) 2021 Carlo Caione <ccaione@baylibre.com>
# SPDX-License-Identifier: Apache-2.0

menuconfig CACHE
	bool "External cache controller drivers"
	default y if CACHE_MANAGEMENT
	help
	  Enable support for external cache controllers drivers

if CACHE

config CACHE_HAS_DRIVER
	bool

config CACHE_DEVICE_ROUTER
    bool "Compose sys cache with device caches"
    depends on CACHE_DEVICE && CACHE_MANAGEMENT
    help
      When enabled, sys_cache_* range and all operations will call both
      the CPU/arch caches and any registered device-side caches via the
      cache_device_* APIs. This is a convenience layer for platforms
      with memory-side caches (e.g. external/XIP controllers).

module = CACHE
module-str = cache
source "subsys/logging/Kconfig.template.log_config"

comment "Device Drivers"

source "drivers/cache/Kconfig.aspeed"
source "drivers/cache/Kconfig.nrf"
source "drivers/cache/Kconfig.andes"
source "drivers/cache/Kconfig.nxp_syscon_lpcac"
source "drivers/cache/Kconfig.nxp_xcache"
source "drivers/cache/Kconfig.stm32"
source "drivers/cache/Kconfig.bflb"

endif # CACHE
```

## drivers/cache/Kconfig.nxp_lmem_cache
```kconfig
# Copyright 2025 NXP
# SPDX-License-Identifier: Apache-2.0

config CACHE_NXP_LMEM_CACHE
	bool "NXP LMEM cache driver"
	default y
	select CACHE_HAS_DRIVER
	select DCACHE_STATE_QUERY if DCACHE
	select ICACHE_STATE_QUERY if ICACHE
	depends on HAS_MCUX_LMEM_CACHE
	help
	  This option enables the LMEM cache driver for NXP SOCs.
```

## drivers/cache/Kconfig.nxp_xcache
```kconfig
# Copyright 2025 NXP
# SPDX-License-Identifier: Apache-2.0

config CACHE_NXP_XCACHE
	bool "NXP external cache driver for xcache controller"
	default y
	select CACHE_HAS_DRIVER
	select DCACHE_STATE_QUERY if DCACHE
	select ICACHE_STATE_QUERY if ICACHE
	depends on HAS_MCUX_XCACHE
	help
	  This option enables the XCACHE driver for NXP SOC's.
```
