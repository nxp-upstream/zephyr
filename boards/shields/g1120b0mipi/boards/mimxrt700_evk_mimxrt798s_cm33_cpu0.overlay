/*
 * Copyright 2024 NXP
 *
 * SPDX-License-Identifier: Apache-2.0
 */

#include <zephyr/dt-bindings/mipi_dbi/mipi_dbi.h>
#include <zephyr/dt-bindings/display/panel.h>

/{
    chosen {
        zephyr,display = &display_mipi_dbi;
    };
};

&zephyr_lcdif {
    status = "okay";
    compatible = "nxp,dcnano-lcdif-dbi";
    mipi-dsi = <0x40417000>;
    mipi-mode = <MIPI_DBI_MODE_8080_BUS_16_BIT>;
    color-coding = "D16-RGB565";
    clock-frequency = <279000000>;
    wr-period = <14>;
    wr-assert = <6>;
    wr-deassert = <13>;
    cs-assert = <1>;
    cs-deassert = <4>;
    display_mipi_dbi: display_mipi_dbi {
        status = "okay";
        compatible = "display_mipi_dbi";
        te-gpios = <&nxp_mipi_connector 22 GPIO_ACTIVE_HIGH>;
        bl-gpios = <&nxp_mipi_connector 0 GPIO_ACTIVE_HIGH>;
        width = <400>;
        height = <392>;
        current-pixel-format = <PANEL_PIXEL_FORMAT_RGB_565>;
    };
};