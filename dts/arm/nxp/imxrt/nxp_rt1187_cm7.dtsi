/*
 * Copyright 2026 NXP
 *
 * SPDX-License-Identifier: Apache-2.0
 */

/* SOC DTS for MIMXRT1187 CM7 core */

/* RT1187 shares the same package and peripheral set as RT1189. */
#include <nxp/imxrt/nxp_rt118x_cm7.dtsi>
