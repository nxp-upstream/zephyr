/*
 * Copyright 2026 NXP
 *
 * SPDX-License-Identifier: Apache-2.0
 */

/* SOC DTS for MIMXRT1181 CM33 core (single-core part) */

/* RT1181 shares the same package and pin layout as RT1182. */
#include <nxp/imxrt/nxp_rt1182_cm33.dtsi>
