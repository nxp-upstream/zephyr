/*
 * Copyright 2026 NXP
 *
 * SPDX-License-Identifier: Apache-2.0
 */

/* SOC DTS for MIMXRT118C CM33 core */

/* RT118C shares the same package and pin layout as RT1186. */
#include <nxp/imxrt/nxp_rt1186_cm33.dtsi>
