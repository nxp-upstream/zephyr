## dts/bindings/power/nxp,mcux-pmc.yaml
```yaml
# Copyright 2024 NXP
# SPDX-License-Identifier: Apache-2.0

description: NXP MCUX PMC (Power Management Controller)

compatible: "nxp,mcux-pmc"

include: base.yaml

properties:
  reg:
    required: true

  bandgap-buffer-enable:
    type: boolean
    description: |
        Bandgap buffer can be enabled by BGBE bit in
        REGSC register. It is optional feature available
        on some SoCs only.
```

## dts/bindings/psi5/nxp,s32-psi5_s-channel.yaml
```yaml
# Copyright 2024 NXP
#
# SPDX-License-Identifier: Apache-2.0

description: Properties for Peripheral Sensor Interface (PSI5_S) channel

compatible: "nxp,s32-psi5_s-channel"

include: base.yaml

properties:
  async-mode:
    type: boolean
    description: |
      This setting enables the channel operation asynchronous mode for Rx only.
      Otherwise enables the channel operation synchronous mode for both Rx and Tx.

  # Channel TX configuration
  init-cmd:
    required: true
    type: int
    description: |
      Initial reset reload value for the integrated "CMD" format

  init-acmd:
    required: true
    type: int
    description: |
      Initial reset reload value for the integrated "ACMD" format

  target-period:
    required: true
    type: int
    description: |
      Subsequent reload values for the integrated period generator

  counter-delay:
    required: true
    type: int
    description: |
      Time in us for which the manchester decoder is disabled after the falling
      edge of a sync pulse

  tx-mode:
    required: true
    type: string
    enum:
      - SHORT FRAME 31
      - SHORT FRAME 5
      - LONG FRAME 31
      - LONG FRAME 5
      - X LONG FRAME 31
      - X LONG FRAME 5
      - XX LONG FRAME
      - NON STANDARD FRAME
    description: |
      Transmitter mode:
        - SHORT FRAME 31: Short Frame(V1.3) with 31 "1s" as the start condition
        - SHORT FRAME 5: Short Frame(V1.3) with 5 "0s" as the start condition
        - LONG FRAME 31: Long Frame(V1.3) with 31 "1s" as the start condition
        - LONG FRAME 5: Long Frame(V1.3) with 5 "0s" as the start condition
        - X LONG FRAME 31: X-Long Frame(V1.3) with 31 "1s" as the start condition
        - X LONG FRAME 5: X-Long Frame(V1.3) with 5 "0s" as the start condition
        - XX LONG FRAME: XX-Long (V2.0)
        - NON STANDARD FRAME: Non Standard Length

  slots-pay-load-size:
    type: array
    required: true
    description: |
      Payload region length
```

## dts/bindings/psi5/nxp,s32-psi5_s-controller.yaml
```yaml
# Copyright 2024 NXP
#
# SPDX-License-Identifier: Apache-2.0

description: Properties for Peripheral Sensor Interface (PSI5_S)

compatible: "nxp,s32-psi5_s-controller"

include: [base.yaml, pinctrl-device.yaml]

properties:
  uart-baud-rate:
    type: int
    required: true
    enum:
      - 1200
      - 2400
      - 4800
      - 7200
      - 9600
      - 14400
      - 19200
      - 28800
      - 38400
      - 57600
      - 115200
      - 230400
      - 460800
      - 921600
      - 1843200
    description: |
      uart-baud-rate

  uart-baud-rate-cus:
    type: int
    required: true
    description: |
      uart-baud-rate-cus

  uart-preset-timeout:
    type: int
    required: true
    description: |
      Preset timeout defines the preset value of timeout counter.
      A zero-value is forbidden

  uart-tx-idle-delay-time:
    type: int
    required: true
    description: |
      This register is used to add a programmable idle time between the data that is transmitted
      on the UART Tx line. The duration of this delay is programmable between 1 to 16 bit times.
      The programmable delay is such that when the normal ECU to Sensor communication(no direct command)
      is happening, then it comes into play between each byte of transmitted data, When the ECU
      to Sensor direct command is used then this delay comes into play between each direct command.
      The direct commands can be programmed as 1,2 and 4 bytes depending on the GLCR[DIRCMD_LEN] register

  uart-reduced-over-sampling:
    type: int
    required: true
    description: |
      uart-reduced-over-sampling

  uart-sampling-point:
    type: int
    required: true
    description: |
      uart-sampling-point
```

## dts/bindings/pwm/nxp,qtmr-pwm.yaml
```yaml
# Copyright (c) 2024, NXP
# SPDX-License-Identifier: Apache-2.0

description: NXP QTMR PWM

compatible: "nxp,qtmr-pwm"

include: [pwm-controller.yaml, pinctrl-device.yaml, base.yaml]

properties:
  prescaler:
    type: int
    default: 128
    description: prescale factor from the qtmr clock. Default to 128
    enum: [1, 2, 4, 8, 16, 32, 64, 128]

  "#pwm-cells":
    const: 3

pwm-cells:
  - channel
  - period
  - flags
```
