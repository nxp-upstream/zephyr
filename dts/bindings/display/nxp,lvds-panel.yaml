## dts/bindings/display/nxp,lvds-panel.yaml
```yaml
# Copyright (c) 2022, NXP
# SPDX-License-Identifier: Apache-2.0

description: NXP LVDS Panel

compatible: "nxp,lvds-panel"

include: [base.yaml, pinctrl-device.yaml]

properties:
  lvds-blt-en-gpios:
    required: true
    type: phandle-array
    description:
      LVDS_BLT_EN GPIO. Driver will initialize this GPIO to active high

  lvds-blt-pwm-gpios:
    required: true
    type: phandle-array
    description:
      LVDS_BLT_PWM GPIO. Driver will initialize this GPIO to active high
```

## dts/bindings/edac/nxp,eim-channel.yaml
```yaml
description: NXP Error Injection Channel

compatible: "nxp,eim-channel"

include: base.yaml

properties:
  channel-id:
    type: int

  start-address:
    type: int

  inject-enable:
    type: int

  ecc-enable:
    type: int
```

## dts/bindings/edac/nxp,eim.yaml
```yaml
description: NXP Error Injection Module

compatible: "nxp,eim"

include: [reset-device.yaml, base.yaml]
```

## dts/bindings/edac/nxp,erm.yaml
```yaml
description: NXP Error Reporting Module

compatible: "nxp,erm"

include: [reset-device.yaml, base.yaml]

properties:
  channels:
    type: array
```

## dts/bindings/ethernet/phy/nxp,t1s-phy.yaml
```yaml
# Copyright (c) 2024 Microchip Technology Inc.
# Copyright 2026 NXP
# SPDX-License-Identifier: Apache-2.0

description: NXP 10BASE-T1S PHY support

compatible: "nxp,t1s-phy"

include: phy.yaml

properties:
  reg:
    required: true
    description: PHY address
  interrupts:
    required: true
  interrupt-names:
    required: true
  plca-enable:
    type: boolean
    description: Enable or disable PLCA support
  plca-node-id:
    type: int
    description: Specify the PLCA node ID number
  plca-node-count:
    type: int
    description: Specify the PLCA node count
  plca-burst-count:
    type: int
    description: Specify the PLCA burst count
  plca-burst-timer:
    type: int
    description: Specify the PLCA burst timer value
  plca-to-timer:
    type: int
    description: Specify the PLCA to timer value
```

## dts/bindings/flash_controller/nxp,fmu-k4.yaml
```yaml
description: NXP Kinetis K4 Flash Controller

compatible: "nxp,fmu-k4"

include: flash-controller.yaml
```

## dts/bindings/flash_controller/nxp,imx-lpspi-nor.yaml
```yaml
# Copyright (c) 2018,2023 NXP
# SPDX-License-Identifier: Apache-2.0

description: NXP i.MX LPSPI controller

compatible: "nxp,imx-lpspi-nor"

include: ["spi-controller.yaml", "pinctrl-device.yaml"]
```

## dts/bindings/ipc/nxp,ipc-rpmsg-lite.yaml
```yaml
# Copyright 2026 NXP
# SPDX-License-Identifier: Apache-2.0

description: RPMSG-Lite backend

compatible: "nxp,ipc-rpmsg-lite"

include: base.yaml

properties:
  role:
    description: RPMSG-Lite roles
    required: true
    type: string
    enum:
      - host
      - remote

  link-id:
    required: true
    type: int
    description: |
      Link ID of the instance.
      Has to be same between Instances between Host and Remote.

      Allowed values [0..(DT_NUM_INST_STATUS_OKAY()-1)).

      User is responsible to correctly assign one value for each pair of
      ipc instances between host and remote.

      This is required to link two instances together with same ID,
      because DT_INST_FOREACH_STATUS_OKAY does not made any guarantees about the order
      that instancies appear in the Device Tree expansion.

      For Example:
      Host:
       ipc0: ipc0 { link-id = <0>; ... };
       ipc1: ipc1 { link-id = <1>; ... };
      Remote:
       ipc0: ipc0 { link-id = <0>; ... };
       ipc1: ipc1 { link-id = <1>; ... };
      This will link Host ipc[0,1] with Remote ipc[0,1].

  memory-region:
    description: phandle to the shared memory region
    required: true
    type: phandle

  mboxes:
    description: phandle to the MBOX controller (TX and RX are required)
    required: true

  mbox-names:
    description: MBOX channel names (must be called "tx" and "rx")
    required: true

  zephyr,priority:
    type: array
    description: |
      WQ priority for the instance. This property is an array composed by the
      priority level and the type of priority (PRIO_COOP for cooperative or
      PRIO_PREEMPT for preemptive).

      For example for a thread priority K_PRIO_COOP(1) in DT we have
        priority = <1 PRIO_COOP>;
      or for K_PRIO_PREEMPT(2)
        priority = <2 PRIO_PREEMPT>;

      When this property is missing a default priority of <0 PRIO_PREEMPT> is
      assumed.

  zephyr,buffer-size:
    type: int
    description: |
      The size of the buffer used to send data between host and remote. Default
      value is RL_BUFFER_PAYLOAD_SIZE. This property must be the same for host and
      remote.
```

## dts/bindings/mdio/snps,designware-ethernet-mdio.yaml
```yaml
# Copyright 2024 NXP
# SPDX-License-Identifier: Apache-2.0

description: Synopsys DesignWare Ethernet MDIO

compatible: "snps,designware-ethernet-mdio"

include: [base.yaml, mdio-controller.yaml, pinctrl-device.yaml]

properties:
  clocks:
    required: true
```

## dts/bindings/mipi-dsi/nxp,imx-mipi-dsi-dw.yaml
```yaml
#
# Copyright 2025 NXP
#
# SPDX-License-Identifier: Apache-2.0
#
description: NXP MCUX MIPI DSI DW

compatible: "nxp,imx-mipi-dsi-dw"

include: mipi-dsi-host.yaml

properties:
  interrupts:
    required: true

  nxp,lcdif:
    type: phandle
    description:
      Instance of the LCDIF peripheral. Only required when using the MIPI
      DSI in video mode.

  dpi-color-coding:
    type: string
    enum:
      - "16-bit-config-1"
      - "16-bit-config-2"
      - "16-bit-config-3"
      - "18-bit-config-1"
      - "18-bit-config-2"
      - "24-bit"
    description:
      MIPI DPI interface color coding. Sets the distribution of RGB bits within
      the 24-bit d bus, as specified by the DPI specification.

  dpi-video-mode:
    type: string
    enum:
      - "non-burst-sync-pulse"
      - "non-burst-sync-event"
      - "burst"
    description:
      DPI video mode.

  dphy-ref-frequency:
    type: int
    required: false
    description:
      Maximum clock speed supported by the device, in Hz.

  phy-clock:
    type: int
    required: false
    description:
      MIPI PHY clock frequency. Should be set to ensure clock frequency is at
      least (pixel clock * bits per output pixel) / number of mipi data lanes
```

## dts/bindings/misc/nxp,evtg.yaml
```yaml
# SPDX-FileCopyrightText: Copyright 2026 NXP
# SPDX-License-Identifier: Apache-2.0

description: |
  NXP EVTG (Event Generator) peripheral.

  The EVTG combines up to four inputs (A, B, C, D) through two
  AND/OR/INVERT (AOI) blocks and an optional flip-flop to produce a single
  event-generator output. The inputs are routed from the on-chip INPUTMUX
  and the output drives the interconnect (for example PWM faults, timer or
  ADC triggers) or a device pin.

  The peripheral is configured through the NXP HAL driver fsl_evtg and has
  no Zephyr runtime API of its own; enabling an evtg node only makes the HAL
  driver available to consumers and tests.

compatible: "nxp,evtg"

include: base.yaml

properties:
  reg:
    required: true
```

## dts/bindings/mtd/nxp,imx-flexspi-nand.yaml
```yaml
# Copyright 2026 NXP
# SPDX-License-Identifier: Apache-2.0

description: |
  NAND device connected to an NXP FlexSPI controller.

compatible: "nxp,imx-flexspi-nand"

include: nxp,imx-flexspi-device.yaml
```

## dts/bindings/mtd/nxp,imx-flexspi-w25n01kv.yaml
```yaml
# Copyright 2020 NXP
# SPDX-License-Identifier: Apache-2.0

description: NXP FlexSPI W25N01KV

compatible: "nxp,imx-flexspi-w25n01kv"

include: ["nxp,imx-flexspi-device.yaml", soc-nv-flash.yaml]
```

## dts/bindings/mtd/nxp,imx-lpspi-flash.yaml
```yaml
# Copyright 2018-2024, NXP
# SPDX-License-Identifier: Apache-2.0

description: NXP LPSPI device

compatible: "nxp,imx-lpspi-flash"

include: [spi-device.yaml, "jedec,jesd216.yaml"]
```

## dts/bindings/mtd/nxp,s32-xspi-hyperram.yaml
```yaml
# Copyright 2025 NXP
# SPDX-License-Identifier: Apache-2.0

description: |
  XSPI hyperram connected to the NXP S32 XSPI bus.

compatible: "nxp,s32-xspi-hyperram"

include: "nxp,s32-xspi-device.yaml"

properties:
  device-id-word-addr:
    required: true
    type: int
    description: |
      The word address of the device ID in ASO (Application-Specific Object).
      This address specifies the exact location within the memory where the device ID is stored.

  master-locked-type:
    type: string
    enum:
      - "SINGLE_ENDED"
      - "DIFFERENTIAL"
    description: |
      Selects the clock types:
        - Differential Clock: Command, address, and data information is output with respect
          to the crossing of the CK and CK# signals. Differential clock is used on 1.8V I/O devices.
        - Single Ended Clock: CK# is not used on 3.0V devices, only a single ended CK is used.
          The clock is not required to be free-running.

  drive-strength-ohm:
    type: int
    required: true
    enum: [0, 1, 2, 3, 4, 5, 6, 7]
    description: |
      Specifies the output drive strength in ohm, which based on the operating device VCC.
      The supported typical impedance settings:
        0 — 34 ohms (default)
        1 — 115 ohms
        2 — 67 ohms
        3 — 46 ohms
        4 — 34 ohms
        5 — 27 ohms
        6 — 22 ohms
        7 — 19 ohms
      See the CR0[14:12] field in CR0 configuration register in the memory device datasheet.

  refresh-interval:
    type: int
    required: true
    enum: [0, 1, 2, 3]
    description: |
      Set the automatic refresh interval for HyperRAM, ensuring the memory is regularly refreshed
      without host intervention.
      This helps keep data safe and prevents long access delays.
        0 — default
          4 us for Industrial temperature range devices
          1 us for Auto Grade (A2, A3) temperature range devices
        1 — 1.5 times default
        2 — 2 times default
        3 — 4 times default

  initial-latency-cycles:
    type: int
    required: true
    enum: [3, 4, 5, 6, 7]
    description: |
      Specifies the read latency in cycles, which is determined based on the operating frequency
      as specified in the memory device datasheet.
```

## dts/bindings/nvmem/fixed-layout.yaml
```yaml
# Copyright (c) 2025 Basalte bv
# SPDX-License-Identifier: Apache-2.0

description: |
  Fixed layout for Non-Volatile memory.
  
  Notes:
    - For efuse/OTP providers, cells are typically provisioned once and then
      treated as read-only by firmware. Mark such cells with the 'read-only'
      property to prevent accidental writes by NVMEM consumers.

compatible: "fixed-layout"

properties:
  "#address-cells":
    type: int
    const: 1
    description: |
      Number of cells required to represent a child node's
      reg property address.

  "#size-cells":
    type: int
    const: 1
    description: |
      Number of cells required to represent a child node's size.

child-binding:
  description: |
    Each child node of the NVMEM provider node represents
    an individual NVMEM cell. These should usually
    look like this:

      cell_nodelabel: cell@START_OFFSET {
              reg = <0xSTART_OFFSET 0xSIZE>;
              #nvmem-cell-cells = <0>;
      };

  properties:
    reg:
      type: array
      required: true
      description: |
        This should be in the format <OFFSET SIZE>, where OFFSET
        is the offset of the NVMEM cell relative to the base
        address of the parent memory, and SIZE is the size of
        the cell in bytes.

    read-only:
      type: boolean
      description: |
        Set this property if the cell is read-only. For efuse/OTP devices,
        cells should normally be marked read-only to avoid accidental writes.
```

## dts/bindings/nvmem/nxp,ocotp.yaml
```yaml
# Copyright 2025 NXP
# SPDX-License-Identifier: Apache-2.0

description: NXP OCOTP eFuse access via ROM API table

compatible: "nxp,ocotp"

include:
  - fixed-layout.yaml

properties:
  reg:
    type: array
    required: false
    description: |
      For OCOTP devices accessed via the ROM API the device's MMIO
      'reg' is generally not used by the provider. When named nvmem
      cells are declared under the OCOTP node (using the included
      fixed-layout.yaml) the 'reg' address is interpreted as a byte
      offset into the efuse memory and the size cell is in bytes.

      Example: with the nvmem cell declared as
        reg = <0x134 0x1>;
      the address 0x134 is a byte offset (308 decimal) which equals
      efuse word index 77 (308 / 4 == 77). The provider/driver is
      expected to read the containing 32-bit word and extract the
      requested byte(s).

      If a different convention is used (for example the board's DT
      encodes efuse word indices rather than byte offsets), document
      that convention here and ensure the OCOTP provider/driver
      performs the appropriate conversion.

  rom-api-tree-addr:
    type: int
    required: true
    description: |
      Absolute address of the ROM API tree base;
      the OCOTP driver pointer is read from index 12
```

## dts/bindings/power-domain/nxp,cmc-pd.yaml
```yaml
# Copyright (c) 2025, NXP
# SPDX-License-Identifier: Apache-2.0

description: NXP CMC power domain

compatible: "nxp,cmc-pd"

include: power-domain.yaml

properties:
  on-off,disabling-power-states:
    type: phandles
    description: |
      List of power states that will turn this power domain on/off.
  
  resume-suspend,disabling-power-states:
    type: phandles
    description: |
      List of power states that will resume/suspend this power domain.

  "#power-domain-cells":
    const: 0  
  
```

## dts/bindings/power-domain/nxp,lpc-pdruncfg-power-domain.yaml
```yaml
# Copyright 2026 NXP
# SPDX-License-Identifier: Apache-2.0

description: NXP LPC PDRUNCFG-controlled power domain

compatible: "nxp,lpc-pdruncfg-power-domain"

include: power-domain.yaml

properties:
  nxp,pdruncfg-mask:
    type: int
    required: true
    description: |
      Bitmask for the power-down configuration (PDRUNCFG) register.
      POWER_DisablePD(mask) will be used to power the domain on, and
      POWER_EnablePD(mask) will be used to power the domain off.

  "#power-domain-cells":
    const: 0
```

## dts/bindings/power-domain/nxp,pmc-power-rail-controller.yaml
```yaml
# Copyright 2026 NXP
# SPDX-License-Identifier: Apache-2.0

description: |
  NXP PMC (Power Management Controller) power-rail controller.

  The controller owns an array of PDRUNCFG registers that gate
  individual peripheral / SRAM power rails. Each child node represents
  one rail and is exposed as an upstream "power-domain"; consumer
  peripherals reference rails via the standard "power-domains" property.

compatible: "nxp,pmc-power-rail-controller"

include: base.yaml

properties:
  reg:
    required: true

child-binding:
  description: |
    A single PMC-controlled power rail (one bit in PDRUNCFG[idx]).

  properties:
    "#power-domain-cells":
      type: int
      const: 0

    nxp,pdruncfg-bit:
      type: array
      required: true
      description: |
        Two-cell descriptor of the PDRUNCFG bit owned by this rail:
        <pdruncfg-register-index bit-position>.

examples:
  - |
    pmc0: pmc@20f000 {
      compatible = "nxp,pmc-power-rail-controller";
      reg = <0x20f000 0x1000>;

      pmc_apd_xspi0: apd-xspi0 {
        #power-domain-cells = <0>;
        nxp,pdruncfg-bit = <4 18>;
      };
      pmc_ppd_xspi0: ppd-xspi0 {
        #power-domain-cells = <0>;
        nxp,pdruncfg-bit = <5 18>;
      };
    };

    &xspi0 {
      power-domains = <&pmc_apd_xspi0>, <&pmc_ppd_xspi0>;
      zephyr,pm-device-runtime-auto;
    };
```

## dts/bindings/power-domain/nxp,spc-pd.yaml
```yaml
description: NXP SPC power domain

compatible: "nxp,spc-pd"

include:
  - power-domain.yaml
  - base.yaml

properties:
  pd-ctrl-bit:
    type: int
    required: false
    description: |
      Control bit in SPC[EVD_CFG] to control this power domain.

  "#power-domain-cells":
    const: 0  
```
