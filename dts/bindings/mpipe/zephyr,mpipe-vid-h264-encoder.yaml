## samples/net/webrtc/Kconfig
```kconfig
# SPDX-FileCopyrightText: Copyright (c) 2026 Meta Platforms, Inc.
# SPDX-License-Identifier: Apache-2.0

mainmenu "WebRTC sample"

# The decoder only has to accept the 320x240 stream the sample negotiates.
if ZEPHYRTC_VIDEO_H264

config H264SWDEC_HEAP_SIZE
	default 393216

config H264SWDEC_MAX_FRAME_WIDTH
	default 320

config H264SWDEC_MAX_FRAME_HEIGHT
	default 240

config H264SWDEC_MAX_FRAME_SIZE
	default 76800

endif # ZEPHYRTC_VIDEO_H264

source "Kconfig.zephyr"

menu "WebRTC sample"

config ZEPHYRTC_TRANSPORT
	bool
	default y
	select LIBPEER
	help
	  Build libpeer and libsrtp against Zephyr's Mbed TLS integration and
	  run a bounded cryptographic initialization probe.

choice ZEPHYRTC_DEMO_MODE
	prompt "libpeer endpoint mode"
	default ZEPHYRTC_MODE_LOOPBACK
	help
	  Select the loopback, signaling-test, or external endpoint mode.

config ZEPHYRTC_MODE_LOOPBACK
	bool "In-process two-peer loopback"
	help
	  Two PeerConnections in one image exchange SDP directly, then complete host
	  ICE, DTLS-SRTP, and bidirectional PCMU RTP. This is the default gate.

config ZEPHYRTC_MODE_HTTP_SIGNALING
	bool "HTTP signaling client against an in-process mock answerer"
	depends on NET_SOCKETS && NET_TCP && NET_IPV4
	select ZEPHYRTC_SIGNALING_CLIENT
	help
	  Run the signaling failure matrix, then drive one PeerConnection as SDP
	  offerer through POST /offer to an in-process mock answerer over Zephyr
	  loopback TCP, and require the same ICE, DTLS-SRTP, and PCMU RTP result.

config ZEPHYRTC_MODE_EXTERNAL
	bool "External HTTP answerer"
	depends on NET_SOCKETS && NET_TCP && NET_UDP && NET_IPV4
	select ZEPHYRTC_SIGNALING_CLIENT
	help
	  POST one complete PCMU-only or H.264/PCMU offer to an external answerer,
	  apply the answer, complete ICE and DTLS-SRTP, then send the configured
	  bounded media sources and require sustained received media.

config ZEPHYRTC_MODE_SELF_CALL
	bool "Call between two endpoints of the image, with the media"
	depends on NET_SOCKETS && NET_UDP && NET_IPV4
	help
	  Two PeerConnections in one image exchange SDP directly. The first
	  one sends what the camera and the microphone capture, the second one
	  gives what it receives to the display and the headphones, through
	  the loopback of the IP stack. This runs everything a call with a
	  remote peer does except signaling and the network driver, on a board
	  that has no network.

endchoice

config ZEPHYRTC_SELF_CALL_RUN_MS
	int "Length of the call of the board with itself in milliseconds"
	depends on ZEPHYRTC_MODE_SELF_CALL
	range 1000 86400000
	default 30000
	help
	  How long the two endpoints stay in the call before the result is
	  reported.

config ZEPHYRTC_AUDIO_RT1170
	bool "RT1170 DMIC and WM8962 PCMU audio"
	depends on ZEPHYRTC_MODE_EXTERNAL || ZEPHYRTC_MODE_SELF_CALL
	depends on BOARD_MIMXRT1170_EVK_MIMXRT1176_CM7 && BOARD_REVISION_B
	depends on I2S && AUDIO_CODEC && AUDIO_DMIC
	help
	  Capture 16 kHz stereo samples from the RT1170 DMIC, downsample and encode
	  them as 8 kHz mono PCMU, and decode remote PCMU to the WM8962 playback path.

config ZEPHYRTC_VIDEO_H264
	bool "Software H.264 video with MiniH264 and H264SwDec"
	depends on ZEPHYRTC_MODE_EXTERNAL || ZEPHYRTC_MODE_SELF_CALL
	depends on !ZEPHYRTC_AUDIO_RT1170 || (VIDEO && DISPLAY)
	select MINIH264
	select H264SWDEC
	help
	  Enable 320x240 all-IDR MiniH264 and H264SwDec video. Synthetic media is used
	  for software gates; the RT1170 audio configuration uses the chosen camera
	  and display. Codec memory uses bounded static storage and a dedicated heap.

config ZEPHYRTC_MEDIA_MPIPE
	bool "Media on the Multimedia Pipeline subsystem"
	depends on ZEPHYRTC_MODE_EXTERNAL || ZEPHYRTC_MODE_SELF_CALL
	depends on MPIPE_BASE_APP_SINK && MPIPE_BASE_APP_SRC && MPIPE_AUD
	depends on !ZEPHYRTC_VIDEO_H264 || (MPIPE_VID_H264_ENCODER && MPIPE_DISP)
	help
	  Capture, encode, decode and render the media of the call with
	  pipelines of the Multimedia Pipeline subsystem, one per leg, instead
	  of the media code of the sample. The application then only moves
	  the encoded frames and the G.711 packets between the pipelines and
	  the WebRTC stack. overlay-mpipe.conf enables it with what it needs.

if ZEPHYRTC_MEDIA_MPIPE

config ZEPHYRTC_VIDEO_WIDTH
	int "Width of the video frames"
	default 320
	help
	  Width in pixels of the frames the camera delivers and of the frames
	  the peer sends. The codec memory is reserved for this size.

config ZEPHYRTC_VIDEO_HEIGHT
	int "Height of the video frames"
	default 240
	help
	  Height in pixels of the frames the camera delivers and of the frames
	  the peer sends. The codec memory is reserved for this size.

config ZEPHYRTC_VIDEO_FPS
	int "Frame rate of the camera"
	range 1 120
	default 30
	help
	  Frames per second asked of the camera, which is also the rate the
	  video is sent at as long as the encoder keeps up.

config ZEPHYRTC_VIDEO_QP
	int "Quantizer of the encoder"
	range 10 51
	default 28
	help
	  Quantizer the encoder uses for every frame: 10 for the best picture,
	  51 for the smallest stream. The default gives a 320x240 picture
	  without visible blocks at a few hundred kbit/s.

config ZEPHYRTC_VIDEO_SPEED
	int "Speed of the encoder"
	range 0 10
	default 9
	help
	  Speed against quality, from 0 (every coding tool) to 10 (fastest).
	  9 is the fastest setting that keeps the deblocking filter, without
	  which the blocks of the picture show in flat areas. On the Cortex-M7
	  of the i.MX RT1170 it is also faster than 10.

config ZEPHYRTC_VIDEO_GOP
	int "Key frame period in frames"
	range 0 65535
	default 300
	help
	  The encoder also sends a key frame whenever the peer asks for one,
	  which is how a lost frame is recovered. The period only bounds the
	  time a peer whose request was lost stays without a picture: ten
	  seconds at 30 frames per second with the default. 0 sends key frames
	  on request only.

config ZEPHYRTC_HEADPHONES_SAMPLE_RATE
	int "Sample rate of the audio codec"
	default 16000
	help
	  Rate the received audio is played at, a multiple of the 8 kHz of
	  G.711 that the audio codec of the board supports.

config ZEPHYRTC_DISPLAY_PLANE
	int "Display plane showing the video of the peer"
	default -1
	help
	  Display plane the decoded frames are scanned out from, without a
	  copy, on a display that has planes. -1 writes them to the display.

config ZEPHYRTC_DISPLAY_X
	int "Horizontal position of the video of the peer"
	default -1
	help
	  Column of the display where the left edge of the frames goes. -1
	  puts the frames in the middle of the display.

config ZEPHYRTC_DISPLAY_Y
	int "Vertical position of the video of the peer"
	default -1
	help
	  Row of the display where the top edge of the frames goes. -1 puts
	  the frames in the middle of the display.

config ZEPHYRTC_DECODER_REMOTE
	bool "Decode the video of the peer on the second core"
	depends on MPIPE_ERPC && SECOND_CORE_MCUX
	help
	  Put a transform client in the place of the decoder in the display
	  leg: every piece of the stream of the peer goes to the second core,
	  whose image (the remote application of the sample, added by a
	  sysbuild) serves a pipeline that holds the same decoder element, and
	  the decoded frame comes back in a buffer of this core. The first
	  core keeps the network, the encoder and the audio.

config ZEPHYRTC_CODE_RELOCATE
	bool "Relocate the code of the media and of the network into RAM"
	select CODE_DATA_RELOCATION
	help
	  Run from RAM, instead of the flash, the code every frame and every
	  packet goes through: the encoder, the decoder, the pixel format
	  conversions, SRTP, the WebRTC stack and the IP stack. On a
	  microcontroller that executes in place from a serial flash this is
	  where most of their time goes.

if ZEPHYRTC_CODE_RELOCATE

config ZEPHYRTC_MEDIA_CODE_RAM_NAME
	string "Media code RAM location"
	default "RAM"
	help
	  Memory region the codecs, the pixel format conversions, SRTP and the
	  WebRTC stack are relocated to.

config ZEPHYRTC_NET_CODE_RAM_NAME
	string "IP stack code RAM location"
	default "RAM"
	help
	  Memory region the IP stack is relocated to.

endif # ZEPHYRTC_CODE_RELOCATE

config ZEPHYRTC_CODEC_DATA_RELOCATE
	bool "Relocate the codec memory"
	select CODE_DATA_RELOCATION
	help
	  Place the state and working area of the encoder and the heap of the
	  decoder in named memory regions, on a board whose default RAM is
	  slower than another one it has.

if ZEPHYRTC_CODEC_DATA_RELOCATE

config ZEPHYRTC_ENCODER_RAM_NAME
	string "Encoder memory location"
	default "RAM"
	help
	  Memory region holding the state and working area of the encoder.

config ZEPHYRTC_DECODER_RAM_NAME
	string "Decoder memory location"
	default "RAM"
	help
	  Memory region holding the heap of the decoder.

endif # ZEPHYRTC_CODEC_DATA_RELOCATE

endif # ZEPHYRTC_MEDIA_MPIPE

config ZEPHYRTC_DISPLAY_ROTATION
	int "Decoded-video display rotation in clockwise degrees"
	depends on ZEPHYRTC_VIDEO_H264 && (ZEPHYRTC_AUDIO_RT1170 || ZEPHYRTC_MEDIA_MPIPE)
	range 0 270
	default 0
	help
	  Rotate decoded video clockwise before display. Valid values are 0, 90,
	  180, and 270 degrees. Other values fail at compile time. The media on
	  the Multimedia Pipeline subsystem rotates with the video transform
	  device of the board and ignores the option on a board without one.

config ZEPHYRTC_DISPLAY_SCALE
	int "Decoded-video integer display scale"
	depends on ZEPHYRTC_VIDEO_H264 && (ZEPHYRTC_AUDIO_RT1170 || ZEPHYRTC_MEDIA_MPIPE)
	range 1 3
	default 1
	help
	  Upscale decoded video by this integer factor using nearest-neighbor
	  replication. The transformed image must fit the active display. The
	  media on the Multimedia Pipeline subsystem scales with the video
	  transform device of the board, which interpolates, and ignores the
	  option on a board without one.

config ZEPHYRTC_SIGNALING_CLIENT
	bool
	help
	  Build the Zephyr socket client that POSTs one complete SDP offer and
	  validates one bounded complete SDP answer, and the libpeer offerer that
	  uses it. Select it from an application mode that needs an external peer.

config ZEPHYRTC_SIGNALING_TIMEOUT_MS
	int "Default total signaling deadline in milliseconds"
	depends on ZEPHYRTC_SIGNALING_CLIENT
	range 100 120000
	default 25000
	help
	  Covers connect, request write, and response read for one offer exchange.
	  Callers may pass a shorter deadline per request.

config ZEPHYRTC_SIGNALING_URL
	string "External SDP answerer URL"
	depends on ZEPHYRTC_MODE_EXTERNAL
	default "http://127.77.0.1:18080/offer"
	help
	  Complete HTTP URL accepted by the bounded signaling client. Only a dotted
	  IPv4 literal or localhost is supported; TLS and DNS are intentionally out
	  of scope for the bring-up endpoint.

config ZEPHYRTC_NETWORK_TIMEOUT_MS
	int "Network readiness deadline in milliseconds"
	depends on ZEPHYRTC_MODE_EXTERNAL
	range 1000 120000
	default 30000
	help
	  Wait this long for the default interface to acquire a preferred IPv4
	  address before creating the PeerConnection and gathering a host candidate.

config ZEPHYRTC_WIFI_SSID
	string "Wi-Fi station SSID"
	depends on ZEPHYRTC_MODE_EXTERNAL && WIFI
	default ""
	help
	  SSID used to associate the Wi-Fi station. Set this only from a private
	  EXTRA_CONF_FILE outside the source tree, such as the one
	  tools/rt1170_demo.py generates.

config ZEPHYRTC_WIFI_PASSWORD
	string "Wi-Fi station password"
	depends on ZEPHYRTC_MODE_EXTERNAL && WIFI
	default ""
	help
	  WPA2 or WPA3 personal password for the Wi-Fi station. An empty value
	  selects an open network. Set this only from a private EXTRA_CONF_FILE
	  outside the source tree, such as the one tools/rt1170_demo.py generates.

config ZEPHYRTC_EXTERNAL_RUN_MS
	int "External connected-media validation time in milliseconds"
	depends on ZEPHYRTC_MODE_EXTERNAL
	range 5000 86400000
	default 12000
	help
	  Run external media validation for this connected interval. The maximum
	  supports soak tests lasting up to 24 hours.

config ZEPHYRTC_DEMO_RUN_MS
	int "native_sim synthetic media run time in milliseconds"
	range 4200 60000
	default 4200
	help
	  Run long enough to generate beeps beginning at 0, 2, and 4 seconds.

endmenu
```
