## dts/bindings/mpipe/zephyr,mpipe-vid-h264-encoder.yaml
```yaml
# Copyright 2026 NXP
# SPDX-License-Identifier: Apache-2.0

description: Pipeline element encoding frames to an H.264 byte stream in software.

compatible: "zephyr,mpipe-vid-h264-encoder"

include: mpipe-element.yaml

properties:
  qp:
    type: int
    default: 30
    description: |
      Quantizer used for every frame, from 10 (best quality) to 51. The
      default is a middle value: a recognizable picture at a moderate bit
      rate.

  gop:
    type: int
    default: 30
    description: |
      Key frame period in frames. 1 makes every frame a key frame; 0
      produces one key frame at the start and then only on request. The
      default gives a late receiver a starting point every second at 30
      frames per second.

  speed:
    type: int
    default: 9
    description: |
      Speed against quality, from 0 (every coding tool) to 10 (fastest).
      The default is the fastest setting that keeps the deblocking filter,
      without which the blocks of the picture show in flat areas.
```

## dts/bindings/mpipe/zephyr,mpipe-vid-overlay.yaml
```yaml
# Copyright 2026 NXP
# SPDX-License-Identifier: Apache-2.0

description: |
  Pipeline element letting the application draw on the frames, or on frames
  of its own shown on another display plane.

compatible: "zephyr,mpipe-vid-overlay"

include: mpipe-element.yaml

properties:
  draw-callback:
    type: string
    description: |
      Name of the function drawing on a frame, defined by the application as
      an mpipe_vid_overlay_draw_cb_t with external linkage. The application
      sets the callback at run time when absent.

  mode:
    type: string
    default: "frame"
    enum:
      - "frame"
      - "plane"
      - "in-place"
    description: |
      Where the callback draws: in the video frame, in a transparent frame the
      element produces for each input buffer, or in the video frame without
      ever copying it. The last one needs no buffer of its own, and is for a
      pipeline where nothing else holds the frames that reach the element.

  width:
    type: int
    description: Width in pixels of the frames produced in the plane mode.

  height:
    type: int
    description: Height in pixels of the frames produced in the plane mode.
```

## dts/bindings/mpipe/zephyr,mpipe-vid-src.yaml
```yaml
# Copyright 2026 NXP
# SPDX-License-Identifier: Apache-2.0

description: Pipeline element capturing frames from a video device.

compatible: "zephyr,mpipe-vid-src"

include: mpipe-element.yaml

properties:
  device:
    type: phandle
    description: |
      Video device to capture from. The chosen "zephyr,camera" node when
      absent.

  num-buffers:
    type: int
    description: |
      Number of buffers to produce before ending the stream. Endless when
      absent.

  crop:
    type: array
    description: |
      Rectangle of the sensor to capture, as <left top width height> in
      pixels. The whole sensor when absent.

  hflip:
    type: boolean
    description: Mirror the frames horizontally.

  vflip:
    type: boolean
    description: Mirror the frames vertically.
```

## dts/bindings/mpipe/zephyr,mpipe-vid-transform-client.yaml
```yaml
# Copyright 2026 NXP
# SPDX-License-Identifier: Apache-2.0

description: |
  Pipeline element handing its frames to a video transform on another core.

compatible: "zephyr,mpipe-vid-transform-client"

include: mpipe-element.yaml

properties:
  channel:
    type: phandle
    required: true
    description: |
      Channel the element calls its server through, a node of an RPC backend.
      Each client element has a channel node of its own.
```

## dts/bindings/mpipe/zephyr,mpipe-vid-transform.yaml
```yaml
# Copyright 2026 NXP
# SPDX-License-Identifier: Apache-2.0

description: |
  Pipeline element processing frames with a memory-to-memory video device,
  such as a decoder, a scaler or a rotator.

compatible: "zephyr,mpipe-vid-transform"

include: mpipe-element.yaml

properties:
  device:
    type: phandle
    required: true
    description: Video device processing the frames.

  rotation:
    type: int
    enum:
      - 0
      - 90
      - 180
      - 270
    description: Angle in degrees the device rotates the frames by.
```
