## subsys/mpipe/utils/Kconfig
```kconfig
#
# Copyright 2026 NXP
#
# SPDX-License-Identifier: Apache-2.0
#

config MPIPE_DT
	bool "Pipelines described in the devicetree"
	default y
	depends on DT_HAS_ZEPHYR_MPIPE_PIPELINE_ENABLED
	imply MPIPE_PLAYER
	help
	  Build at boot the pipelines the devicetree describes with
	  zephyr,mpipe-pipeline nodes, and play those with the autostart
	  property, with no application code. The option of an element type
	  is enabled by default when the devicetree has a node of that type.

config MPIPE_DT_INIT_PRIORITY
	int "Initialization priority of the devicetree pipelines"
	default 95
	depends on MPIPE_DT
	help
	  Priority, in the APPLICATION level, at which the pipelines of the
	  devicetree are built and those with the autostart property played.

config MPIPE_PLAYER
	bool "Multimedia Pipeline player helper"
	depends on MPIPE
	imply SHELL
	imply SERIAL
	imply UART_CONSOLE
	help
	  Enable the mpipe_player control layer: a reusable, media-player-like
	  helper that owns the run-time lifecycle of a pipeline (play, pause,
	  stop, replay, quit). When SHELL is enabled it also registers
	  interactive shell commands ("player play|pause|stop|replay|quit|status"
	  and the single-letter shortcuts p/s/r/q).

if MPIPE_PLAYER

config MPIPE_PLAYER_NUM
	int "Number of players the application can have at once"
	range 1 255
	default $(dt_compat_enabled_num,$(DT_COMPAT_ZEPHYR_MPIPE_PIPELINE)) if MPIPE_DT
	default 1
	help
	  Each player owns a worker thread, so this sizes a pool of worker
	  stacks. A pipeline that streams needs an mpipe thread of its own as
	  well: MPIPE_THREADS_NUM must cover every pipeline playing at once.

config MPIPE_PLAYER_WORKER_STACK_SIZE
	int "Player worker thread stack size"
	default 6144
	help
	  Stack size (in bytes) for the player worker thread that serializes
	  pipeline state changes.

	  Capability negotiation runs on this thread and recurses from the source
	  down to the sinks. Each element keeps a few capabilities live while it
	  negotiates, roughly 800 bytes, so budget that much per element. The
	  default suits chains of up to about seven elements; raise it for longer
	  pipelines.

config MPIPE_PLAYER_WORKER_PRIORITY
	int "Player worker thread priority"
	default 5
	help
	  Scheduling priority for the player worker thread.

config MPIPE_PLAYER_CMD_QUEUE_DEPTH
	int "Player command queue depth"
	default 8
	help
	  Number of pending commands the player can buffer. Posting never
	  blocks, so a command asked for once the queue is full is dropped
	  and reported.

config MPIPE_PLAYER_DUMP_ON_STATE_CHANGE
	bool "Dump the pipeline on every state change and every error"
	depends on MPIPE_DUMP
	help
	  Print the pipeline after each state the player drives it to, and
	  whenever an element reports an error.

	  The dump is taken once the transition has finished, never between
	  two of them, so it delays nothing: a failure stops the pipeline
	  where it broke and the graph is still that failure's graph.

	  It goes to the console rather than the shell, since no shell
	  instance exists at that point. Extract a graph from a capture with:

	    sed -n '/^digraph/,/^}/p' log > pipe.dot

endif # MPIPE_PLAYER

config MPIPE_PIPELINE_SERVER
	bool "Pipeline server (serve a pipeline to another core)"
	depends on MPIPE_BASE_APP_SRC && MPIPE_BASE_APP_SINK
	help
	  Enable the pipeline server: the counterpart, on the core that does
	  the work, of a client element in the pipeline of another core. The
	  application builds an ordinary pipeline between an application
	  source and an application sink, and the server answers the client's
	  calls with it: capabilities, negotiation, one buffer at a time,
	  state changes and end of stream.

	  The server knows no media type and no transport. A plugin provides
	  the adapter for its media type, and the transport binding with it.

config MPIPE_DUMP
	bool "Pipeline topology dump"
	select MPIPE_ELEMENT_NAME
	help
	  Render a bin as a Graphviz graph for debugging: every element with
	  its state and pads, the peer of each pad and the capability
	  negotiated on it. The DOT text is written through a callback, to the
	  console by default.

config MPIPE_DUMP_MAX_ELEMENTS
	int "Maximum number of elements a dump can index"
	depends on MPIPE_DUMP
	range 2 256
	default 32
	help
	  A dump flattens nested bins, so it can hold more elements than one
	  bin's MPIPE_BIN_MAX_CHILDREN. An element past this limit is left out
	  of the graph and the dump is marked truncated.
```

## subsys/mpipe/vid/Kconfig
```kconfig
#
# Copyright 2025 NXP
#
# SPDX-License-Identifier: Apache-2.0
#

config MPIPE_VID
	bool "Video plugin support"
	select VIDEO
	help
	  Elements backed by Zephyr video devices: capture from a camera, and
	  memory-to-memory transforms performed by hardware such as a scaler,
	  rotator or decoder.

	  This is where zero-copy matters most, so the pools here hand out the
	  driver's own buffers rather than copies, and a frame captured by a
	  camera reaches the display without being moved.

if MPIPE_VID

config MPIPE_VID_CONVERT
	bool "Software-based pixel format converter"
	help
	  A transform that converts a frame from one pixel format to another on
	  the CPU.

	  It exists as the fallback for a conversion no hardware on the board can
	  do, which is common between a decoder's output format and what a panel
	  accepts. It converts pixel formats only: it does not scale, crop or
	  rotate. Expect it to cost real CPU time per frame.

config MPIPE_VID_H264_DECODER
	bool "Software H.264 decoder element"
	depends on ZEPHYR_H264SWDEC_MODULE
	select H264SWDEC
	help
	  Transform element that decodes an H.264 byte stream to planar
	  YUV 4:2:0 frames with the h264swdec module, for Baseline and
	  Constrained Baseline streams. The decoder takes its picture buffers
	  from the heap of the module (H264SWDEC_HEAP_SIZE).

if MPIPE_VID_H264_DECODER

config MPIPE_VID_H264_DECODER_POOL_NUM
	int "Number of buffers in the H.264 decoder's output pool"
	range 1 255
	default 2
	help
	  Number of buffers in the decoder's internal output pool, used when
	  downstream proposes no pool of its own. A picture decoded while every
	  buffer is held downstream is not shown.

config MPIPE_VID_H264_DECODER_MAX_OUT_FRAME_SIZE
	int "Maximum decoded frame size in bytes"
	default 115200
	help
	  Size of the buffers in the decoder's internal output pool: width x
	  height x 3 / 2 of the largest picture. The default holds 320x240.

endif # MPIPE_VID_H264_DECODER

config MPIPE_VID_H264_ENCODER
	bool "Software H.264 encoder element"
	depends on ZEPHYR_MINIH264_MODULE
	select MINIH264
	help
	  Transform element that encodes planar YUV 4:2:0 frames to a
	  Constrained Baseline H.264 byte stream with the minih264 module.

if MPIPE_VID_H264_ENCODER

config MPIPE_VID_H264_ENCODER_POOL_NUM
	int "Number of buffers in the H.264 encoder's output pool"
	range 1 255
	default 2
	help
	  Number of buffers in the encoder's internal output pool, used when
	  downstream proposes no pool of its own. A frame that arrives while
	  every buffer is held downstream is not encoded.

config MPIPE_VID_H264_ENCODER_MAX_OUT_FRAME_SIZE
	int "Maximum encoded frame size in bytes"
	default 32768
	help
	  Size of the buffers in the encoder's internal output pool. A frame
	  that encodes to more is dropped and the next one is a key frame.

config MPIPE_VID_H264_ENCODER_PERSIST_SIZE
	int "Encoder state size in bytes"
	default 294912
	help
	  Memory reserved for the encoder state, which holds the reference
	  frame. The size depends on the frame size; the element reports the
	  size it needs when the reserved one is too small. A 320x240 frame
	  needs 288368 bytes.

config MPIPE_VID_H264_ENCODER_SCRATCH_SIZE
	int "Encoder working area size in bytes"
	default 196608
	help
	  Memory reserved for the encoder working area, which holds the
	  encoded frame. The size depends on the frame size; the element
	  reports the size it needs when the reserved one is too small. A
	  320x240 frame needs 182607 bytes.

endif # MPIPE_VID_H264_ENCODER

config MPIPE_VID_OVERLAY
	bool "Video overlay element"
	help
	  A transform handing every buffer to an application draw callback,
	  the pipeline equivalent of drawing on a canvas, with drawing helpers
	  for rectangles, fills and text. In frame mode it draws into the video
	  frame, in place when nobody else holds it and into a copy otherwise,
	  as behind a tee. In plane mode it draws into a transparent BGRA32
	  frame of its own for a display sink on a display plane, and the
	  display controller blends the drawing over the video. Text needs the
	  character framebuffer's built-in fonts
	  (CHARACTER_FRAMEBUFFER_USE_DEFAULT_FONTS).

	  It is the software fallback and demonstration tier: the target for
	  compositing is an aggregator-based compositor and, where the display
	  controller has them, hardware layers.

config MPIPE_VID_PIPELINE_SERVER
	bool "Video adapter of the pipeline server"
	depends on MPIPE_PIPELINE_SERVER
	help
	  Serve a video pipeline to a video client element on another core:
	  the functions answering the calls of the video transform and sink
	  clients with a pipeline server, translating between the formats of
	  the video API the clients speak and the capabilities the served
	  pipeline negotiates with.

endif # MPIPE_VID
```
