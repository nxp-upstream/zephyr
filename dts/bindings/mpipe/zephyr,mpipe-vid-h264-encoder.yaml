## samples/subsys/mpipe/audio_multicore/aud_remote/Kconfig
```kconfig
# Copyright 2026 NXP
# SPDX-License-Identifier: Apache-2.0

# The audio format and the functions of the remote audio server. The
# sysbuild.cmake of each sample sets the sample rate and the functions from
# its own sysbuild options, so that the server serves what the Cortex-M33
# pipeline opens, in the format it captures. The channel count and the block
# duration are negotiated: the Cortex-M33 sets them with each format, within
# the limits below, which prj.conf sets.

menu "Remote audio server"

config AUD_REMOTE_SAMPLE_RATE
	int "Sample rate, in Hz"
	default 16000
	help
	  Rate of the PCM blocks the Cortex-M33 sends. It must be one of the
	  AUDIO_SAMPLE_RATE_* rates of zephyr/audio/audio_caps.h, written in
	  decimal: the server pastes it into that macro name.

config AUD_REMOTE_FRAME_INTERVAL_US
	int "Duration of one audio block, in microseconds"
	default 16000
	help
	  Each block holds AUD_REMOTE_SAMPLE_RATE x this interval samples.
	  With fft or ifft, that count is the FFT length and must be a power
	  of two.

config AUD_REMOTE_PCM_BIT_WIDTH
	int "PCM sample width, in bits"
	default 32
	help
	  Width of one PCM sample of one channel. The functions process
	  32-bit samples only, the width the MICFIL driver of the Cortex-M33
	  produces; the build fails for any other value.

config AUD_REMOTE_MAX_CHANNELS
	int "Most channels of a block"
	default 2
	range 1 2
	help
	  The PCM and FFT formats take 1 to this many channels. ifft writes
	  its output as stereo, so it needs 2.

config AUD_REMOTE_MIN_BLOCK_SAMPLES
	int "Fewest samples of one channel in a block"
	default 4
	range 4 AUD_REMOTE_MAX_BLOCK_SAMPLES
	help
	  Shortest block the server takes. With the sample rate, it gives the
	  shortest frame interval the server advertises. 4 is the shortest
	  block the FFT takes. The server refuses any block that does not
	  hold a power of two samples, whatever the function.

config AUD_REMOTE_MAX_BLOCK_SAMPLES
	int "Most samples of one channel in a block"
	default 1024
	range 4 4096
	help
	  Longest block the server takes, and the longest FFT. It must be a
	  power of two. Every input and output buffer is sized for a block
	  of this many samples of AUD_REMOTE_MAX_CHANNELS channels, and each
	  fft or ifft instance has work memory of 8 bytes per sample, so the
	  memory of the server grows with this value.

config AUD_REMOTE_BUF_ALIGN
	int "Buffer alignment, in bytes"
	default DCACHE_LINE_SIZE if DCACHE
	default 64
	help
	  Alignment and size granularity of the input and output buffers.
	  The buffers are flushed and invalidated by cache line, so this
	  must be a power of two and a multiple of DCACHE_LINE_SIZE: a
	  buffer that shares a line with other data loses the writes made
	  to that data when the buffer is invalidated.

config AUD_REMOTE_LOG_BUF_SIZE
	int "Log buffer size, in bytes"
	default 2048
	range 256 65536
	help
	  The server keeps its log lines in a buffer of this size until the
	  Cortex-M33 reads them with aud_log_read_rpc. A line that does not
	  fit is dropped and counted; the Cortex-M33 prints the count. It
	  must be a power of two.

config AUD_REMOTE_FUNC_GAIN
	bool "Gain function"
	help
	  Scale each 32-bit PCM sample of every channel by
	  AUD_REMOTE_GAIN_PERCENT, clamped to the 32-bit range.

config AUD_REMOTE_GAIN_PERCENT
	int "Gain, in percent"
	depends on AUD_REMOTE_FUNC_GAIN
	default 100
	range 0 10000

config AUD_REMOTE_FUNC_FFT
	bool "FFT function"
	help
	  Turn each channel of a PCM block into its complex spectrum
	  (MPIPE_MEDIA_AUDIO_FFT): a radix-2 float FFT of one block, with no
	  window and no overlap.

config AUD_REMOTE_FUNC_IFFT
	bool "Inverse FFT function"
	help
	  Turn the spectra of a block back into a 32-bit stereo PCM block:
	  each channel to its own side, or a single channel to both.

endmenu

source "Kconfig.zephyr"
```

## samples/subsys/mpipe/cam_disp_dt/boards/mimxrt700_evk_mimxrt798s_cm33_cpu0.conf
```kconfig
CONFIG_DCACHE=n
CONFIG_VIDEO_BUFFER_POOL_NUM_MAX=3
CONFIG_VIDEO_BUFFER_POOL_HEAP_SIZE=307200
```

## samples/subsys/mpipe/jpeg_dec_multicore/Kconfig
```kconfig
# Copyright 2026 NXP
# SPDX-License-Identifier: Apache-2.0

mainmenu "Multi-core MJPEG decode pipeline described in the devicetree"

config SAMPLE_INCLUDE_REMOTE_DIR
	bool "Include remote core header directory"
	help
	  Include remote build header files. Can be used if primary image
	  needs to be aware of size or base address of secondary image

source "Kconfig.zephyr"
```

## samples/subsys/mpipe/nn_classify_dt/Kconfig
```kconfig
# Copyright 2026 NXP
#
# SPDX-License-Identifier: Apache-2.0

mainmenu "Live classification pipeline described in the devicetree"

config SAMPLE_NN_ARENA_SIZE
	int "Tensor arena size in bytes"
	default 140000
	help
	  Working memory handed to the inference backend; 136 KiB fits the
	  stock person detection model.

source "Kconfig.zephyr"
```

## samples/subsys/mpipe/nn_detect_dt/Kconfig
```kconfig
# Copyright 2026 NXP
#
# SPDX-License-Identifier: Apache-2.0

mainmenu "Live detection pipeline described in the devicetree"

config SAMPLE_NN_ARENA_SIZE
	int "Tensor arena size in bytes"
	default 320000
	help
	  Working memory handed to the inference backend, which logs how much
	  a model uses at load. The 128x128 Ultraface model needs 310 KB on
	  the CPU, the 320x240 one 1.3 MB, or 1.2 MB on the Neutron NPU.

config SAMPLE_NN_NPU_REGION_NAME
	string "Memory region for the model and its arena on an NPU"
	default "SRAM1"
	depends on TFLM_NXP_NEUTRON
	help
	  Name of a zephyr,memory-region devicetree node the Neutron NPU can
	  reach: the model is copied there at start-up and the arena placed
	  there, both being read by the NPU in place.

source "Kconfig.zephyr"
```

## subsys/mpipe/aud/Kconfig
```kconfig
#
# Copyright 2025 NXP
#
# SPDX-License-Identifier: Apache-2.0
#

config MPIPE_AUD
	bool "Audio plugin support"
	select AUDIO
	help
	  Elements that capture, process and play back PCM audio: a digital
	  microphone source, a gain transform, and a sink driving an audio codec
	  over I2S.

	  They sit on Zephyr's audio APIs and describe what they carry as a
	  sample rate, a sample width, a channel count and the layout of those
	  channels within a buffer.

if MPIPE_AUD

config MPIPE_AUD_BUFFER_POOL_SZ_MAX
	int "Size of the largest buffer in the buffer pool"
	default 98304
	help
	  Size in bytes of the largest buffer the audio pool can hand out. It
	  bounds one block of PCM, so it follows from the sample rate, the sample
	  width, the channel count and how much time one buffer covers.

	  The default holds roughly half a second of 48 kHz 16-bit stereo, or a
	  full second of the same in mono. Reserved
	  memory, so lower it when the pipeline's format is known and smaller.

config MPIPE_AUD_BUFFER_POOL_NUM_MAX
	int "Number of maximum sized buffers in the buffer pool"
	default 10
	help
	  Upper bound on how many buffers the audio pool provides. Negotiation
	  settles the number actually used, and this caps what it may ask for.
	  It reports the count it needed when this bound refuses it.

	  Size it for the sum of every concurrent holder, not the largest one: the
	  capture device, whatever the sink keeps queued, and one buffer in transit
	  on the pipeline thread all come out of this pool at the same time.

	  Audio needs more slack than video: a codec starved of data produces an
	  audible artifact rather than a dropped frame, so leave enough for the
	  sink to keep its buffers primed.

config MPIPE_AUD_BUFFER_POOL_CLIENT_NUM_MAX
	int "Maximum number of remote buffers per audio transform client pool"
	default 4
	range 1 255
	depends on MPIPE_RPC
	help
	  Upper bound on how many buffers of the remote core one pad of an
	  audio transform client can hand out. The remote chooses the count;
	  the client fails to initialize when the remote has more than this.

	  Only the buffer addresses are kept on this core, so each one costs a
	  few bytes here: the buffers themselves live on the remote core.

config MPIPE_AUD_I2S_CODEC_SINK_SET_OUTPUT_VOLUME
	bool "Set codec output volume in the I2S codec sink"
	help
	  When enabled, the I2S codec sink programs the codec output volume
	  after configuring it. Without this, the codec keeps its driver
	  default (typically 0 dB / unity), which can overdrive the analog
	  output stage and sound distorted on boards with a fixed line/speaker
	  amplifier.

config MPIPE_AUD_I2S_CODEC_SINK_OUTPUT_VOLUME
	int "Codec output volume (codec-specific units)"
	default 106
	depends on MPIPE_AUD_I2S_CODEC_SINK_SET_OUTPUT_VOLUME
	help
	  Output volume value passed to audio_codec_set_property() as the
	  AUDIO_PROPERTY_OUTPUT_VOLUME for AUDIO_CHANNEL_ALL. The units are
	  codec specific. For the WM8962 the field is 7 bits where 121 (0x79)
	  is 0 dB, each step is 1 dB and values up to and including 47 (0x2F)
	  mute the output. The default of 106 is approximately -15 dB.

config MPIPE_AUD_REMOTE_LOG
	bool "Print the log of the remote audio server"
	default y
	depends on MPIPE_ERPC
	help
	  The remote audio server keeps its log lines in a buffer of its own
	  instead of writing them to a console. The eRPC audio transform
	  client reads them back after each control call, and once when it
	  binds, and prints each line at its level in log module
	  mpipe_aud_remote. The processing call is not followed by a read.

	  The remote must serve the MpipeAudLog interface of
	  mpipe_aud_transform.erpc.

config MPIPE_AUD_REMOTE_LOG_POLL_MS
	int "Period of the remote log reads while streaming (in milliseconds)"
	default 0
	depends on MPIPE_AUD_REMOTE_LOG
	help
	  When not 0, the client also reads the log of the remote every this
	  many milliseconds, on the system work queue, for what the remote
	  logs between control calls. Each read takes the RPC lock, so it
	  delays the processing call of a block that is waiting for it.

endif # MPIPE_AUD
```

## subsys/mpipe/erpc/Kconfig
```kconfig
#
# Copyright 2026 NXP
#
# SPDX-License-Identifier: Apache-2.0
#

config MPIPE_ERPC
	bool "eRPC backend for the client elements"
	default y if DT_HAS_ZEPHYR_MPIPE_ERPC_CHANNEL_ENABLED
	depends on MPIPE_RPC
	depends on ZEPHYR_ERPC_MODULE
	help
	  Provide the RPC channels of the client elements over eRPC, with the
	  Zephyr IPC service as the transport.

	  Each client element has a channel of its own, so a pipeline can hold
	  several client elements of the same kind, on one endpoint each or
	  sharing one. The eRPC objects are static: no channel takes memory
	  from the heap when eRPC uses its static allocation policy
	  (ERPC_ALLOCATION_POLICY_STATIC).

	  The interface definitions are compiled at build time by the erpcgen
	  host tool.

	  The library and its transport are the module's own options, ERPC
	  and ERPC_TRANSPORT_IPC_SERVICE: the application enables both.

if MPIPE_ERPC

config MPIPE_ERPC_CHANNELS_NUM
	int "Number of eRPC channels"
	default 1
	range 1 255
	help
	  Number of client elements that can have an eRPC channel.

config MPIPE_ERPC_ENDPOINTS_NUM
	int "Number of eRPC endpoints of the channels"
	default MPIPE_ERPC_CHANNELS_NUM
	range 1 MPIPE_ERPC_CHANNELS_NUM
	help
	  Number of IPC service endpoints the channels use. Channels that name
	  the same endpoint share one eRPC client and one server on the other
	  core. With the static allocation policy of eRPC, ERPC_CODEC_COUNT
	  must be at least this number.

config MPIPE_ERPC_INIT_DELAY_MS
	int "Delay before the first exchange with the remote core (in milliseconds)"
	default 300
	help
	  Time a channel waits before it talks to the remote core,
	  which may still be booting when the pipeline is built.

endif # MPIPE_ERPC

config MPIPE_ERPC_SERVER
	bool "eRPC binding of the pipeline server"
	depends on MPIPE_PIPELINE_SERVER
	depends on ZEPHYR_ERPC_MODULE
	help
	  Receive the calls of the client elements of another core over eRPC,
	  with the Zephyr IPC service as the transport, and answer them with a
	  pipeline server. This is the server side of the channels the eRPC
	  backend of the client elements (MPIPE_ERPC) provides. A plugin adds
	  the calls of its media type.

	  The library and its transport are the module's own options, ERPC
	  and ERPC_TRANSPORT_IPC_SERVICE: the application enables both.

config MPIPE_ERPC_SERVERS_NUM
	int "Number of eRPC pipeline servers"
	default 1
	range 1 255
	depends on MPIPE_ERPC_SERVER
	help
	  Number of pipelines that can be served over eRPC, each on an
	  endpoint of its own. With the static allocation policy of eRPC,
	  ERPC_CODEC_COUNT must be at least this number.

config MPIPE_ERPC_SERVER_PRODUCE_TIMEOUT_MS
	int "Time a served source is waited for (in milliseconds)"
	default 50
	range 1 10000
	depends on MPIPE_ERPC_SERVER
	help
	  How long the server waits for the next buffer of a pipeline that
	  has a source of its own before it tells the source client that
	  nothing came. The client then asks again. The other client elements
	  of the endpoint wait during that time, and so does a stop.

config MPIPE_ERPC_VID
	bool "eRPC channels for the video client elements"
	default y
	depends on MPIPE_ERPC && MPIPE_VID
	help
	  Carry the format calls of the video client elements over their eRPC
	  channels.

config MPIPE_ERPC_VID_SERVER
	bool "eRPC binding of the video pipeline server"
	depends on MPIPE_ERPC_SERVER && MPIPE_VID_PIPELINE_SERVER
	help
	  Answer the format calls of the video client elements of another
	  core over eRPC with a pipeline server: the video side of the eRPC
	  binding of the pipeline server (MPIPE_ERPC_SERVER).
```
