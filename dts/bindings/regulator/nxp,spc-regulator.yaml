## dts/bindings/regulator/nxp,spc-regulator.yaml
```yaml
# Copyright 2025 NXP
# SPDX-License-Identifier: Apache-2.0

description: NXP SPC regulator

compatible: "nxp,spc-regulator"

include:
  - name: regulator.yaml
    property-allowlist:
      - regulator-boot-on
```

## dts/bindings/rtc/nxp,imx-rtc.yaml
```yaml
# Copyright (c) 2022, Kumar Gala <galak@kernel.org>
# SPDX-License-Identifier: Apache-2.0

description: NXP IMX RTC

compatible: "nxp,imx-rtc"

include: rtc.yaml

properties:
  reg:
    required: true
```

## dts/bindings/sensor/nxp,pmc-tmpsns.yaml
```yaml
# Copyright NXP 2025
# SPDX-License-Identifier: Apache-2.0

description: NXP PMC temperature sensor (PMC-TMPSNS)

compatible: "nxp,pmc-tmpsns"

include: sensor-device.yaml

properties:
  io-channels:
    required: true
    description: |
      This should point to an ADC channel (e.g., <&adc0 0>)
      to read from the PMC internal temperature sensor.

  nxp,otp:
    type: phandle
    required: true
    description: |
      Phandle to the OTP controller device used for reading
      calibration data from fuses.
```

## dts/bindings/timer/cortex-m-systick.yaml
```yaml
# Copyright (c) 2023 MUNIC SA
# SPDX-License-Identifier: Apache-2.0

# Common fields for SysTick of ARM Cortex-M chips
include: base.yaml

properties:
  reg:
    required: true

  clock-source:
    type: int
    default: 1
    enum:
      - 0
      - 1
    description: |
      Selects the SysTick clock source.

      - 0: External/reference clock (CLKSOURCE bit cleared)
      - 1: Processor/core clock (CLKSOURCE bit set)
```

## dts/bindings/timer/nxp,lptmr-timer.yaml
```yaml
# Copyright 2026 NXP
# SPDX-License-Identifier: Apache-2.0

description: |
  NXP Low Power Timer (LPTMR) used as the Zephyr system tick / tickless timer.

  This binding is dedicated to the system-timer role. For counter (alarm/capture)
  usage, see dts/bindings/counter/nxp,lptmr.yaml (compatible "nxp,lptmr").

compatible: "nxp,lptmr-timer"

include: base.yaml

properties:
  reg:
    required: true

  interrupts:
    required: true

  clock-frequency:
    type: int
    required: true
    description: |
      Timer input clock frequency in Hz. Used by the SoC Kconfig.defconfig to
      set SYS_CLOCK_HW_CYCLES_PER_SEC when this driver is selected.

  clk-source:
    type: int
    required: true
    enum: [0, 1, 2, 3]
    description: |
      Selects the clock to be used by the LPTMR prescaler/glitch filter.
      In Time Counter mode this field selects the input clock to the prescaler.
      The clock connections vary by device; see the device reference manual for
      details.

  resolution:
    type: int
    required: true
    description: Counter width in bits (typically 16 or 32).

  prescale-glitch-filter-bypass:
    type: boolean
    description: |
      When present, the prescaler/glitch filter is bypassed and the selected
      clk-source directly clocks the counter register (CNR).

  prescale-glitch-filter:
    type: int
    default: 0
    enum: [0, 1, 2, 3, 4, 5, 6, 7, 8, 9, 10, 11, 12, 13, 14, 15]
    description: |
      Prescaler divisor selection. The counter is clocked at
      clk-source / 2^(prescale-glitch-filter + 1).
      Ignored when prescale-glitch-filter-bypass is set.
```

## dts/bindings/usb/zephyr,cdc-ecm-host.yaml
```yaml
# Copyright 2025 NXP
# SPDX-License-Identifier: Apache-2.0

description: |
  USB Mass Storage Class (MSC) host instance.

  Each MSC instance added to the USB Host Controller (UHC) node will be visible
  as a new storage device from the host point of view.

compatible: "zephyr,cdc-ecm-host"

include: base.yaml
```

## dts/bindings/usb/zephyr,msc-host.yaml
```yaml
# Copyright 2025 NXP
# SPDX-License-Identifier: Apache-2.0

description: |
  USB Mass Storage Class (MSC) host instance.

  Each MSC instance added to the USB Host Controller (UHC) node will be visible
  as a new storage device from the host point of view.

compatible: "zephyr,msc-host"

include: base.yaml
```

## dts/bindings/video/aptina,mt9m114.yaml
```yaml
# Copyright (c) 2019, Linaro Limited
# SPDX-License-Identifier: Apache-2.0

description: MT9M114 CMOS video sensor

compatible: "aptina,mt9m114"

include: [i2c-device.yaml, pinctrl-device.yaml]

properties:
  regulators:
    type: phandles
    required: true

  powerdown-gpios:
    type: phandle-array
    required: true
    description:
      power down gpio. Driver will initialize this GPIO to active high

  reset-gpios:
    type: phandle-array
    required: true
    description:
      reset gpio. Driver will initialize this GPIO to active low
```

## dts/bindings/video/nxp,imx-isi.yaml
```yaml
# Copyright 2026 NXP
# SPDX-License-Identifier: Apache-2.0

description: NXP i.MX Image Sensing Interface (ISI)

compatible: "nxp,imx-isi"

include: [base.yaml, pinctrl-device.yaml]

properties:
  reg:
    required: true

  interrupts:
    required: true

  input-port:
    type: int
    default: 0
    description: ISI input port number

child-binding:
  child-binding:
    child-binding:
      include: video-interfaces.yaml
```

## dts/bindings/video/nxp,imx93-parallel-csi.yaml
```yaml
#
# Copyright (c) 2023, NXP
#
# SPDX-License-Identifier: Apache-2.0
#

description: NXP MCUX i.MX93 Parallel CSI

compatible: "nxp,imx93-parallel-csi"

include: [base.yaml]

properties:
  sensor:
    required: true
    type: phandle
    description: phandle of connected sensor device
```

## dts/bindings/video/onnn,ap1302.yaml
```yaml
# Copyright 2026 NXP
# SPDX-License-Identifier: Apache-2.0

description: |
  ONNN AP1302 Camera ISP.

  Note: This device requires a firmware binary blob provided by ON Semiconductor.
  The firmware is NOT distributed as part of Zephyr. Users must download it
  separately from https://github.com/ONSemiconductor/ap1302_binaries and ensure
  they comply with the "AP1302 Software License Agreement".

compatible: "onnn,ap1302"

include: [i2c-device.yaml, pinctrl-device.yaml]

child-binding:
  include: video-interfaces.yaml

  properties:
    bus-type:
      required: true

    data-lanes:
      required: true

examples:
  - |
    #include <zephyr/dt-bindings/gpio/gpio.h>

    /* Example of storing the firmware in a fixed flash partition */
    &flash0 {
        partitions {
            compatible = "fixed-partitions";
            #address-cells = <1>;
            #size-cells = <1>;

            ap1302_fw_part: partition@100000 {
                label = "ap1302_fw";
                reg = <0x00100000 0x00040000>;
            };
        };
    };

    ap1302: ap1302@3c {
        compatible = "onnn,ap1302";
        reg = <0x3c>;
        reset-gpios = <&gpio1 10 GPIO_ACTIVE_LOW>;
        isp-en-gpios = <&gpio1 11 GPIO_ACTIVE_HIGH>;
        standby-gpios = <&gpio1 12 GPIO_ACTIVE_HIGH>;
        power-supplies = <&vddio &vdda>;
        mipi-data-lanes = <2>;
        firmware-partition = <&ap1302_fw_part>;

        port {
            ap1302_ep_out: endpoint {
                remote-endpoint-label = "csi2rx_ep_in";
                bus-type = <4>; /* MIPI CSI-2 D-PHY */
                data-lanes = <1 2>;
            };
        };
    };

properties:
  reset-gpios:
    type: phandle-array
    required: true
    description: GPIO connected to reset pin

  isp-en-gpios:
    type: phandle-array
    required: true
    description: GPIO isp enable pin

  standby-gpios:
    type: phandle-array
    required: false
    description: GPIO connected to standby pin

  power-supplies:
    type: phandles
    required: false
    description: Power supply regulators in sequence

  firmware-partition:
    type: phandle
    required: true
    description: |
      Phandle to a devicetree node that describes where the AP1302 firmware blob
      is stored, via its `reg` property.

      This can point to a `fixed-partitions` partition node (flash storage) or a
      `reserved-memory` region (e.g. firmware preloaded in DDR).

  mipi-data-lanes:
    type: int
    required: true
    description: Number of MIPI CSI-2 data lanes (1-4)


  clocks:
    type: phandle-array
    required: false
    description: Clock phandle for MCLK

  clock-names:
    type: string-array
    required: false
    description: Clock names
```

## lib/libmp/Kconfig
```kconfig
#
# Copyright 2025 NXP
#
# SPDX-License-Identifier: Apache-2.0
#

menuconfig MP
    bool "Media Pipe library"
    select NET_BUF
    help
        Enable Media Pipe library.

if MP

module = LIBMP
module-str = libmp
source "subsys/logging/Kconfig.template.log_config"

config MP_RPC
    bool "RPC support"

# Load core configurations
source "lib/libmp/src/core/Kconfig"

# Load all plugin configurations
source "lib/libmp/src/plugins/Kconfig"

endif # MP
```

## lib/libmp/src/core/Kconfig
```kconfig
#
# Copyright 2025 NXP
#
# SPDX-License-Identifier: Apache-2.0
#

config MP_THREADS_NUM
    int "Maximum number of threads"
    range 0 255
    default 3

config MP_THREAD_STACK_SIZE
    int "Stack size of a thread"
    default 1024

config MP_THREAD_DEFAULT_PRIORITY
    int "Priority of a thread"
    default 5

config MP_CAPSFILTER
    bool "Capsfilter support"

config MP_NET_BUF_POOL_COUNT
    int "Number of buffers can be handled at the same time for the whole pipeline"
    default 1
```

## lib/libmp/src/plugins/zvid/Kconfig
```kconfig
#
# Copyright 2025 NXP
#
# SPDX-License-Identifier: Apache-2.0
#

config MP_PLUGIN_ZVID
    bool "Video plugin support"
    depends on MP
    select VIDEO
```

## modules/hal_nxp/Kconfig
```kconfig
#
# Copyright (c) 2021 Linaro, Limited
# Copyright 2025 NXP
#
# SPDX-License-Identifier: Apache-2.0
#

config MCUX_ACMP
	bool "Include ACMP driver from MCUX SDK"

rsource "psa_crypto_hse/Kconfig.nxp_s32"
```

## modules/hal_nxp/psa_crypto_hse/Kconfig.nxp_s32
```kconfig
# Copyright NXP 2025
# SPDX-License-Identifier: Apache-2.0

config PSA_CRYPTO_HSE_DRIVER
	bool "PSA Crypto driver on HSE"
	default y if MBEDTLS_PSA_CRYPTO_CLIENT
	imply MBEDTLS_HAVE_TIME_DATE
	help
	  Enable to use PSA Crypto driver on HSE
```

## samples/bluetooth/opendroneid/sample.yaml
```yaml
sample:
  name: Bluetooth ODID
tests:
  sample.bluetooth.opendroneid:
    harness: bluetooth
    platform_allow:
      - kw45b41z_evk
    tags: bluetooth
```

## samples/bluetooth/peripheral_ets/sample.yaml
```yaml
sample:
  name: Bluetooth Peripheral ETS
  description: Demonstrates the ETS (Elapsed Time Service) GATT Service
tests:
  sample.bluetooth.peripheral_ets:
    harness: bluetooth
    platform_allow:
      - qemu_cortex_m3
      - qemu_x86
    tags: bluetooth
    integration_platforms:
      - qemu_cortex_m3
  sample.bluetooth.peripheral_ets.rw612:
    harness: bluetooth
    platform_allow:
      - frdm_rw612
    tags: bluetooth
    extra_args: CONFIG_BUILD_ONLY_NO_BLOBS=y
  sample.bluetooth.peripheral_ets.local_time:
    harness: bluetooth
    platform_allow:
      - qemu_cortex_m3
      - qemu_x86
    integration_platforms:
      - qemu_cortex_m3
    extra_args: EXTRA_CONF_FILE=overlay-local-time.conf
    tags: bluetooth
  sample.bluetooth.peripheral_ets.local_time.rw612:
    harness: bluetooth
    platform_allow:
      - frdm_rw612
    extra_args:
      - EXTRA_CONF_FILE=overlay-local-time.conf
      - CONFIG_BUILD_ONLY_NO_BLOBS=y
    tags: bluetooth
```

## samples/boards/nxp/frdm_rw612/button_pm3/sample.yaml
```yaml
#
# Copyright 2025 NXP
#
# SPDX-License-Identifier: Apache-2.0
#
sample:
  name: Button sample for PM3 mode on RW61x
common:
  tags: power
tests:
  sample.boards.frdm_rw612.button_pm3:
    build_only: true
    platform_allow: frdm_rw612
```

## samples/boards/nxp/mcx/mcxa/poweroff/Kconfig
```kconfig
# Copyright 2025 NXP
# SPDX-License-Identifier: Apache-2.0

mainmenu "NXP MCXA SERIES POWER OFF DEMO"

source "Kconfig.zephyr"
```

## samples/boards/nxp/mcx/mcxa/poweroff/sample.yaml
```yaml
# Copyright 2025 NXP
# SPDX-License-Identifier: Apache-2.0

sample:
  name: Poweroff demo for NXP MCXA series
common:
  tags: power
tests:
  sample.boards.nxp.mcx.mcxa.poweroff:
    platform_allow:
    - frdm_mcxa156
    - frdm_mcxa153
    - frdm_mcxa166
    - frdm_mcxa276
```

## samples/boards/nxp/mcx/mcxn/poweroff/Kconfig
```kconfig
# Copyright 2025 NXP
# SPDX-License-Identifier: Apache-2.0

mainmenu "NXP MCXN SERIES POWER OFF DEMO"

source "Kconfig.zephyr"
```

## samples/boards/nxp/mcx/mcxn/poweroff/sample.yaml
```yaml
# Copyright 2025 NXP
#
# SPDX-License-Identifier: Apache-2.0

sample:
  name: Poweroff demo for NXP MCXN series
common:
  tags: power
tests:
  sample.boards.nxp.mcx.mcxn.poweroff:
    platform_allow:
    - frdm_mcxn236/mcxn236
    - frdm_mcxn947/mcxn947/cpu0
```

## samples/drivers/display/boards/mimxrt1060_evk.conf
```kconfig
#
# Copyright 2026 NXP
#
# SPDX-License-Identifier: Apache-2.0
#

# elcdif requires 8-byte alignment for the rendering buffer address
CONFIG_SAMPLE_BUFFER_ADDR_ALIGN=8
```

## samples/drivers/i2s/i2s_codec/boards/rd_rw612_bga.conf
```kconfig
#
# Copyright 2025 NXP
#
# SPDX-License-Identifier: Apache-2.0
#

CONFIG_DMA=y
CONFIG_USE_DMIC=y

CONFIG_CODEC_MASTER=y
CONFIG_I2S_MASTER=n
```
