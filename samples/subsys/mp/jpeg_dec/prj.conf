## CMakeLists.txt
```
# SPDX-License-Identifier: Apache-2.0

cmake_minimum_required(VERSION 3.20.0)
find_package(Zephyr REQUIRED HINTS $ENV{ZEPHYR_BASE})
project(jpeg_pipeline)

FILE(GLOB app_sources src/*.c)
target_sources(app PRIVATE ${app_sources})

# Generate MJPEG file to test using GStreamer CLI
find_program(GST_LAUNCH gst-launch-1.0 REQUIRED)

set(TEST_MJPEG_FILE ${ZEPHYR_BINARY_DIR}/include/generated/test.mjpeg)

add_custom_command(
    OUTPUT ${TEST_MJPEG_FILE}
    COMMAND ${GST_LAUNCH}
        videotestsrc num-buffers=${CONFIG_MJPEG_NUM_FRAMES}
        ! "video/x-raw,width=${CONFIG_JPEG_IMAGE_WIDTH},height=${CONFIG_JPEG_IMAGE_HEIGHT}"
        ! jpegenc
        ! filesink location=${TEST_MJPEG_FILE}
    COMMENT "Generating test.mjpeg (${CONFIG_JPEG_IMAGE_WIDTH}x${CONFIG_JPEG_IMAGE_HEIGHT}, ${CONFIG_MJPEG_NUM_FRAMES} frames) using GStreamer"
)

add_custom_target(gen_test_mjpeg DEPENDS ${TEST_MJPEG_FILE})

generate_inc_file_for_target(app
    ${TEST_MJPEG_FILE}
    ${ZEPHYR_BINARY_DIR}/include/generated/mjpeg.inc
)

add_dependencies(app gen_test_mjpeg)
```

## Kconfig
```
# Copyright 2026 NXP
# SPDX-License-Identifier: Apache-2.0

mainmenu "MJPEG decode pipeline"

menu "Pipeline configuration"

config FILE_INPUT_PATH
	string "Input MJPEG file path"
	default "/SD:/test.mjpeg"
	help
	  Absolute path to the MJPEG input file.

config JPEG_PIX_FMT
	string "Pixel format of the decoded image"
	default "NV12"

config JPEG_IMAGE_WIDTH
	int "Width of the decoded image"
	default 320

config JPEG_IMAGE_HEIGHT
	int "Height of the decoded image"
	default 240

config VIDEO_ROTATION_ANGLE
	int "Rotate the decoded frame by a specified angle"
	range 0 270
	default 0
	help
	  Specify one of these values {0, 90, 180, 270} in degree to rotate the video frame.
	  Only applies when a zephyr,videotrans device is present.

endmenu

source "Kconfig.zephyr"
```

## sample.yaml
```
sample:
  name: MJPEG file decode pipeline

tests:
  sample.mp.mjpeg.decode:
    tags:
      - mp
      - video
      - filesystem
    platform_allow:
      - native_sim/native/64
      - mimxrt700_evk/mimxrt798s/cm33_cpu0
      - mimxrt1170_evk@B/mimxrt1176/cm7
    integration_platforms:
      - native_sim/native/64
      - mimxrt700_evk/mimxrt798s/cm33_cpu0
      - mimxrt1170_evk@B/mimxrt1176/cm7
    harness: console
    extra_args:
      - platform:mimxrt700_evk/mimxrt798s/cm33_cpu0:SHIELD="rk055hdmipi4ma0"
      - platform:mimxrt1170_evk@B/mimxrt1176/cm7:SHIELD="rk055hdmipi4ma0"
    harness_config:
      type: one_line
      regex:
        - "EOS message from element"
```

## prj.conf
```kconfig
CONFIG_LOG=y

# main() mounts the filesystem and writes the input file before starting the
# pipeline, which the default main stack does not cover.
CONFIG_MAIN_STACK_SIZE=2048

CONFIG_MP=y

# Size one caps structure for the widest union that can meet in one
# intersection, not for what a single element sets.
# The widest capability here is {pixel format, width, height}.
CONFIG_MP_STRUCTURE_MAX_FIELDS=3
CONFIG_MP_BASE=y
CONFIG_MP_BASE_CAPSFILTER=y
CONFIG_MP_FS=y
CONFIG_MP_IMG=y
CONFIG_MP_DISP=y
CONFIG_MP_PLAYER=y

# At the parser, we need simultaneously 1 input + 1 output + 1 partial (for next frame) buffers
CONFIG_MP_NET_BUF_POOL_COUNT=3
# Largest estimated size for 320x240 JPEG image
CONFIG_MP_IMG_JPEG_PARSER_MAX_FRAME_SIZE=153600

CONFIG_FILE_SYSTEM=y
CONFIG_FAT_FILESYSTEM_ELM=y
CONFIG_FS_FATFS_LFN=y
CONFIG_FS_FATFS_MAX_LFN=255
CONFIG_DISK_ACCESS=y
CONFIG_DISK_DRIVERS=y
```

## boards/mimxrt1170_evk_mimxrt1176_cm7.conf
```kconfig
CONFIG_VIDEO_BUFFER_POOL_NUM_MAX=2
CONFIG_VIDEO_BUFFER_POOL_HEAP_SIZE=307600
CONFIG_VIDEO_ROTATION_ANGLE=90

CONFIG_MP_PLUGIN_ZVID=y
CONFIG_MP_PLUGIN_ZVID_CONVERT=y
```

## boards/mimxrt700_evk_mimxrt798s_cm33_cpu0.conf
```kconfig
CONFIG_DCACHE=n
# 3 (jpeg decoder: 2 input + 1 output) + 1 (video converter output)
CONFIG_VIDEO_BUFFER_POOL_NUM_MAX=4
# Resolution: 320x240, Format: NV12 + RGB565 + 2 * JPEG + alignment = 320 * 240 * (1.5 + 2 + 2 * 2) + alignment
CONFIG_VIDEO_BUFFER_POOL_HEAP_SIZE=580000
CONFIG_VIDEO_BUFFER_POOL_ZEPHYR_REGION=y
CONFIG_VIDEO_BUFFER_POOL_ZEPHYR_REGION_NAME="SRAM1"

CONFIG_MP_PLUGIN_ZVID=y
CONFIG_MP_PLUGIN_ZVID_CONVERT=y
```

## boards/native_sim_64.conf
```kconfig
# Flash-backed FAT volume (disk-name "SD") for native_sim
CONFIG_FLASH_SIMULATOR=y
CONFIG_DISK_DRIVER_FLASH=y

# Bind the native PTY UART to stdin/stdout so the shell reads keystrokes typed
# on the launching terminal (otherwise the shell sits on a separate PTY and the
# p/s/r/q commands never receive input).
CONFIG_UART_NATIVE_PTY_0_ON_STDINOUT=y

# Log directly to stdout via the native backend, which is active from boot so
# the boot banner and early log lines (before the shell is up) are printed.
# Disable the shell log backend so those same lines are not printed a second
# time once the shell starts.
CONFIG_LOG_BACKEND_NATIVE_POSIX=y
CONFIG_SHELL_LOG_BACKEND=n

CONFIG_HEAP_MEM_POOL_SIZE=5500
```

## src/main.c
```c
/*
 * Copyright 2026 NXP
 *
 * SPDX-License-Identifier: Apache-2.0
 */

#include <errno.h>
#if defined(CONFIG_FAT_FILESYSTEM_ELM)
#include <ff.h>
#endif

#include <zephyr/drivers/video.h>
#include <zephyr/video/controls.h>
#include <zephyr/fs/fs.h>
#include <zephyr/logging/log.h>

#include <zephyr/mp/mp.h>
#include <zephyr/mp/base/mp_capsfilter.h>
#include <zephyr/mp/disp/mp_disp_sink.h>
#include <zephyr/mp/fs/mp_filesrc.h>
#include <zephyr/mp/img/mp_img_jpeg_decoder.h>
#include <zephyr/mp/img/mp_img_jpeg_parser.h>
#include <zephyr/mp/utils/mp_player.h>
#if DT_HAS_CHOSEN(zephyr_jpegdec) || DT_HAS_CHOSEN(zephyr_videotrans)
#include <zephyr/mp/vid/mp_vid_transform.h>
#endif
#if DT_HAS_CHOSEN(zephyr_jpegdec)
#include <zephyr/mp/vid/mp_vid_convert.h>
#endif

LOG_MODULE_REGISTER(main, CONFIG_LOG_DEFAULT_LEVEL);

/* Element IDs (values are arbitrary; only uniqueness within the pipeline matters) */
enum {
	PIPE_ID,
	FILE_SRC_ID,
	JPEG_PARSER_ID,
	CAPS_FILTER_ID,
	JPEG_DEC_ID,
	VID_CONV_ID,
	VID_TRANS_ID,
	DISP_SINK_ID,
};

#define MNT_POINT "/SD:"

#if defined(CONFIG_FAT_FILESYSTEM_ELM)
static FATFS fat_fs;
#endif

static struct fs_mount_t mp = {
	.type = FS_FATFS,
#if defined(CONFIG_FAT_FILESYSTEM_ELM)
	.fs_data = &fat_fs,
#endif
	.mnt_point = MNT_POINT,
};

static const uint8_t mjpeg[] = {
#include "mjpeg.inc"
};
static const size_t mjpeg_sz = sizeof(mjpeg);

static int embed_test_file(void)
{
	struct fs_dirent ent;
	int ret = fs_stat(CONFIG_FILE_INPUT_PATH, &ent);

	if (ret == 0) {
		return 0;
	}

	if (ret != -ENOENT) {
		LOG_ERR("fs_stat(%s) failed (%d)", CONFIG_FILE_INPUT_PATH, ret);
		return ret;
	}

	if (mjpeg_sz == 0) {
		LOG_ERR("MJPEG test file not available");
		return -ENOENT;
	}

	struct fs_file_t f;

	fs_file_t_init(&f);

	ret = fs_open(&f, CONFIG_FILE_INPUT_PATH, FS_O_CREATE | FS_O_WRITE);
	if (ret != 0) {
		LOG_ERR("fs_open(%s) failed (%d)", CONFIG_FILE_INPUT_PATH, ret);
		return ret;
	}

	ssize_t w = fs_write(&f, mjpeg, mjpeg_sz);

	if (w < 0 || (size_t)w != mjpeg_sz) {
		LOG_ERR("fs_write failed (%d)", (int)w);
		(void)fs_close(&f);
		return (w < 0) ? (int)w : -EIO;
	}

	(void)fs_close(&f);

	LOG_INF("Created %s file for test (%u bytes)", CONFIG_FILE_INPUT_PATH,
		(unsigned int)mjpeg_sz);

	return 0;
}

static int mount_sd(void)
{
	int ret;

	ret = fs_mount(&mp);
	if (ret != 0) {
		LOG_ERR("fs_mount failed (%d)", ret);
		return ret;
	}

	LOG_INF("SDCard mounted at %s", MNT_POINT);

	ret = embed_test_file();
	if (ret != 0) {
		return ret;
	}

	return 0;
}

static struct mp_pipeline pipe;
static struct mp_filesrc filesrc;
static struct mp_img_jpeg_parser jpeg_parser;
static struct mp_caps_filter caps_filter;
static struct mp_disp_sink disp_sink;
#if DT_HAS_CHOSEN(zephyr_jpegdec)
static struct mp_vid_transform jpeg_dec;
static struct mp_vid_convert vid_conv;
#else
static struct mp_img_jpeg_decoder jpeg_dec;
#endif
#if DT_HAS_CHOSEN(zephyr_videotrans)
static struct mp_vid_transform vid_trans;
#endif
static struct mp_player player;

int main(void)
{
	int ret = mount_sd();

	if (ret != 0) {
		goto err;
	}

	MP_ELEMENT_INIT(&pipe, mp_pipeline_init, PIPE_ID);
	MP_ELEMENT_INIT(&filesrc, mp_filesrc_init, FILE_SRC_ID);
	MP_ELEMENT_INIT(&jpeg_parser, mp_img_jpeg_parser_init, JPEG_PARSER_ID);
	MP_ELEMENT_INIT(&caps_filter, mp_caps_filter_init, CAPS_FILTER_ID);
	MP_ELEMENT_INIT(&disp_sink, mp_disp_sink_init, DISP_SINK_ID);

#if DT_HAS_CHOSEN(zephyr_jpegdec)
	MP_ELEMENT_INIT(&jpeg_dec, mp_vid_transform_init, JPEG_DEC_ID);
	MP_ELEMENT_INIT(&vid_conv, mp_vid_convert_init, VID_CONV_ID);

	ret = mp_object_set_properties((struct mp_object *)&jpeg_dec, MP_PROP_VID_DEVICE,
				       DEVICE_DT_GET_OR_NULL(DT_CHOSEN(zephyr_jpegdec)),
				       MP_PROP_LIST_END);
	if (ret < 0) {
		goto err;
	}
#else
	MP_ELEMENT_INIT(&jpeg_dec, mp_img_jpeg_decoder_init, JPEG_DEC_ID);
#endif
#if DT_HAS_CHOSEN(zephyr_videotrans)
	MP_ELEMENT_INIT(&vid_trans, mp_vid_transform_init, VID_TRANS_ID);
	ret = mp_object_set_properties(
		(struct mp_object *)&vid_trans,
		COND_CODE_0(CONFIG_VIDEO_ROTATION_ANGLE,
			(), (VIDEO_CID_ROTATE, CONFIG_VIDEO_ROTATION_ANGLE,)) MP_PROP_LIST_END);
	if (ret < 0) {
		goto err;
	}
#endif

	ret = mp_object_set_properties((struct mp_object *)&filesrc, MP_PROP_FS_SRC_PATH,
				       CONFIG_FILE_INPUT_PATH, MP_PROP_LIST_END);
	if (ret < 0) {
		goto err;
	}

	{
		struct mp_structure caps;

		ret = mp_structure_init_fields(&caps, MP_MEDIA_VIDEO, MP_CAPS_PIXEL_FORMAT,
					       MP_TYPE_UINT, VIDEO_PIX_FMT_JPEG,
					       MP_CAPS_IMAGE_WIDTH, MP_TYPE_UINT,
					       CONFIG_JPEG_IMAGE_WIDTH, MP_CAPS_IMAGE_HEIGHT,
					       MP_TYPE_UINT, CONFIG_JPEG_IMAGE_HEIGHT, MP_CAPS_END);

		if (ret != 0) {
			goto err;
		}

		ret = mp_object_set_properties((struct mp_object *)&caps_filter,
					       MP_PROP_BASE_CAPSFILTER_CAPS, &caps,
					       MP_PROP_LIST_END);
		if (ret < 0) {
			goto err;
		}
	}

	/* clang-format off */
	ret = mp_bin_add((struct mp_bin *)&pipe,
			(struct mp_element *)&filesrc,
			(struct mp_element *)&jpeg_parser,
			(struct mp_element *)&caps_filter,
			(struct mp_element *)&jpeg_dec,
			IF_ENABLED(DT_HAS_CHOSEN(zephyr_jpegdec), ((struct mp_element *)&vid_conv,))
			IF_ENABLED(DT_HAS_CHOSEN(zephyr_videotrans), ((struct mp_element *)&vid_trans,))
			(struct mp_element *)&disp_sink,
			NULL);
	if (ret < 0) {
		LOG_ERR("Failed to add elements (%d)", ret);
		goto err;
	}

	ret = mp_element_link((struct mp_element *)&filesrc,
			(struct mp_element *)&jpeg_parser,
			(struct mp_element *)&caps_filter,
			(struct mp_element *)&jpeg_dec,
			IF_ENABLED(DT_HAS_CHOSEN(zephyr_jpegdec), ((struct mp_element *)&vid_conv,))
			IF_ENABLED(DT_HAS_CHOSEN(zephyr_videotrans), ((struct mp_element *)&vid_trans,))
			(struct mp_element *)&disp_sink,
			NULL);
	if (ret < 0) {
		LOG_ERR("Failed to link elements (%d)", ret);
		goto err;
	}
	/* clang-format on */

	LOG_INF("Pipeline linked.");

	ret = mp_player_init(&player, &pipe);
	if (ret != 0) {
		LOG_ERR("Failed to init player (%d)", ret);
		goto err;
	}

	(void)mp_player_play(&player);
	(void)mp_player_wait_quit(&player);
	(void)mp_player_deinit(&player);

	ret = fs_unmount(&mp);
	if (ret != 0) {
		LOG_ERR("fs_unmount failed (%d)", ret);
	}

	LOG_INF("Done.");

	return 0;

err:
	LOG_ERR("Aborting sample");
	return 0;
}
```
