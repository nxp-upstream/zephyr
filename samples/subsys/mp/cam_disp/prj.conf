## Kconfig
```
# Copyright (c) 2024 Espressif Systems (Shanghai) Co., Ltd.
# Copyright 2025-2026 NXP
#
# SPDX-License-Identifier: Apache-2.0

mainmenu "Camera to display pipeline sample"

menu "Camera to display pipeline configuration"

config VIDEO_SOURCE_CROP_LEFT
	int "Crop area left value"
	default 0
	help
	   Left value of the crop area within the video source.

config VIDEO_SOURCE_CROP_TOP
	int "Crop area top value"
	default 0
	help
	   Top value of the crop area within the video source.

config VIDEO_SOURCE_CROP_WIDTH
	int "Crop area width value"
	default 0
	help
	   Width value of the crop area within the video source.
	   If set to 0, the crop is not applied.

config VIDEO_SOURCE_CROP_HEIGHT
	int "Crop area height value"
	default 0
	help
	   Height value of the crop area within the video source.
	   If set to 0, the crop is not applied.

config VIDEO_FRAME_HEIGHT
	int "Height of the video frame"
	default 0
	help
	  Height of the video frame. If set to 0, the default height is used.

config VIDEO_FRAME_WIDTH
	int "Width of the video frame"
	default 0
	help
	  Width of the video frame. If set to 0, the default width is used.

config VIDEO_FRAME_RATE
	int "Frame rate of the video stream"
	default 0
	help
	  Frame rate of the video stream. If set to 0, the default frame rate is used.

config VIDEO_PIXEL_FORMAT
	string "Pixel format of the video frame"
	help
	  Pixel format of the video frame. If not set, the default pixel format is used.

config VIDEO_CTRL_HFLIP
	int "Mirror the video frame horizontally"
	range 0 1
	default 0
	help
	  If set, mirror the video frame horizontally

config VIDEO_CTRL_VFLIP
	int "Mirror the video frame vertically"
	range 0 1
	default 0
	help
	  If set, mirror the video frame vertically

config VIDEO_ROTATION_ANGLE
	int "Rotate the video frame by a specified angle"
	range 0 270
	default 0
	help
	   Specify one of these values {0, 90, 180, 270} in degree to rotate the video frame

config MP_PROP_NUM_BUFS
	int "Number of buffers the source provides before stopping"
	default 0
	help
	   If not set or set to 0, the source will run forever

endmenu

source "Kconfig.zephyr"
```

## sample.yaml
```
sample:
  name: Camera to display sample

tests:
  sample.mp.cam_disp:
    tags:
    - video
    - samples
    platform_allow:
    - native_sim/native/64
    - mimxrt1064_evk/mimxrt1064
    - mimxrt1170_evk/mimxrt1176/cm7
    - mimxrt1170_evk@B/mimxrt1176/cm7
    - frdm_mcxn947/mcxn947/cpu0
    - frdm_mcxn236/mcxn236
    - esp32s3_eye/esp32s3/procpu
    - stm32h7b3i_dk
    - ek_ra8d1/r7fa8d1bhecbd
    - mm_swiftio
    - arduino_nicla_vision/stm32h747xx/m7
    integration_platforms:
    - native_sim/native/64
    - mimxrt1064_evk/mimxrt1064
    - mimxrt1170_evk/mimxrt1176/cm7
    extra_args:
    - platform:native_sim/native/64:SNIPPET="video-sw-generator"
    - platform:mimxrt1064_evk/mimxrt1064:SHIELD="dvp_fpc24_mt9m114;rk043fn66hs_ctg"
    - platform:mimxrt1170_evk/mimxrt1176/cm7:SHIELD="nxp_btb44_ov5640;rk055hdmipi4ma0"
    - platform:mimxrt1170_evk@B/mimxrt1176/cm7:SHIELD="nxp_btb44_ov5640;rk055hdmipi4ma0"
    - platform:frdm_mcxn947/mcxn947/cpu0:SHIELD="dvp_20pin_ov7670;lcd_par_s035_8080"
    - platform:frdm_mcxn236/mcxn236:SHIELD="dvp_20pin_ov7670;lcd_par_s035_8080"
    - platform:stm32h7b3i_dk:SHIELD="st_b_cams_omv_mb1683"
    - platform:ek_ra8d1/r7fa8d1bhecbd:SHIELD="dvp_20pin_ov7670;rtkmipilcdb00000be"
    extra_configs:
    - CONFIG_TEST=y
    - CONFIG_MP_PROP_NUM_BUFS=100
    harness: console
    harness_config:
      type: one_line
      regex:
      - "End of stream"
```

## prj.conf
```kconfig
CONFIG_LOG=y

CONFIG_MP=y

# Size one caps structure for the widest union that can meet in one
# intersection, not for what a single element sets.
# The camera adds a frame interval to {pixel format, width, height}.
CONFIG_MP_STRUCTURE_MAX_FIELDS=4
CONFIG_MP_BASE=y
CONFIG_MP_BASE_CAPSFILTER=y
CONFIG_MP_VID=y
CONFIG_MP_DISP=y
CONFIG_MP_PLAYER=y
```

## boards/mimxrt700_evk_mimxrt798s_cm33_cpu0.conf
```kconfig
CONFIG_DCACHE=n

CONFIG_VIDEO_BUFFER_POOL_NUM_MAX=3
CONFIG_VIDEO_BUFFER_POOL_HEAP_SIZE=307200

CONFIG_MP_PLUGIN_ZVID=y
CONFIG_MP_ZVID_CONVERT=y
CONFIG_MP_NET_BUF_POOL_COUNT=3

CONFIG_VIDEO_PIXEL_FORMAT="JPEG"
CONFIG_VIDEO_FRAME_WIDTH=320
CONFIG_VIDEO_FRAME_HEIGHT=160
```

## boards/native_sim_64.conf
```kconfig
CONFIG_VIDEO_FRAME_WIDTH=320
CONFIG_VIDEO_FRAME_HEIGHT=240
CONFIG_MP_BASE_CAPSFILTER=y
CONFIG_PROP_NUM_BUFS=10

# Bind the native PTY UART to stdin/stdout so the shell reads keystrokes typed
# on the launching terminal (otherwise the shell sits on a separate PTY and the
# p/s/r/q commands never receive input).
CONFIG_UART_NATIVE_PTY_0_ON_STDINOUT=y

# Log directly to stdout via the native backend, which is active from boot so
# the boot banner and early log lines (before the shell is up) are printed.
# Disable the shell log backend so those same lines are not printed a second
# time once the shell starts.
CONFIG_LOG_BACKEND_NATIVE_POSIX=y
CONFIG_SHELL_LOG_BACKEND=n

# Threads on native_sim run on host stacks, so this size is never used and
# only reserves memory.
CONFIG_MP_PLAYER_WORKER_STACK_SIZE=64
```

## src/main.c
```c
/*
 * Copyright 2025-2026 NXP
 *
 * SPDX-License-Identifier: Apache-2.0
 */

#include <zephyr/drivers/video.h>
#include <zephyr/video/controls.h>
#include <zephyr/logging/log.h>
#include <zephyr/mp/mp.h>
#include <zephyr/mp/base/mp_capsfilter.h>
#include <zephyr/mp/disp/mp_disp_sink.h>
#include <zephyr/mp/vid/mp_vid_src.h>
#include <zephyr/mp/utils/mp_player.h>
#if DT_HAS_CHOSEN(zephyr_jpegdec) || DT_HAS_CHOSEN(zephyr_videotrans)
#include <zephyr/mp/vid/mp_vid_transform.h>
#endif
#if DT_HAS_CHOSEN(zephyr_jpegdec)
#include <zephyr/mp/vid/mp_vid_convert.h>
#endif
#include <zephyr/sys/util_macro.h>

LOG_MODULE_REGISTER(main, CONFIG_LOG_DEFAULT_LEVEL);

/* Element IDs (values are arbitrary; only uniqueness within the pipeline matters) */
enum {
	PIPE_ID,
	VID_SRC_ID,
	CAPS_FILTER_ID,
	JPEG_DEC_ID,
	VID_CONV_ID,
	VID_TRANS_ID,
	DISP_SINK_ID,
};

static struct mp_pipeline pipe;
static struct mp_vid_src vid_src;
static struct mp_disp_sink disp_sink;
#if defined(CONFIG_MP_BASE_CAPSFILTER)
static struct mp_caps_filter caps_filter;
#endif
#if (DT_HAS_CHOSEN(zephyr_jpegdec))
static struct mp_vid_transform jpeg_dec;
static struct mp_vid_convert vid_conv;
#endif
#if (DT_HAS_CHOSEN(zephyr_videotrans))
static struct mp_vid_transform vid_trans;
#endif
static struct mp_player player;

int main(void)
{
	int ret;

	MP_ELEMENT_INIT(&pipe, mp_pipeline_init, PIPE_ID);
	MP_ELEMENT_INIT(&vid_src, mp_vid_src_init, VID_SRC_ID);
	MP_ELEMENT_INIT(&disp_sink, mp_disp_sink_init, DISP_SINK_ID);

	struct video_rect __maybe_unused crop = {
		CONFIG_VIDEO_SOURCE_CROP_LEFT, CONFIG_VIDEO_SOURCE_CROP_TOP,
		CONFIG_VIDEO_SOURCE_CROP_WIDTH, CONFIG_VIDEO_SOURCE_CROP_HEIGHT};

	/* clang-format off */
	ret = mp_object_set_properties((struct mp_object *)&vid_src,
		COND_CODE_0(CONFIG_PROP_NUM_BUFS, (), (MP_PROP_SRC_NUM_BUFS, CONFIG_PROP_NUM_BUFS,))
		COND_CODE_0(CONFIG_VIDEO_SOURCE_CROP_WIDTH, (), (MP_PROP_VID_CROP, &crop,))
		IF_ENABLED(CONFIG_VIDEO_CTRL_HFLIP, (VIDEO_CID_HFLIP, CONFIG_VIDEO_CTRL_HFLIP,))
		IF_ENABLED(CONFIG_VIDEO_CTRL_VFLIP, (VIDEO_CID_VFLIP, CONFIG_VIDEO_CTRL_VFLIP,))
		MP_PROP_LIST_END);
	/* clang-format on */
	if (ret < 0) {
		goto err;
	}

	/* Caps filter element */
#if defined(CONFIG_MP_BASE_CAPSFILTER)
	MP_ELEMENT_INIT(&caps_filter, mp_caps_filter_init, CAPS_FILTER_ID);

	/* clang-format off */
	struct mp_structure caps;
	struct mp_value pixfmt;

	ret = mp_structure_init_fields(&caps, MP_MEDIA_VIDEO,
		COND_CODE_0(CONFIG_VIDEO_FRAME_WIDTH,
			(), (MP_CAPS_IMAGE_WIDTH, MP_TYPE_UINT, CONFIG_VIDEO_FRAME_WIDTH,))
		COND_CODE_0(CONFIG_VIDEO_FRAME_HEIGHT,
			(), (MP_CAPS_IMAGE_HEIGHT, MP_TYPE_UINT, CONFIG_VIDEO_FRAME_HEIGHT,))
		COND_CODE_0(CONFIG_VIDEO_FRAME_RATE, (),
			(MP_CAPS_FRAME_INTERVAL, MP_TYPE_UINT,
			 MP_FRAME_INTERVAL_FROM_FPS(CONFIG_VIDEO_FRAME_RATE),))
		MP_CAPS_END);
	/* clang-format on */

	if (ret != 0) {
		goto err;
	}

	if (strcmp(CONFIG_VIDEO_PIXEL_FORMAT, "") != 0) {
		mp_value_set(&pixfmt, MP_TYPE_UINT,
			     VIDEO_FOURCC_FROM_STR(CONFIG_VIDEO_PIXEL_FORMAT));
		mp_structure_append_value(&caps, MP_CAPS_PIXEL_FORMAT, &pixfmt);
	}

	ret = mp_object_set_properties((struct mp_object *)&caps_filter,
				       MP_PROP_BASE_CAPSFILTER_CAPS, &caps, MP_PROP_LIST_END);
	if (ret < 0) {
		goto err;
	}
#endif

	/* JPEG decoder element */
#if (DT_HAS_CHOSEN(zephyr_jpegdec))
	MP_ELEMENT_INIT(&jpeg_dec, mp_vid_transform_init, JPEG_DEC_ID);
	MP_ELEMENT_INIT(&vid_conv, mp_vid_convert_init, VID_CONV_ID);

	ret = mp_object_set_properties((struct mp_object *)&jpeg_dec, MP_PROP_VID_DEVICE,
				       DEVICE_DT_GET_OR_NULL(DT_CHOSEN(zephyr_jpegdec)),
				       MP_PROP_LIST_END);
	if (ret < 0) {
		goto err;
	}
#endif

	/* Video transform element */
#if (DT_HAS_CHOSEN(zephyr_videotrans))
	MP_ELEMENT_INIT(&vid_trans, mp_vid_transform_init, VID_TRANS_ID);

	/* clang-format off */
	ret = mp_object_set_properties((struct mp_object *)&vid_trans,
		COND_CODE_0(CONFIG_VIDEO_ROTATION_ANGLE,
			(), (VIDEO_CID_ROTATE, CONFIG_VIDEO_ROTATION_ANGLE,)) MP_PROP_LIST_END);
	/* clang-format on */
	if (ret < 0) {
		goto err;
	}
#endif

	/* clang-format off */
	/* Add elements to the pipeline - order does not matter */
	ret = mp_bin_add((struct mp_bin *)&pipe,
			(struct mp_element *)&vid_src,
			IF_ENABLED(CONFIG_MP_BASE_CAPSFILTER, ((struct mp_element *)&caps_filter,))
			IF_ENABLED(DT_HAS_CHOSEN(zephyr_jpegdec), ((struct mp_element *)&jpeg_dec,))
			IF_ENABLED(DT_HAS_CHOSEN(zephyr_jpegdec), ((struct mp_element *)&vid_conv,))
			IF_ENABLED(DT_HAS_CHOSEN(zephyr_videotrans), ((struct mp_element *)&vid_trans,))
			(struct mp_element *)&disp_sink, NULL);
	if (ret < 0) {
		LOG_ERR("Failed to add elements (%d)", ret);
		goto err;
	}
	/* Link elements together - order does matter */
	ret = mp_element_link((struct mp_element *)&vid_src,
			IF_ENABLED(CONFIG_MP_BASE_CAPSFILTER, ((struct mp_element *)&caps_filter,))
			IF_ENABLED(DT_HAS_CHOSEN(zephyr_jpegdec), ((struct mp_element *)&jpeg_dec,))
			IF_ENABLED(DT_HAS_CHOSEN(zephyr_jpegdec), ((struct mp_element *)&vid_conv,))
			IF_ENABLED(DT_HAS_CHOSEN(zephyr_videotrans), ((struct mp_element *)&vid_trans,))
			(struct mp_element *)&disp_sink, NULL);
	if (ret < 0) {
		LOG_ERR("Failed to link elements (%d)", ret);
		goto err;
	}
	/* clang-format on */

	LOG_INF("Pipeline linked.");

	ret = mp_player_init(&player, &pipe);
	if (ret != 0) {
		LOG_ERR("Failed to init player (%d)", ret);
		goto err;
	}

	(void)mp_player_play(&player);
	(void)mp_player_wait_quit(&player);
	(void)mp_player_deinit(&player);

	LOG_INF("Done.");

	return 0;

err:
	LOG_ERR("Aborting sample");
	return 0;
}
```
