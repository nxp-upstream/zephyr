/*
 * Copyright 2026 NXP
 *
 * SPDX-License-Identifier: Apache-2.0
 */

/* The SDL display composes planes: the boxes go on one of their own */
#include "../pipeline_plane.dtsi"

/* The emulated camera never ends: stop after a few frames */
&camera_src {
	num-buffers = <10>;
};

&frame_filter {
	width = <320>;
	height = <240>;
};

&overlay {
	width = <320>;
	height = <240>;
};
