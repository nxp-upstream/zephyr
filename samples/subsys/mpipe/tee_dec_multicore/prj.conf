## CMakeLists.txt
```
# Copyright 2026 NXP
#
# SPDX-License-Identifier: Apache-2.0

cmake_minimum_required(VERSION 3.20.0)
find_package(Zephyr REQUIRED HINTS $ENV{ZEPHYR_BASE})
project(tee_dec_multicore)

# The pipeline is described in pipeline.dtsi: the application brings the
# stream it pushes and what it draws on the frames
target_sources(app PRIVATE src/main.c)

if(CONFIG_SAMPLE_INCLUDE_REMOTE_DIR)
  target_include_directories(zephyr_interface
    INTERFACE ${CMAKE_CURRENT_BINARY_DIR}/../remote/zephyr/include/public)
endif()

include(../common/mjpeg.cmake)
mpipe_sample_mjpeg_generate(jpeg_filter)
```

## Kconfig
```
# Copyright 2026 NXP
# SPDX-License-Identifier: Apache-2.0

mainmenu "Pipelines on two cores"

menu "Pipeline configuration"

config JPEG_IMAGE_WIDTH
	int "Width of the JPEG images"
	default 320

config JPEG_IMAGE_HEIGHT
	int "Height of the JPEG images"
	default 240

config MJPEG_NUM_FRAMES
	int "Number of frames in the generated test MJPEG stream"
	default 150
	help
	  Number of video frames in the MJPEG stream the application plays.
	  The stream is produced at build time using GStreamer CLI and
	  embedded in the image.

config FILE_OUTPUT_PATH
	string "Output MJPEG file path"
	default "/SD:/rec.mjp"
	help
	  Absolute path of the file the stream is recorded to.

endmenu

config SAMPLE_INCLUDE_REMOTE_DIR
	bool "Include remote core header directory"
	help
	  Include remote build header files. Can be used if primary image
	  needs to be aware of size or base address of secondary image

source "Kconfig.zephyr"
```

## prj.conf
```kconfig
CONFIG_LOG=y

CONFIG_MAIN_STACK_SIZE=4096
CONFIG_HEAP_MEM_POOL_SIZE=16384

# The framework, its elements and the player are enabled by the pipeline node
CONFIG_MPIPE_STRUCTURE_MAX_FIELDS=3
CONFIG_MPIPE_BIN_MAX_CHILDREN=12
CONFIG_MPIPE_BASE_TEE_MAX_SRC_PADS_NUM=3
# The pipeline thread plus one queue thread per branch
CONFIG_MPIPE_THREADS_NUM=4
# The thread of the recording branch writes the file
CONFIG_MPIPE_THREAD_STACK_SIZE=2048
# Twelve elements negotiate from the player's thread, two of them across the cores
CONFIG_MPIPE_PLAYER_WORKER_STACK_SIZE=10240

# The stream is pushed in chunks a 320x240 JPEG frame fits in, so a frame
# usually leaves the parser as a view of its chunk: one chunk being filled,
# one pending in the parser and one pinned by the frames queued in the branches.
CONFIG_MPIPE_BASE_APP_SRC_BUF_SZ=32768
CONFIG_MPIPE_BASE_APP_SRC_POOL_NUM=4
# A frame cut across two chunks is copied
CONFIG_MPIPE_IMG_JPEG_PARSER_MAX_FRAME_SIZE=76800
# The views of the frames of a chunk, the clients' buffers and slack
CONFIG_MPIPE_NET_BUF_POOL_COUNT=16

# The recording goes to the SD card
CONFIG_FILE_SYSTEM=y
CONFIG_FAT_FILESYSTEM_ELM=y
CONFIG_DISK_ACCESS=y
CONFIG_DISK_DRIVERS=y

# The text of the overlay
CONFIG_CHARACTER_FRAMEBUFFER=y
CONFIG_CHARACTER_FRAMEBUFFER_USE_DEFAULT_FONTS=y

# eRPC over the IPC service, one channel per client element, nothing from the heap
CONFIG_ERPC=y
CONFIG_ERPC_TRANSPORT_IPC_SERVICE=y
CONFIG_ERPC_ALLOCATION_POLICY_STATIC=y
CONFIG_ERPC_CODEC_COUNT=2
CONFIG_ERPC_DEFAULT_BUFFER_SIZE=4096
CONFIG_MPIPE_ERPC_CHANNELS_NUM=2

# RPMsg-Lite
CONFIG_RL_API_HAS_ZEROCOPY=y
CONFIG_RL_USE_STATIC_API=y
CONFIG_TIMESLICE_SIZE=1

# The bus carries end-of-stream and errors, never data: it needs neither
# zbus priority boost nor zbus logging of its own.
CONFIG_ZBUS_PRIORITY_BOOST=n
CONFIG_ZBUS_LOG_LEVEL_ERR=y
```

## boards/mimxrt1170_evk_mimxrt1176_cm7.conf
```kconfig
# The buffers the other core reads and writes: one JPEG frame of 76800 bytes for
# each client, and two decoded frames of 153600 bytes, the one being decoded
# and the one on the display
CONFIG_VIDEO_BUFFER_POOL_NUM_MAX=4
CONFIG_VIDEO_BUFFER_POOL_HEAP_SIZE=471040

# Both cores access the frames: keep them out of the M7 caches
CONFIG_VIDEO_BUFFER_POOL_ZEPHYR_REGION=y
CONFIG_VIDEO_BUFFER_POOL_ZEPHYR_REGION_NAME="OCRAM1"

CONFIG_SAMPLE_INCLUDE_REMOTE_DIR=y
CONFIG_SECOND_CORE_MCUX=y

# The decoded frame is smaller than the panel: display_write() needs a framebuffer
CONFIG_MCUX_LCDIFV2_FB_NUM=1
```

## src/main.c
```c
/*
 * Copyright 2026 NXP
 *
 * SPDX-License-Identifier: Apache-2.0
 *
 * The pipeline is described in pipeline.dtsi and built and played at boot.
 * The application brings the stream it pushes into the source and what this
 * core draws on the frames.
 */

#include <stdio.h>

#include <zephyr/devicetree.h>
#include <zephyr/kernel.h>
#include <zephyr/net_buf.h>
#include <zephyr/sys/util.h>

#include <zephyr/mpipe/base/mpipe_app_src.h>
#include <zephyr/mpipe/mpipe_dt.h>
#include <zephyr/mpipe/utils/mpipe_player.h>
#include <zephyr/mpipe/vid/mpipe_vid_draw.h>

#define FEED_POLL K_MSEC(100)

static const uint8_t mjpeg[] = {
#include "mjpeg.inc"
};

/* What this core adds to the frames the other core decoded and drew on */
void sample_draw_hud(uint8_t *frame, uint16_t width, uint16_t height, uint32_t pixfmt,
		     const struct net_buf *in, void *user_data)
{
	static uint32_t frames;
	char text[24];

	ARG_UNUSED(in);
	ARG_UNUSED(user_data);

	frames++;
	(void)snprintf(text, sizeof(text), "M7 %u", (unsigned int)frames);
	(void)mpipe_vid_draw_text(frame, width, height, pixfmt, 4, 4, 1, 0xFF000000U, text);
}

/*
 * Push the stream every time the pipeline plays, then declare its end: a
 * replay asked of the player gets the stream again.
 */
int main(void)
{
	struct mpipe_player *player = MPIPE_DT_PLAYER_GET(DT_NODELABEL(pipeline));
	struct mpipe_app_src *app_src =
		(struct mpipe_app_src *)MPIPE_DT_ELEMENT_GET(DT_NODELABEL(stream_src));
	size_t offset;
	uint32_t len;

	for (;;) {
		if (mpipe_player_wait_state(player, MPIPE_STATE_PLAYING, FEED_POLL) != 0) {
			continue;
		}

		offset = 0;
		while (offset < sizeof(mjpeg)) {
			len = (uint32_t)MIN(sizeof(mjpeg) - offset,
					    CONFIG_MPIPE_BASE_APP_SRC_BUF_SZ);

			if (mpipe_app_src_push(app_src, &mjpeg[offset], len, FEED_POLL) == 0) {
				offset += len;
				continue;
			}

			/* Stopped while the stream was being pushed; busy or paused otherwise */
			if (mpipe_player_wait_state(player, MPIPE_STATE_READY, K_NO_WAIT) == 0) {
				break;
			}
		}

		if (offset == sizeof(mjpeg)) {
			(void)mpipe_app_src_eos(app_src, K_FOREVER);
		}

		/* The player stops the pipeline at the end of the stream */
		while (mpipe_player_wait_state(player, MPIPE_STATE_READY, FEED_POLL) != 0) {
		}
	}

	return 0;
}
```
