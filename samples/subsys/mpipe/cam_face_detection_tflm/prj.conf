## CMakeLists.txt
```
# Copyright The Zephyr Project Contributors
# SPDX-License-Identifier: Apache-2.0

cmake_minimum_required(VERSION 3.28.0)

find_package(Zephyr REQUIRED HINTS $ENV{ZEPHYR_BASE})

project(cam_face_detection_tflm)

target_sources(app PRIVATE
  src/detect.c
  src/main.c
  src/preprocess.c
  src/inference.cpp
)

# The model, converted for the NPU and stored as a C array, so the build does
# not run the Neutron converter. model/ultraface_slim_npu.h records how it
# was produced. Another header defining g_model_tflite can be given; it must
# come from the converter version of the hal_nxp Neutron driver blobs.
set(MODEL_HEADER ${CMAKE_CURRENT_SOURCE_DIR}/model/ultraface_slim_npu.h
  CACHE FILEPATH "Neutron-compiled model, as a header defining g_model_tflite")
if(NOT EXISTS "${MODEL_HEADER}")
  message(FATAL_ERROR "Model header '${MODEL_HEADER}' not found.")
endif()
set(model_dir ${CMAKE_BINARY_DIR}/model)
configure_file(${MODEL_HEADER} ${model_dir}/model_tflite.h COPYONLY)
target_include_directories(app PRIVATE ${model_dir})
```

## Kconfig
```
# Copyright The Zephyr Project Contributors
# SPDX-License-Identifier: Apache-2.0

mainmenu "Camera face detection with TFLite Micro"

menu "Camera configuration"

config VIDEO_FRAME_RATE
	int "Frame rate of the video stream"
	default 0
	help
	  Frame rate requested from the camera. If set to 0, the sensor's
	  default frame rate is used.

config VIDEO_CTRL_HFLIP
	int "Mirror the captured frames horizontally"
	range 0 1
	default 0

config VIDEO_CTRL_VFLIP
	int "Mirror the captured frames vertically"
	range 0 1
	default 0

config PROP_NUM_BUFS
	int "Number of frames to capture before stopping"
	default 0
	help
	  If not set or set to 0, the camera streams forever.

endmenu

menu "Inference configuration"

config CAM_FACE_DETECTION_INPUT_MEAN
	int "Pixel level the model input is centered on"
	range 0 255
	default 128
	help
	  Each 8-bit pixel level p is fed to the model as (p - mean) / std,
	  then quantized with the scale and zero point of the input tensor.

config CAM_FACE_DETECTION_INPUT_STD
	int "Pixel level range the model input is divided by"
	range 1 255
	default 127
	help
	  Divisor of the input normalization, see CAM_FACE_DETECTION_INPUT_MEAN.

config CAM_FACE_DETECTION_THRESHOLD
	int "Face detection threshold in percent"
	range 1 100
	default 60
	help
	  Boxes whose face probability is below this value are discarded. The
	  led0 LED is lit while a face is reported.

config CAM_FACE_DETECTION_NMS_THRESHOLD
	int "Overlap threshold of the non-maximum suppression in percent"
	range 1 100
	default 50
	help
	  A box is discarded when its intersection over union with a
	  higher-scoring box reaches this value.

config CAM_FACE_DETECTION_MAX_BOXES
	int "Maximum faces reported per frame"
	range 1 32
	default 16
	help
	  Upper bound on the boxes kept from one inference.

config CAM_FACE_DETECTION_PRINT_PERIOD_MS
	int "Result reporting period in milliseconds"
	default 1000
	help
	  The latest result is printed, and the display overlay and the LED
	  are updated, once per period. Inferences finishing in between
	  replace the pending result rather than queueing behind it.

config CAM_FACE_DETECTION_NPU_REGION_NAME
	string "Memory region for the model and its tensor arena"
	default "SRAM1"
	help
	  Name of a zephyr,memory-region devicetree node the Neutron NPU can
	  reach. The NPU reads the model's microcode and weights in place and
	  reads and writes the tensors itself, so the model is copied there
	  from flash at start-up and the tensor arena is allocated there.

config CAM_FACE_DETECTION_ARENA_SIZE
	int "TFLite Micro tensor arena size in bytes"
	default 1277952
	help
	  Holds the input, output and intermediate tensors and the NPU scratch
	  buffer. The Neutron converter reports 1178528 bytes of tensors for
	  ultraface_slim; the sample logs the bytes actually used at start-up.

config INFERENCE_DROP_FRAMES
	bool "Drop frames captured while the model is busy"
	default y
	help
	  With a live camera the frames arriving during an inference are
	  dropped, so the result always describes a recent frame. Disable this
	  to score every frame instead, at the cost of back-pressure on the
	  camera.

config INFERENCE_STACK_SIZE
	int "Inference thread stack size"
	default 4096

config INFERENCE_PRIORITY
	int "Inference thread priority"
	default 5

endmenu

menu "Display configuration"

config CAM_FACE_DETECTION_DISPLAY_QUEUE_SIZE
	int "Buffers the display branch may hold"
	range 1 MPIPE_BASE_QUEUE_MAX_SIZE
	default 1
	help
	  Buffers queued for the display while the previous one is rendered.
	  They cannot be reused meanwhile, so keep this well below the size of
	  the pool they come from.

endmenu

source "Kconfig.zephyr"
```

## prj.conf
```kconfig
CONFIG_LOG=y
CONFIG_GPIO=y

CONFIG_MPIPE=y
CONFIG_MPIPE_STRUCTURE_MAX_FIELDS=4
CONFIG_MPIPE_BASE=y
CONFIG_MPIPE_BASE_APP_SINK=y
CONFIG_MPIPE_BASE_QUEUE=y
CONFIG_MPIPE_BASE_TEE=y
CONFIG_MPIPE_DISP=y
CONFIG_MPIPE_VID=y
CONFIG_MPIPE_VID_OVERLAY=y
CONFIG_MPIPE_PLAYER=y

# One streaming thread for the pipeline, one for the display branch's queue
CONFIG_MPIPE_THREADS_NUM=2
CONFIG_MPIPE_NET_BUF_POOL_COUNT=3

# The bus carries end-of-stream and errors, never data
CONFIG_ZBUS_PRIORITY_BOOST=n
CONFIG_ZBUS_LOG_LEVEL_ERR=y

# C++ with the full standard library, required by TFLite Micro
CONFIG_CPP=y
CONFIG_STD_CPP17=y
CONFIG_REQUIRES_FULL_LIBCPP=y
CONFIG_GLIBCXX_LIBCPP=y

# TensorFlow Lite Micro with the CMSIS-NN kernels
CONFIG_TENSORFLOW_LITE_MICRO=y
CONFIG_TENSORFLOW_LITE_MICRO_CMSIS_NN_KERNELS=y

# NXP Neutron NPU driver and firmware, and its TFLM kernel
CONFIG_TFLM_NXP_NEUTRON=y

CONFIG_FPU=y

# main() loads the model and sets the pipeline up
CONFIG_MAIN_STACK_SIZE=8192

# The result work item runs on the system work queue: it copies a detection
# result and builds the overlay rectangles on the stack, then prints. The
# default 1024 bytes overflow on the first result.
CONFIG_SYSTEM_WORKQUEUE_STACK_SIZE=4096
```

## boards/mimxrt700_evk_mimxrt798s_cm33_cpu0.conf
```kconfig
# Same as the other mpipe samples on this board: the camera DMA and the NPU
# share buffers with the CPU without cache maintenance.
CONFIG_DCACHE=n

# The model and its tensor arena fill SRAM1, so the capture buffers go to the
# SRAM_SHARED0 region the overlay declares. The camera driver asks for two
# buffers, each frame of the model input size, 320x240 RGB565, being 153600
# bytes; the heap holds those two plus the alignment and heap overhead.
CONFIG_VIDEO_BUFFER_POOL_NUM_MAX=2
CONFIG_VIDEO_BUFFER_POOL_HEAP_SIZE=327680
CONFIG_VIDEO_BUFFER_POOL_ZEPHYR_REGION=y
CONFIG_VIDEO_BUFFER_POOL_ZEPHYR_REGION_NAME="SRAM_SHARED0"
```

## boards/mimxrt700_evk_mimxrt798s_cm33_cpu0.overlay
```dts
/*
 * Copyright The Zephyr Project Contributors
 * SPDX-License-Identifier: Apache-2.0
 */

/*
 * The 1.4 MB SRAM partition below the RAM region holds no code or data in an
 * XIP image: declare it as a memory region for the video buffer pool, so the
 * capture buffers stay in on-chip SRAM. SRAM1 is left to the NPU.
 */
&sram_shared_code0 {
	compatible = "zephyr,memory-region", "mmio-sram";
	zephyr,memory-region = "SRAM_SHARED0";
};
```

## src/main.c
```c
/*
 * Copyright The Zephyr Project Contributors
 * SPDX-License-Identifier: Apache-2.0
 */

#include <errno.h>

#include <zephyr/drivers/gpio.h>
#include <zephyr/drivers/video.h>
#include <zephyr/kernel.h>
#include <zephyr/logging/log.h>
#include <zephyr/sys/printk.h>
#include <zephyr/sys/util_macro.h>
#include <zephyr/video/controls.h>

#include <zephyr/mpipe/mpipe.h>
#include <zephyr/mpipe/base/mpipe_app_sink.h>
#include <zephyr/mpipe/base/mpipe_queue.h>
#include <zephyr/mpipe/base/mpipe_tee.h>
#include <zephyr/mpipe/disp/mpipe_disp_sink.h>
#include <zephyr/mpipe/utils/mpipe_player.h>
#include <zephyr/mpipe/vid/mpipe_vid_overlay.h>
#include <zephyr/mpipe/vid/mpipe_vid_src.h>

#include "detect.h"
#include "inference.h"
#include "preprocess.h"

LOG_MODULE_REGISTER(main, CONFIG_LOG_DEFAULT_LEVEL);

/* Element IDs (values are arbitrary; only uniqueness within the pipeline matters) */
enum {
	PIPE_ID,
	VID_SRC_ID,
	TEE_ID,
	APP_SINK_ID,
	QUEUE_ID,
	OVERLAY_ID,
	DISP_SINK_ID,
};

/* Box outline color and width, as in the MPP person detection demo */
#define BOX_COLOR       0x0000FFU
#define RECT_LINE_WIDTH 2U

#define DETECTION_LABEL "face"

static struct mpipe pipe;
static struct mpipe_vid_src vid_src;
static struct mpipe_app_sink app_sink;
static struct mpipe_player player;
static struct mpipe_tee tee;
static struct mpipe_queue disp_queue;
static struct mpipe_vid_overlay overlay;
static struct mpipe_disp_sink disp_sink;

static struct inference_input model_in;
static size_t num_outputs;

/*
 * Dequantized model outputs, one row per anchor. They do not fit the
 * inference thread's stack, their only user.
 */
static float outputs[DETECT_MAX_OUTPUTS];

/* Lit while a face is in view; boards without a led0 alias run without it */
static const struct gpio_dt_spec led = GPIO_DT_SPEC_GET_OR(DT_ALIAS(led0), gpios, {0});

K_THREAD_STACK_DEFINE(inference_stack, CONFIG_INFERENCE_STACK_SIZE);
static struct k_thread inference_tid;

/*
 * Handshake between the streaming thread, which fills the input tensor, and
 * the inference thread, which runs the model on it. The tensor is in use
 * while a frame is being scored: with a live camera the next frames are
 * dropped rather than queued, so the result always describes a recent frame.
 */
static K_SEM_DEFINE(model_idle, 1, 1);
static K_SEM_DEFINE(frame_ready, 0, 1);
static uint32_t frame_num;
static uint32_t frame_pre_us;
static uint32_t frames_dropped;

/*
 * Runs on the streaming thread for every frame the sink delivers: a frame of
 * the model input size in RGB565, as negotiated. Converting it into the input
 * tensor here, rather than queueing the buffer for the inference thread,
 * returns the buffer at once: holding it would starve a camera driver that
 * cycles through a small set of buffers.
 */
static void frame_cb(const struct net_buf *buf, void *user_data)
{
	ARG_UNUSED(user_data);

	size_t size = mpipe_buffer_get_meta(buf)->bytes_used;
	uint32_t start;
	int ret;

	if (k_sem_take(&model_idle,
		       IS_ENABLED(CONFIG_INFERENCE_DROP_FRAMES) ? K_NO_WAIT : K_FOREVER) != 0) {
		/* The model still holds the tensor: drop this frame */
		frames_dropped++;
		return;
	}

	start = k_cycle_get_32();
	ret = preprocess_run(buf->data, size, &model_in);
	if (ret != 0) {
		LOG_ERR("Frame %u: preprocessing failed (%d), %u bytes", frame_num, ret,
			(unsigned int)size);
		frame_num++;
		k_sem_give(&model_idle);
		return;
	}

	frame_pre_us = k_cyc_to_us_floor32(k_cycle_get_32() - start);
	k_sem_give(&frame_ready);
}

/*
 * The producer: runs the model on each frame, decodes the
 * outputs into boxes and publishes them. It never touches the pipeline or
 * the console; the periodic consumer does.
 */
static void inference_thread(void *p1, void *p2, void *p3)
{
	ARG_UNUSED(p1);
	ARG_UNUSED(p2);
	ARG_UNUSED(p3);

	while (true) {
		struct detect_result result = {
			.model_width = model_in.width,
			.model_height = model_in.height,
		};
		uint32_t run_us;
		int ret;

		(void)k_sem_take(&frame_ready, K_FOREVER);

		ret = inference_run(outputs, num_outputs, &run_us);
		if (ret != 0) {
			LOG_ERR("Frame %u: inference failed (%d)", frame_num, ret);
		} else {
			result.inference_us = run_us;
			detect_decode(outputs, num_outputs, &result);
			detect_result_publish(&result);
			LOG_DBG("Frame %u: %u box(es), preprocess %u us, inference %u us, "
				"%u dropped",
				frame_num, result.count, frame_pre_us, run_us, frames_dropped);
		}

		frame_num++;
		k_sem_give(&model_idle);
	}
}

/* Overlay rectangle of an area of the frame, inclusive bounds */
static struct mpipe_vid_overlay_rect overlay_rect(uint16_t left, uint16_t top, uint16_t right,
						  uint16_t bottom, uint32_t color)
{
	struct mpipe_vid_overlay_rect r = {
		.left = left,
		.top = top,
		.right = right,
		.bottom = bottom,
		.line_width = RECT_LINE_WIDTH,
		.color = color,
	};

	return r;
}

/* Outline of each box in blue; model input pixels are frame pixels */
static void update_overlay(const struct detect_result *result)
{
	struct mpipe_vid_overlay_rect rects[CONFIG_CAM_FACE_DETECTION_MAX_BOXES];
	struct mpipe_vid_overlay_rects set = {.rects = rects, .count = 0};
	int ret;

	for (uint8_t i = 0; i < result->count; i++) {
		const struct detect_box *b = &result->boxes[i];

		rects[set.count++] = overlay_rect(b->left, b->top, b->right, b->bottom, BOX_COLOR);
	}

	ret = mpipe_object_set_properties((struct mpipe_object *)&overlay,
					  MPIPE_PROP_VID_OVERLAY_RECTS, &set, MPIPE_PROP_LIST_END);
	if (ret != 0) {
		LOG_ERR("Overlay update failed (%d)", ret);
	}
}

/*
 * The consumer: once per CONFIG_CAM_FACE_DETECTION_PRINT_PERIOD_MS, take the
 * latest result, if a new one was published, update the display overlay and
 * the LED, and print it.
 */
static uint32_t last_processed_frame;

static void process_results(void)
{
	struct detect_result result;

	if (!detect_result_fetch(&result, last_processed_frame)) {
		return;
	}

	last_processed_frame = result.frame_num;

	update_overlay(&result);

	if (led.port != NULL) {
		(void)gpio_pin_set_dt(&led, (result.count > 0U) ? 1 : 0);
	}

	printk("\ninference time %u ms\n", result.inference_us / USEC_PER_MSEC);
	if (result.count == 0U) {
		printk("detect: no %s detected\n", DETECTION_LABEL);
	} else {
		for (uint8_t i = 0; i < result.count; i++) {
			printk("detect: box %u label %s score %u(%%)\n", i, DETECTION_LABEL,
			       (uint32_t)(result.boxes[i].score * 100.0f + 0.5f));
		}
	}
}

static void results_work_handler(struct k_work *work);
static K_WORK_DELAYABLE_DEFINE(results_work, results_work_handler);

static void results_work_handler(struct k_work *work)
{
	ARG_UNUSED(work);

	process_results();
	(void)k_work_reschedule(&results_work, K_MSEC(CONFIG_CAM_FACE_DETECTION_PRINT_PERIOD_MS));
}

static int setup_led(void)
{
	if (led.port == NULL) {
		return 0;
	}

	if (!gpio_is_ready_dt(&led)) {
		return -ENODEV;
	}

	return gpio_pin_configure_dt(&led, GPIO_OUTPUT_INACTIVE);
}

static int setup_source(void)
{
	int ret = mpipe_vid_src_init(&vid_src, VID_SRC_ID);

	if (ret != 0) {
		return ret;
	}

	/* clang-format off */
	return mpipe_object_set_properties((struct mpipe_object *)&vid_src,
		COND_CODE_0(CONFIG_PROP_NUM_BUFS, (),
			    (MPIPE_PROP_SRC_NUM_BUFS, CONFIG_PROP_NUM_BUFS,))
		IF_ENABLED(CONFIG_VIDEO_CTRL_HFLIP, (VIDEO_CID_HFLIP, CONFIG_VIDEO_CTRL_HFLIP,))
		IF_ENABLED(CONFIG_VIDEO_CTRL_VFLIP, (VIDEO_CID_VFLIP, CONFIG_VIDEO_CTRL_VFLIP,))
		MPIPE_PROP_LIST_END);
	/* clang-format on */
}

/*
 * The frames the model is fed: RGB565 of the model input size, which the
 * camera delivers directly. A camera that cannot deliver them fails the
 * negotiation instead of passing frames the preprocessing would refuse.
 */
static int setup_app_sink(void)
{
	static const struct mpipe_app_sink_cb cb = {.fn = frame_cb};
	struct mpipe_structure caps;
	int ret = mpipe_app_sink_init(&app_sink, APP_SINK_ID);

	if (ret != 0) {
		return ret;
	}

	/* clang-format off */
	ret = mpipe_structure_init_fields(&caps, MPIPE_MEDIA_VIDEO,
		MPIPE_CAPS_PIXEL_FORMAT, MPIPE_TYPE_UINT, (uint32_t)VIDEO_PIX_FMT_RGB565,
		MPIPE_CAPS_IMAGE_WIDTH, MPIPE_TYPE_UINT, (uint32_t)model_in.width,
		MPIPE_CAPS_IMAGE_HEIGHT, MPIPE_TYPE_UINT, (uint32_t)model_in.height,
		COND_CODE_0(CONFIG_VIDEO_FRAME_RATE, (),
			(MPIPE_CAPS_FRAME_INTERVAL, MPIPE_TYPE_UINT,
			 MPIPE_FRAME_INTERVAL_FROM_FPS(CONFIG_VIDEO_FRAME_RATE),))
		MPIPE_CAPS_END);
	/* clang-format on */
	if (ret != 0) {
		return ret;
	}

	return mpipe_object_set_properties((struct mpipe_object *)&app_sink,
					   MPIPE_PROP_BASE_APP_SINK_CAPS, &caps,
					   MPIPE_PROP_BASE_APP_SINK_CB, &cb, MPIPE_PROP_LIST_END);
}

/*
 * The display branch: a queue, so the frames are pushed to the display on a
 * thread of its own and a slow panel does not hold the capture up, the
 * overlay drawing the boxes, and the display sink itself.
 * The queue leaks the oldest buffer rather than blocking, since the buffers
 * it holds cannot be reused meanwhile.
 */
static int setup_display_branch(void)
{
	static const uint8_t queue_size = CONFIG_CAM_FACE_DETECTION_DISPLAY_QUEUE_SIZE;
	static const enum mpipe_base_queue_leak leak = MPIPE_BASE_QUEUE_LEAK_OLDEST;
	int ret = mpipe_queue_init(&disp_queue, QUEUE_ID);

	if (ret != 0) {
		return ret;
	}

	ret = mpipe_object_set_properties((struct mpipe_object *)&disp_queue,
					  MPIPE_PROP_BASE_QUEUE_SIZE, &queue_size,
					  MPIPE_PROP_BASE_QUEUE_LEAK, &leak, MPIPE_PROP_LIST_END);
	if (ret != 0) {
		return ret;
	}

	ret = mpipe_vid_overlay_init(&overlay, OVERLAY_ID);
	if (ret != 0) {
		return ret;
	}

	return mpipe_disp_sink_init(&disp_sink, DISP_SINK_ID);
}

/*
 * A tee feeds the application and the display the same buffers:
 *
 *   vid_src -> tee -> app_sink
 *                  -> queue -> overlay -> disp_sink
 *
 * The caps of app_sink set the camera format through the tee. The tee pushes
 * to app_sink first, whose callback has converted the frame into the input
 * tensor before the overlay draws into the same buffer.
 */
static int setup_pipeline(void)
{
	int ret = mpipe_pipeline_init(&pipe, PIPE_ID);

	if (ret != 0) {
		return ret;
	}

	ret = setup_source();
	if (ret != 0) {
		return ret;
	}

	ret = setup_app_sink();
	if (ret != 0) {
		return ret;
	}

	ret = mpipe_tee_init(&tee, TEE_ID);
	if (ret != 0) {
		return ret;
	}

	ret = setup_display_branch();
	if (ret != 0) {
		LOG_ERR("Failed to set the display branch up (%d)", ret);
		return ret;
	}

	/* clang-format off */
	/* Add elements to the pipeline - order does not matter */
	ret = mpipe_bin_add((struct mpipe_bin *)&pipe,
			    (struct mpipe_element *)&vid_src,
			    (struct mpipe_element *)&tee,
			    (struct mpipe_element *)&app_sink,
			    (struct mpipe_element *)&disp_queue,
			    (struct mpipe_element *)&overlay,
			    (struct mpipe_element *)&disp_sink,
			    NULL);
	if (ret != 0) {
		LOG_ERR("Failed to add elements (%d)", ret);
		return ret;
	}

	/* Inference branch - order does matter */
	ret = mpipe_element_link((struct mpipe_element *)&vid_src,
				 (struct mpipe_element *)&tee,
				 (struct mpipe_element *)&app_sink, NULL);

	if (ret != 0) {
		LOG_ERR("Failed to link the inference branch (%d)", ret);
		return ret;
	}

	/* Display branch, off the tee's second source pad */
	ret = mpipe_element_link((struct mpipe_element *)&tee, (struct mpipe_element *)&disp_queue,
				 (struct mpipe_element *)&overlay,
				 (struct mpipe_element *)&disp_sink, NULL);
	if (ret != 0) {
		LOG_ERR("Failed to link the display branch (%d)", ret);
		return ret;
	}

	return 0;
}

int main(void)
{
	int ret;

	printk("\n");
	printk("========================================\n");
	printk("  Zephyr mpipe Face Detection Demo\n");
	printk("  TFLite Micro on the Neutron NPU\n");
	printk("========================================\n");
	printk("\n");

	ret = inference_init(&model_in, &num_outputs);
	if (ret != 0) {
		LOG_ERR("Model setup failed (%d)", ret);
		return 0;
	}

	if (!detect_outputs_supported(num_outputs)) {
		LOG_ERR("Model has %u outputs, more than %u", (unsigned int)num_outputs,
			DETECT_MAX_OUTPUTS);
		return 0;
	}

	ret = setup_led();
	if (ret != 0) {
		LOG_WRN("LED unavailable (%d)", ret);
	}

	preprocess_init(&model_in);

	ret = setup_pipeline();
	if (ret != 0) {
		LOG_ERR("Pipeline setup failed (%d)", ret);
		return 0;
	}

	LOG_INF("Pipeline linked.");

	(void)k_thread_create(&inference_tid, inference_stack,
			      K_THREAD_STACK_SIZEOF(inference_stack), inference_thread, NULL, NULL,
			      NULL, CONFIG_INFERENCE_PRIORITY, 0, K_NO_WAIT);
	(void)k_thread_name_set(&inference_tid, "inference");

	ret = mpipe_player_init(&player, &pipe);
	if (ret != 0) {
		LOG_ERR("Failed to init player (%d)", ret);
		return 0;
	}

	printk("\n========================================\n");
	printk("  Pipeline Running - Detecting Faces\n");
	printk("========================================\n\n");

	(void)k_work_schedule(&results_work, K_MSEC(CONFIG_CAM_FACE_DETECTION_PRINT_PERIOD_MS));

	(void)mpipe_player_play(&player);
	(void)mpipe_player_wait_quit(&player);
	(void)k_work_cancel_delayable(&results_work);
	(void)mpipe_player_deinit(&player);

	LOG_INF("Done.");

	return 0;
}
```

## src/detect.c
```c
/*
 * Copyright The Zephyr Project Contributors
 * SPDX-License-Identifier: Apache-2.0
 */

#include <zephyr/kernel.h>
#include <zephyr/spinlock.h>
#include <zephyr/sys/util.h>

#include "detect.h"

/*
 * Latest-result mailbox between the inference thread and the periodic
 * consumer. Both sides copy a small structure under a spinlock, so neither
 * ever waits for the other to finish processing, and the consumer always sees
 * one complete result.
 */
static struct k_spinlock result_lock;
static struct detect_result latest;
static uint32_t published;

void detect_result_publish(const struct detect_result *result)
{
	__ASSERT_NO_MSG(result != NULL);

	k_spinlock_key_t key = k_spin_lock(&result_lock);

	latest = *result;
	latest.frame_num = ++published;
	k_spin_unlock(&result_lock, key);
}

bool detect_result_fetch(struct detect_result *result, uint32_t last_frame)
{
	__ASSERT_NO_MSG(result != NULL);

	bool fresh;
	k_spinlock_key_t key = k_spin_lock(&result_lock);

	fresh = (published != 0U) && (published != last_frame);
	if (fresh) {
		*result = latest;
	}
	k_spin_unlock(&result_lock, key);

	return fresh;
}

bool detect_outputs_supported(size_t num_outputs)
{
	return (num_outputs > 0U) && ((num_outputs % DETECT_ANCHOR_CHANNELS) == 0U) &&
	       (num_outputs <= DETECT_MAX_OUTPUTS);
}

static uint32_t box_area(const struct detect_box *b)
{
	return (uint32_t)(b->right - b->left + 1U) * (uint32_t)(b->bottom - b->top + 1U);
}

/* Whether a and b overlap by at least CONFIG_CAM_FACE_DETECTION_NMS_THRESHOLD percent */
static bool boxes_overlap(const struct detect_box *a, const struct detect_box *b)
{
	uint16_t left = MAX(a->left, b->left);
	uint16_t top = MAX(a->top, b->top);
	uint16_t right = MIN(a->right, b->right);
	uint16_t bottom = MIN(a->bottom, b->bottom);

	if (right < left || bottom < top) {
		return false;
	}

	uint32_t inter = (uint32_t)(right - left + 1U) * (uint32_t)(bottom - top + 1U);
	uint32_t uni = box_area(a) + box_area(b) - inter;

	/* inter / uni >= threshold / 100, without division */
	return inter * 100U >= uni * (uint32_t)CONFIG_CAM_FACE_DETECTION_NMS_THRESHOLD;
}

/* Pixel coordinate of a normalized position, clamped to [0, size - 1] */
static uint16_t to_pixel(float pos, uint16_t size)
{
	float px = pos * (float)size;

	return (uint16_t)CLAMP(px, 0.0f, (float)(size - 1U));
}

/*
 * Candidate boxes of the current inference, best score first. Only the
 * inference thread decodes, so a single static list serves every call and
 * keeps the candidates off its stack.
 */
static struct detect_box candidates[DETECT_MAX_CANDIDATES];

/* Insert a box in the sorted candidates; a full list drops its lowest score */
static size_t candidate_insert(size_t num, const struct detect_box *box)
{
	size_t pos = MIN(num, (size_t)DETECT_MAX_CANDIDATES - 1U);

	if (num == DETECT_MAX_CANDIDATES && candidates[pos].score >= box->score) {
		return num;
	}

	/* Insertion sort: there are few candidates above the threshold */
	while (pos > 0U && candidates[pos - 1U].score < box->score) {
		candidates[pos] = candidates[pos - 1U];
		pos--;
	}
	candidates[pos] = *box;

	return MIN(num + 1U, (size_t)DETECT_MAX_CANDIDATES);
}

/* Greedy non-maximum suppression over the sorted candidates */
static void candidates_suppress(size_t num, struct detect_result *result)
{
	for (size_t i = 0U; i < num && result->count < CONFIG_CAM_FACE_DETECTION_MAX_BOXES; i++) {
		bool suppressed = false;

		for (uint8_t k = 0U; k < result->count; k++) {
			if (boxes_overlap(&result->boxes[k], &candidates[i])) {
				suppressed = true;
				break;
			}
		}

		if (!suppressed) {
			result->boxes[result->count] = candidates[i];
			result->count++;
		}
	}
}

static void anchor_decode(const float *scores, size_t num_scores, struct detect_result *result)
{
	const float threshold = (float)CONFIG_CAM_FACE_DETECTION_THRESHOLD / 100.0f;
	const size_t num_anchors = num_scores / DETECT_ANCHOR_CHANNELS;
	size_t num = 0U;

	for (size_t i = 0U; i < num_anchors; i++) {
		const float *anchor = &scores[i * DETECT_ANCHOR_CHANNELS];
		float score = anchor[1];

		if (score < threshold) {
			continue;
		}

		/* The model decodes the anchors: corners relative to the input */
		struct detect_box box = {
			.left = to_pixel(anchor[2], result->model_width),
			.top = to_pixel(anchor[3], result->model_height),
			.right = to_pixel(anchor[4], result->model_width),
			.bottom = to_pixel(anchor[5], result->model_height),
			.score = CLAMP(score, 0.0f, 1.0f),
		};

		if (box.right <= box.left || box.bottom <= box.top) {
			continue;
		}

		num = candidate_insert(num, &box);
	}

	candidates_suppress(num, result);
}

void detect_decode(const float *scores, size_t num_scores, struct detect_result *result)
{
	__ASSERT_NO_MSG(scores != NULL);
	__ASSERT_NO_MSG(result != NULL);

	result->count = 0U;

	if (!detect_outputs_supported(num_scores)) {
		return;
	}

	anchor_decode(scores, num_scores, result);
}
```

## src/detect.h
```c
/*
 * Copyright The Zephyr Project Contributors
 * SPDX-License-Identifier: Apache-2.0
 */

#ifndef CAM_FACE_DETECTION_DETECT_H_
#define CAM_FACE_DETECTION_DETECT_H_

#include <stdbool.h>
#include <stddef.h>
#include <stdint.h>

#include <zephyr/sys/util.h>

/*
 * The Ultra-Light face detector output: one row per anchor holding the
 * no-face and face probabilities and the box corners left, top, right,
 * bottom, each relative to the input size. The model decodes the anchors
 * itself. The anchor count follows the input size: 4420 at 320x240, 9984 at
 * 480x360, the largest input whose tensors fit the NPU-reachable SRAM.
 */
#define DETECT_ANCHOR_CHANNELS  6U
#define DETECT_MAX_ANCHORS      9984U
#define DETECT_MAX_OUTPUTS      (DETECT_MAX_ANCHORS * DETECT_ANCHOR_CHANNELS)

/* Boxes above the threshold kept for the non-maximum suppression, at most */
#define DETECT_MAX_CANDIDATES 196U

/** One detected face, in pixels of the model input, which are those of the frame */
struct detect_box {
	/** Left column, inclusive */
	uint16_t left;
	/** Top row, inclusive */
	uint16_t top;
	/** Right column, inclusive */
	uint16_t right;
	/** Bottom row, inclusive */
	uint16_t bottom;
	/** Confidence in [0, 1] */
	float score;
};

/** The outcome of one inference, as published to the consumer */
struct detect_result {
	/** Detected faces */
	struct detect_box boxes[CONFIG_CAM_FACE_DETECTION_MAX_BOXES];
	/** Valid entries in @p boxes */
	uint8_t count;
	/** Model input size the boxes are expressed in */
	uint16_t model_width;
	/** Model input size the boxes are expressed in */
	uint16_t model_height;
	/** Duration of the inference in microseconds */
	uint32_t inference_us;
	/** Increments with every published result, starting at 1 */
	uint32_t frame_num;
};

/**
 * @brief Publish a result, replacing the previous one
 *
 * Called by the producer only. The result is copied; the frame number is
 * assigned here.
 *
 * @param result Result to publish
 */
void detect_result_publish(const struct detect_result *result);

/**
 * @brief Fetch the latest published result
 *
 * @param[out] result Copy of the latest result
 * @param last_frame Frame number the caller already processed
 *
 * @retval true @p result holds a result newer than @p last_frame
 * @retval false Nothing new was published
 */
bool detect_result_fetch(struct detect_result *result, uint32_t last_frame);

/**
 * @brief Check that the model output matches the decoding built in
 *
 * @param num_outputs Number of values in the model output
 *
 * @retval true detect_decode() can read this output
 * @retval false The output is not whole anchor rows, or holds more than
 *               DETECT_MAX_ANCHORS of them
 */
bool detect_outputs_supported(size_t num_outputs);

/**
 * @brief Turn the model outputs into boxes
 *
 * The detector yields one box per anchor: the boxes scoring below
 * CONFIG_CAM_FACE_DETECTION_THRESHOLD are dropped and the best
 * DETECT_MAX_CANDIDATES others go through a non-maximum suppression at
 * CONFIG_CAM_FACE_DETECTION_NMS_THRESHOLD, best score first.
 *
 * Not reentrant: the detector decodes into a static candidate list.
 *
 * @param scores Dequantized model outputs
 * @param num_scores Entries in @p scores
 * @param[in,out] result Result whose model size is set; boxes are written
 */
void detect_decode(const float *scores, size_t num_scores, struct detect_result *result);

#endif /* CAM_FACE_DETECTION_DETECT_H_ */
```

## src/inference.cpp
```c
/*
 * Copyright The Zephyr Project Contributors
 * SPDX-License-Identifier: Apache-2.0
 *
 * Face detection with TensorFlow Lite Micro on the NXP Neutron NPU. The
 * model is the Neutron-compiled TFLite flatbuffer itself: its NeutronGraph
 * operator carries the microcode and weights.
 */

#include <errno.h>
#include <string.h>

#include <zephyr/kernel.h>
#include <zephyr/linker/section_tags.h>
#include <zephyr/logging/log.h>
#include <zephyr/sys/util.h>

#include <tensorflow/lite/micro/kernels/neutron/neutron.h>
#include <tensorflow/lite/micro/micro_interpreter.h>
#include <tensorflow/lite/micro/micro_mutable_op_resolver.h>
#include <tensorflow/lite/schema/schema_generated.h>

#include <model_tflite.h>

#include "inference.h"

LOG_MODULE_REGISTER(inference, CONFIG_LOG_DEFAULT_LEVEL);

/*
 * The NPU reads the model (microcode and weights) in place and reads and
 * writes the tensors and its scratch buffer itself, so all of them live in a
 * region it reaches. inference_init() copies the model in from flash.
 */
#define NPU_SECTION Z_GENERIC_SECTION(CONFIG_CAM_FACE_DETECTION_NPU_REGION_NAME)

alignas(16) static uint8_t model_data[sizeof(g_model_tflite)] NPU_SECTION;
alignas(16) static uint8_t tensor_arena[CONFIG_CAM_FACE_DETECTION_ARENA_SIZE] NPU_SECTION;

static tflite::MicroInterpreter *interpreter;
static TfLiteTensor *input_tensor;
static TfLiteTensor *output_tensor;
static size_t output_count;

int inference_init(struct inference_input *input, size_t *num_outputs)
{
	__ASSERT_NO_MSG(input != NULL);
	__ASSERT_NO_MSG(num_outputs != NULL);

	memcpy(model_data, g_model_tflite, sizeof(model_data));
	memset(tensor_arena, 0, sizeof(tensor_arena));

	const tflite::Model *model = tflite::GetModel(model_data);

	if (model->version() != TFLITE_SCHEMA_VERSION) {
		LOG_ERR("Model schema version %u, expected %d", (unsigned int)model->version(),
			TFLITE_SCHEMA_VERSION);
		return -EINVAL;
	}

	/*
	 * The operators the Neutron converter leaves on the CPU besides the NPU
	 * graphs. A missing one fails AllocateTensors().
	 */
	static tflite::MicroMutableOpResolver<6> resolver;

	resolver.AddAdd();
	resolver.AddConcatenation();
	resolver.AddMul();
	resolver.AddSlice();
	resolver.AddSoftmax();
	resolver.AddCustom(tflite::GetString_NEUTRON_GRAPH(), tflite::Register_NEUTRON_GRAPH());

	static tflite::MicroInterpreter static_interpreter(model, resolver, tensor_arena,
							   sizeof(tensor_arena));

	interpreter = &static_interpreter;

	/* Allocating the tensors has the Neutron kernel prepare the NPU model */
	if (interpreter->AllocateTensors() != kTfLiteOk) {
		LOG_ERR("AllocateTensors failed");
		interpreter = NULL;
		return -ENOMEM;
	}

	input_tensor = interpreter->input(0);
	output_tensor = interpreter->output(0);

	if (input_tensor == NULL || output_tensor == NULL) {
		interpreter = NULL;
		return -EINVAL;
	}

	if (input_tensor->type != kTfLiteInt8 || input_tensor->dims->size != 4 ||
	    input_tensor->dims->data[0] != 1 ||
	    (input_tensor->dims->data[3] != 1 && input_tensor->dims->data[3] != 3)) {
		LOG_ERR("Input must be int8 [1, H, W, 1 or 3]");
		interpreter = NULL;
		return -EINVAL;
	}

	if (output_tensor->dims->size < 2 || output_tensor->dims->data[0] != 1) {
		LOG_ERR("Output must be [1, ...]");
		interpreter = NULL;
		return -EINVAL;
	}

	input->data = input_tensor->data.int8;
	input->height = (uint16_t)input_tensor->dims->data[1];
	input->width = (uint16_t)input_tensor->dims->data[2];
	input->channels = (uint16_t)input_tensor->dims->data[3];
	input->scale = input_tensor->params.scale;
	input->zero_point = input_tensor->params.zero_point;

	/* Every output value after the batch dimension, in row-major order */
	size_t count = 1U;

	for (int i = 1; i < output_tensor->dims->size; i++) {
		count *= (size_t)output_tensor->dims->data[i];
	}
	output_count = count;
	*num_outputs = count;

	LOG_INF("TFLM model %u bytes, input %ux%ux%u, %u outputs, arena %u of %u bytes used",
		(unsigned int)sizeof(model_data), input->width, input->height, input->channels,
		(unsigned int)*num_outputs, (unsigned int)interpreter->arena_used_bytes(),
		(unsigned int)sizeof(tensor_arena));

	return 0;
}

int inference_run(float *scores, size_t num_scores, uint32_t *usec)
{
	__ASSERT_NO_MSG(interpreter != NULL);
	__ASSERT_NO_MSG(scores != NULL);
	__ASSERT_NO_MSG(usec != NULL);

	uint32_t start = k_cycle_get_32();
	TfLiteStatus status = interpreter->Invoke();

	*usec = k_cyc_to_us_floor32(k_cycle_get_32() - start);

	if (status != kTfLiteOk) {
		LOG_ERR("Invoke failed (%d)", (int)status);
		return -EIO;
	}

	size_t n = MIN(num_scores, output_count);

	for (size_t i = 0; i < n; i++) {
		switch (output_tensor->type) {
		case kTfLiteFloat32:
			scores[i] = output_tensor->data.f[i];
			break;
		case kTfLiteInt8:
			scores[i] = ((int)output_tensor->data.int8[i] -
				     output_tensor->params.zero_point) *
				    output_tensor->params.scale;
			break;
		case kTfLiteUInt8:
			scores[i] = ((int)output_tensor->data.uint8[i] -
				     output_tensor->params.zero_point) *
				    output_tensor->params.scale;
			break;
		default:
			return -ENOTSUP;
		}
	}

	return 0;
}
```

## src/inference.h
```c
/*
 * Copyright The Zephyr Project Contributors
 * SPDX-License-Identifier: Apache-2.0
 */

#ifndef CAM_FACE_DETECTION_INFERENCE_H_
#define CAM_FACE_DETECTION_INFERENCE_H_

#include <stddef.h>
#include <stdint.h>

#ifdef __cplusplus
extern "C" {
#endif

/** Model input tensor: an int8 image in NHWC order, filled by the caller */
struct inference_input {
	/** Tensor data, width * height * channels bytes */
	int8_t *data;
	/** Image width in pixels */
	uint16_t width;
	/** Image height in pixels */
	uint16_t height;
	/** 1 (grey) or 3 (RGB) */
	uint16_t channels;
	/** Quantization: real = scale * (q - zero_point) */
	float scale;
	/** Quantization zero point */
	int32_t zero_point;
};

/**
 * @brief Initialize the NPU and load the model
 *
 * @param[out] input Description of the input tensor to fill before each run
 * @param[out] num_outputs Number of values in the model output, batch excluded
 *
 * @retval 0 Success
 * @retval -EIO The Neutron driver failed to initialize
 * @retval -EINVAL Unsupported model (operator, input type or shape)
 * @retval -ENOMEM The tensor arena is too small
 */
int inference_init(struct inference_input *input, size_t *num_outputs);

/**
 * @brief Run the model on the current input tensor
 *
 * @param[out] scores Dequantized output values, in the row-major order of the
 *                    output tensor
 * @param num_scores Room in @p scores
 * @param[out] usec Duration of the inference in microseconds
 *
 * @retval 0 Success
 * @retval -EIO The execution failed
 */
int inference_run(float *scores, size_t num_scores, uint32_t *usec);

#ifdef __cplusplus
}
#endif

#endif /* CAM_FACE_DETECTION_INFERENCE_H_ */
```

## src/preprocess.c
```c
/*
 * Copyright 2026 NXP
 *
 * SPDX-License-Identifier: Apache-2.0
 */

#include <errno.h>
#include <math.h>

#include <zephyr/sys/util.h>

#include "preprocess.h"

/*
 * Quantized value of each RGB565 component, expanded to 8 bits by replicating
 * its high bits into the low ones, for the current model input
 */
static int8_t quant_5bit[32];
static int8_t quant_6bit[64];

static int8_t quantize(const struct inference_input *input, uint32_t level)
{
	float real = ((float)level - (float)CONFIG_CAM_FACE_DETECTION_INPUT_MEAN) /
		     (float)CONFIG_CAM_FACE_DETECTION_INPUT_STD;
	int32_t q = (int32_t)lroundf(real / input->scale) + input->zero_point;

	return (int8_t)CLAMP(q, INT8_MIN, INT8_MAX);
}

void preprocess_init(const struct inference_input *input)
{
	__ASSERT_NO_MSG(input != NULL);

	for (uint32_t i = 0U; i < ARRAY_SIZE(quant_5bit); i++) {
		quant_5bit[i] = quantize(input, (i << 3) | (i >> 2));
	}

	for (uint32_t i = 0U; i < ARRAY_SIZE(quant_6bit); i++) {
		quant_6bit[i] = quantize(input, (i << 2) | (i >> 4));
	}
}

int preprocess_run(const uint8_t *data, size_t size, const struct inference_input *input)
{
	__ASSERT_NO_MSG(data != NULL);
	__ASSERT_NO_MSG(input != NULL);

	if (input->channels != 3U) {
		return -ENOTSUP;
	}

	size_t pixels = (size_t)input->width * input->height;

	if (size < pixels * 2U) {
		return -EINVAL;
	}

	int8_t *out = input->data;

	/* RGB565 is little endian: the high byte of a pixel comes second */
	for (size_t i = 0U; i < pixels; i++) {
		uint16_t px = (uint16_t)(data[0] | (data[1] << 8));

		out[0] = quant_5bit[px >> 11];
		out[1] = quant_6bit[(px >> 5) & 0x3FU];
		out[2] = quant_5bit[px & 0x1FU];
		data += 2;
		out += 3;
	}

	return 0;
}
```

## src/preprocess.h
```c
/*
 * Copyright 2026 NXP
 *
 * SPDX-License-Identifier: Apache-2.0
 */

#ifndef CAM_FACE_DETECTION_PREPROCESS_H_
#define CAM_FACE_DETECTION_PREPROCESS_H_

#include <stddef.h>
#include <stdint.h>

#include "inference.h"

/**
 * @brief Prepare the quantization tables for a model input
 *
 * Each 8-bit pixel level p is normalized to (p - CONFIG_CAM_FACE_DETECTION_INPUT_MEAN) /
 * CONFIG_CAM_FACE_DETECTION_INPUT_STD, then quantized for the input tensor.
 *
 * @param input Model input tensor description
 */
void preprocess_init(const struct inference_input *input);

/**
 * @brief Convert an RGB565 frame into the model input
 *
 * The pipeline negotiates RGB565 frames of the model input size, so each
 * pixel is converted in place: no crop, no scaling.
 *
 * @param data RGB565 frame, with no row padding
 * @param size Valid bytes in @p data
 * @param input Model input tensor to fill
 *
 * @retval 0 Success
 * @retval -ENOTSUP The model input is not 3-channel RGB
 * @retval -EINVAL @p size does not hold a frame of the model input size
 */
int preprocess_run(const uint8_t *data, size_t size, const struct inference_input *input);

#endif /* CAM_FACE_DETECTION_PREPROCESS_H_ */
```
