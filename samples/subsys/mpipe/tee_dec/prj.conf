## prj.conf
```kconfig
CONFIG_LOG=y

CONFIG_MPIPE=y
CONFIG_MPIPE_STRUCTURE_MAX_FIELDS=3
# Pipeline thread + 2 queue threads
CONFIG_MPIPE_THREADS_NUM=3
CONFIG_MPIPE_BASE=y
CONFIG_MPIPE_BASE_CAPS_FILTER=y
CONFIG_MPIPE_BASE_QUEUE=y
CONFIG_MPIPE_BASE_TEE=y
CONFIG_MPIPE_FS=y
CONFIG_MPIPE_IMG=y
CONFIG_MPIPE_IMG_JPEG_DECODER=y
CONFIG_MPIPE_DISP=y
CONFIG_MPIPE_PLAYER=y
# 2 in each queue + 1 partial + 1 in-flight = 6.
CONFIG_MPIPE_NET_BUF_POOL_COUNT=6
CONFIG_MPIPE_IMG_JPEG_PARSER_POOL_NUM=6
# Largest estimated size for 320x240 JPEG image
CONFIG_MPIPE_IMG_JPEG_PARSER_MAX_FRAME_SIZE=153600

CONFIG_FILE_SYSTEM=y
CONFIG_FAT_FILESYSTEM_ELM=y
CONFIG_FS_FATFS_LFN=y
CONFIG_FS_FATFS_MAX_LFN=255
CONFIG_DISK_ACCESS=y
CONFIG_DISK_DRIVERS=y

# The source reads the input file on the pipeline thread while the file_sink
# writes on a queue thread, both on the same FAT volume. FatFs shares one
# sector window per volume, so concurrent access needs the re-entrancy option.
# Re-entrancy cannot use the LFN buffer in BSS; the stack mode costs
# (MAX_LFN + 1) * 2 bytes on the stack of every thread entering the filesystem.
CONFIG_FS_FATFS_REENTRANT=y
CONFIG_FS_FATFS_LFN_MODE_STACK=y

# The bus carries end-of-stream and errors, never data: it needs neither
# zbus priority boost nor zbus logging of its own.
CONFIG_ZBUS_PRIORITY_BOOST=n
CONFIG_ZBUS_LOG_LEVEL_ERR=y
```

## boards/mimxrt1170_evk_mimxrt1176_cm7.conf
```kconfig
# main() mounts FATFS and writes the test input file out to the SD card,
# which the default main stack does not cover.
CONFIG_MAIN_STACK_SIZE=2560

# The pooled threads carry the whole chain: file read and parse, JPEG decode
# and display, and the second branch's file writes, which the default stack
# does not cover.
CONFIG_MPIPE_THREAD_STACK_SIZE=2048

CONFIG_MCUX_ELCDIF_FB_NUM=1
```

## src/main.c
```c
/*
 * Copyright 2026 NXP
 *
 * SPDX-License-Identifier: Apache-2.0
 *
 * Tee pipeline sample demonstrating multi-branch pipelines:
 *
 *   [file_src] -> [jpeg_parser] -> [caps_filter] -> [tee] -> [queue1] -> [jpeg_dec] -> [disp_sink]
 *                                                     -> [queue2] -> [file_sink]
 */

#include <errno.h>
#if defined(CONFIG_FAT_FILESYSTEM_ELM)
#include <ff.h>
#endif

#include <zephyr/drivers/video.h>
#include <zephyr/fs/fs.h>
#include <zephyr/logging/log.h>

#include <zephyr/mpipe/mpipe.h>
#include <zephyr/mpipe/base/mpipe_caps_filter.h>
#include <zephyr/mpipe/base/mpipe_queue.h>
#include <zephyr/mpipe/base/mpipe_tee.h>
#include <zephyr/mpipe/disp/mpipe_disp_sink.h>
#include <zephyr/mpipe/fs/mpipe_file_sink.h>
#include <zephyr/mpipe/fs/mpipe_file_src.h>
#include <zephyr/mpipe/img/mpipe_img_jpeg_decoder.h>
#include <zephyr/mpipe/img/mpipe_img_jpeg_parser.h>
#include <zephyr/mpipe/utils/mpipe_player.h>

LOG_MODULE_REGISTER(main, CONFIG_LOG_DEFAULT_LEVEL);

/* Element IDs (values are arbitrary; only uniqueness within the pipeline matters) */
enum {
	PIPE_ID,
	FILE_SRC_ID,
	JPEG_PARSER_ID,
	CAPS_FILTER_ID,
	TEE_ID,
	QUEUE1_ID,
	JPEG_DEC_ID,
	DISP_SINK_ID,
	QUEUE2_ID,
	FILE_SINK_ID,
};

#define MNT_POINT "/SD:"

#if defined(CONFIG_FAT_FILESYSTEM_ELM)
static FATFS fat_fs;
#endif

static struct fs_mount_t mnt = {
	.type = FS_FATFS,
#if defined(CONFIG_FAT_FILESYSTEM_ELM)
	.fs_data = &fat_fs,
#endif
	.mnt_point = MNT_POINT,
};

static const uint8_t mjpeg[] = {
#include "mjpeg.inc"
};
static const size_t mjpeg_sz = sizeof(mjpeg);

static int embed_test_file(void)
{
	struct fs_dirent ent;
	int ret = fs_stat(CONFIG_FILE_INPUT_PATH, &ent);

	if (ret == 0) {
		return 0;
	}

	if (ret != -ENOENT) {
		LOG_ERR("fs_stat(%s) failed (%d)", CONFIG_FILE_INPUT_PATH, ret);
		return ret;
	}

	if (mjpeg_sz == 0) {
		LOG_ERR("MJPEG test file not available");
		return -ENOENT;
	}

	struct fs_file_t f;

	fs_file_t_init(&f);

	ret = fs_open(&f, CONFIG_FILE_INPUT_PATH, FS_O_CREATE | FS_O_WRITE);
	if (ret != 0) {
		LOG_ERR("fs_open(%s) failed (%d)", CONFIG_FILE_INPUT_PATH, ret);
		return ret;
	}

	ssize_t w = fs_write(&f, mjpeg, mjpeg_sz);

	if (w < 0 || (size_t)w != mjpeg_sz) {
		LOG_ERR("fs_write failed (%d)", (int)w);
		(void)fs_close(&f);
		return (w < 0) ? (int)w : -EIO;
	}

	(void)fs_close(&f);
	LOG_INF("Created %s (%u bytes)", CONFIG_FILE_INPUT_PATH, (unsigned int)mjpeg_sz);
	return 0;
}

static int mount_sd(void)
{
	int ret = fs_mount(&mnt);

	if (ret != 0) {
		LOG_ERR("fs_mount failed (%d)", ret);
		return ret;
	}

	LOG_INF("SDCard mounted at %s", MNT_POINT);
	return embed_test_file();
}

static struct mpipe pipe;
static struct mpipe_file_src file_src;
static struct mpipe_img_jpeg_parser jpeg_parser;
static struct mpipe_caps_filter caps_filter;
static struct mpipe_tee tee;
static struct mpipe_queue queue1;
static struct mpipe_img_jpeg_decoder jpeg_dec;
static struct mpipe_disp_sink disp_sink;
static struct mpipe_queue queue2;
static struct mpipe_file_sink file_sink;
static struct mpipe_player player;

int main(void)
{
	int ret;

	ret = mount_sd();
	if (ret != 0) {
		goto err;
	}

	/* Initialize all elements */
	MPIPE_ELEMENT_INIT(&pipe, mpipe_pipeline_init, PIPE_ID);
	MPIPE_ELEMENT_INIT(&file_src, mpipe_file_src_init, FILE_SRC_ID);
	MPIPE_ELEMENT_INIT(&jpeg_parser, mpipe_img_jpeg_parser_init, JPEG_PARSER_ID);
	MPIPE_ELEMENT_INIT(&caps_filter, mpipe_caps_filter_init, CAPS_FILTER_ID);
	MPIPE_ELEMENT_INIT(&tee, mpipe_tee_init, TEE_ID);
	MPIPE_ELEMENT_INIT(&queue1, mpipe_queue_init, QUEUE1_ID);
	MPIPE_ELEMENT_INIT(&jpeg_dec, mpipe_img_jpeg_decoder_init, JPEG_DEC_ID);
	MPIPE_ELEMENT_INIT(&disp_sink, mpipe_disp_sink_init, DISP_SINK_ID);
	MPIPE_ELEMENT_INIT(&queue2, mpipe_queue_init, QUEUE2_ID);
	MPIPE_ELEMENT_INIT(&file_sink, mpipe_file_sink_init, FILE_SINK_ID);

	/* Set properties */
	ret = mpipe_object_set_properties((struct mpipe_object *)&file_src, MPIPE_PROP_FS_SRC_PATH,
					  CONFIG_FILE_INPUT_PATH, MPIPE_PROP_LIST_END);
	if (ret < 0) {
		LOG_ERR("Failed to set file_src properties (%d)", ret);
		goto err;
	}

	ret = mpipe_object_set_properties((struct mpipe_object *)&file_sink,
					  MPIPE_PROP_FS_SINK_PATH, CONFIG_FILE_OUTPUT_PATH,
					  MPIPE_PROP_LIST_END);
	if (ret < 0) {
		LOG_ERR("Failed to set file_sink properties (%d)", ret);
		goto err;
	}

	/* Set caps filter to constrain negotiation with JPEG format + resolution */
	{
		struct mpipe_structure caps;

		ret = mpipe_structure_init_fields(
			&caps, MPIPE_MEDIA_VIDEO, MPIPE_CAPS_PIXEL_FORMAT, MPIPE_TYPE_UINT,
			VIDEO_PIX_FMT_JPEG, MPIPE_CAPS_IMAGE_WIDTH, MPIPE_TYPE_UINT,
			CONFIG_JPEG_IMAGE_WIDTH, MPIPE_CAPS_IMAGE_HEIGHT, MPIPE_TYPE_UINT,
			CONFIG_JPEG_IMAGE_HEIGHT, MPIPE_CAPS_END);

		if (ret != 0) {
			LOG_ERR("Failed to create caps");
			goto err;
		}

		ret = mpipe_object_set_properties((struct mpipe_object *)&caps_filter,
						  MPIPE_PROP_BASE_CAPS_FILTER_CAPS, &caps,
						  MPIPE_PROP_LIST_END);
		if (ret < 0) {
			LOG_ERR("Failed to set caps_filter properties (%d)", ret);
			goto err;
		}
	}

	/* Add all elements to the pipeline bin */
	ret = mpipe_bin_add((struct mpipe_bin *)&pipe, (struct mpipe_element *)&file_src,
			    (struct mpipe_element *)&jpeg_parser,
			    (struct mpipe_element *)&caps_filter, (struct mpipe_element *)&tee,
			    (struct mpipe_element *)&queue1, (struct mpipe_element *)&jpeg_dec,
			    (struct mpipe_element *)&disp_sink, (struct mpipe_element *)&queue2,
			    (struct mpipe_element *)&file_sink, NULL);
	if (ret < 0) {
		LOG_ERR("Failed to add elements (%d)", ret);
		goto err;
	}

	/* Branch 1: file_src -> jpeg_parser -> caps_filter -> tee -> queue1 ->
	 * jpeg_dec -> disp_sink
	 */
	ret = mpipe_element_link((struct mpipe_element *)&file_src,
				 (struct mpipe_element *)&jpeg_parser,
				 (struct mpipe_element *)&caps_filter, (struct mpipe_element *)&tee,
				 (struct mpipe_element *)&queue1, (struct mpipe_element *)&jpeg_dec,
				 (struct mpipe_element *)&disp_sink, NULL);
	if (ret < 0) {
		LOG_ERR("Failed to link branch 1 (%d)", ret);
		goto err;
	}

	/* Branch 2: tee (2nd srcpad) -> queue2 -> file_sink */
	ret = mpipe_element_link((struct mpipe_element *)&tee, (struct mpipe_element *)&queue2,
				 (struct mpipe_element *)&file_sink, NULL);
	if (ret < 0) {
		LOG_ERR("Failed to link branch 2 (%d)", ret);
		goto err;
	}

	LOG_INF("Pipeline linked.");

	ret = mpipe_player_init(&player, &pipe);
	if (ret != 0) {
		LOG_ERR("Failed to init player (%d)", ret);
		goto err;
	}

	(void)mpipe_player_play(&player);
	(void)mpipe_player_wait_quit(&player);
	(void)mpipe_player_deinit(&player);

	ret = fs_unmount(&mnt);
	if (ret != 0) {
		LOG_ERR("fs_unmount failed (%d)", ret);
	}

	LOG_INF("Done.");

	return 0;

err:
	LOG_ERR("Aborting sample");
	return 0;
}
```
