## CMakeLists.txt
```
# SPDX-License-Identifier: Apache-2.0

cmake_minimum_required(VERSION 3.20.0)
find_package(Zephyr REQUIRED HINTS $ENV{ZEPHYR_BASE})
project(dual_pipeline)

file(GLOB app_sources src/*.c)
target_sources(app PRIVATE ${app_sources})
```

## Kconfig
```
# Copyright (c) 2024 Espressif Systems (Shanghai) Co., Ltd.
# Copyright 2025-2026 NXP
#
# SPDX-License-Identifier: Apache-2.0

mainmenu "Dual pipeline sample"

menu "Dual pipeline configuration"

config USE_I2S_TARGET_CODEC_CONTROLLER
	bool "Use the codec as the I2S clock controller"
	help
	  If enabled, the audio codec acts as the I2S clock controller (target)
	  instead of the SoC I2S peripheral.

config APP_AUDIO_PIPELINE_THREAD_PRIORITY
	int "Audio pipeline thread priority"
	default 0
	help
	  Thread priority for the audio pipeline. The audio pipeline drives a
	  continuous I2S bit clock, so it must preempt the video pipeline thread
	  (which performs long per-frame CPU bursts) to avoid I2S TX underruns.
	  Set this to a numerically lower value than the video pipeline thread
	  priority (CONFIG_MPIPE_THREAD_DEFAULT_PRIORITY).

config APP_VIDEO_PIPELINE_THREAD_PRIORITY
	int "Video pipeline thread priority"
	default 4
	help
	  Thread priority for the video pipeline. Should be numerically higher
	  (lower urgency) than APP_AUDIO_PIPELINE_THREAD_PRIORITY so the audio
	  pipeline can preempt long video-frame processing bursts.

menu "Video pipeline configuration"

config VIDEO_SOURCE_CROP_LEFT
	int "Crop area left value"
	default 0
	help
	   Left value of the crop area within the video source.

config VIDEO_SOURCE_CROP_TOP
	int "Crop area top value"
	default 0
	help
	   Top value of the crop area within the video source.

config VIDEO_SOURCE_CROP_WIDTH
	int "Crop area width value"
	default 0
	help
	   Width value of the crop area within the video source.
	   If set to 0, the crop is not applied.

config VIDEO_SOURCE_CROP_HEIGHT
	int "Crop area height value"
	default 0
	help
	   Height value of the crop area within the video source.
	   If set to 0, the crop is not applied.

config VIDEO_FRAME_HEIGHT
	int "Height of the video frame"
	default 0
	help
	  Height of the video frame. If set to 0, the default height is used.

config VIDEO_FRAME_WIDTH
	int "Width of the video frame"
	default 0
	help
	  Width of the video frame. If set to 0, the default width is used.

config VIDEO_FRAME_RATE
	int "Frame rate of the video stream"
	default 0
	help
	  Frame rate of the video stream. If set to 0, the default frame rate is used.

config VIDEO_PIXEL_FORMAT
	string "Pixel format of the video frame"
	help
	  Pixel format of the video frame. If not set, the default pixel format is used.

config VIDEO_CTRL_HFLIP
	int "Mirror the video frame horizontally"
	range 0 1
	default 0
	help
	  If set, mirror the video frame horizontally

config VIDEO_CTRL_VFLIP
	int "Mirror the video frame vertically"
	range 0 1
	default 0
	help
	  If set, mirror the video frame vertically

config VIDEO_ROTATION_ANGLE
	int "Rotate the video frame by a specified angle"
	range 0 270
	default 0
	help
	   Specify one of these values {0, 90, 180, 270} in degree to rotate the video frame

config PROP_NUM_BUFS
	int "Number of buffers the source provides before stopping"
	default 0
	help
	   If not set or set to 0, the source will run forever

endmenu

endmenu

source "Kconfig.zephyr"
```

## prj.conf
```kconfig
CONFIG_LOG=y

CONFIG_MPIPE=y
CONFIG_MPIPE_STRUCTURE_MAX_FIELDS=30
CONFIG_MPIPE_THREADS_NUM=2
# Shared net_buf pool must cover the sum of the maximum in-flight buffers of
# every running pipeline. Two pipelines run at once here, so size it larger
# than the single-pipeline default of 1.
CONFIG_MPIPE_NET_BUF_POOL_COUNT=16
CONFIG_MPIPE_BASE=y

CONFIG_MPIPE_BASE_CAPS_FILTER=y

# Audio pipeline
CONFIG_MPIPE_AUD=y
CONFIG_AUDIO_DMIC=y
CONFIG_AUDIO_CODEC=y
CONFIG_I2S=y

# Video pipeline
CONFIG_MPIPE_VID=y
CONFIG_MPIPE_DISP=y

# The audio and video pipeline threads run at the same preemptible priority
# (CONFIG_MPIPE_THREAD_DEFAULT_PRIORITY). The video pipeline does a long CPU
# burst (720p pixel conversion) which, without time-slicing, would run to
# completion and starve the audio pipeline thread. The I2S sink drives a
# continuous bit clock, so if its TX queue is not refilled in time it
# underruns. Enable time-slicing so the audio thread can preempt the video
# thread's long CPU bursts and keep the I2S TX queue fed.
CONFIG_TIMESLICING=y
CONFIG_TIMESLICE_SIZE=5


# Each pipeline is driven by its own mpipe player instance. The player layer
# supports several concurrent players; size it for the two pipelines run here.
CONFIG_MPIPE_PLAYER=y
CONFIG_MPIPE_PLAYER_NUM=2
CONFIG_MPIPE_PLAYER_WORKER_STACK_SIZE=64000

# Shell
CONFIG_SHELL=y
CONFIG_SHELL_STACK_SIZE=64000

CONFIG_MAIN_STACK_SIZE=64000
```

## boards/mimxrt1170_evk_mimxrt1176_cm7.conf
```kconfig
#
# Copyright 2026 NXP
#
# SPDX-License-Identifier: Apache-2.0
#

# Audio pipeline
CONFIG_I3C=y
CONFIG_AUDIO_CODEC=y
CONFIG_AUDIO_CODEC_WM8962=y
# A 40ms audio frame at 48kHz/16-bit/2ch is 7680 bytes, so each buffer must be
# at least 8192 bytes. Keep a deep pool so several frames can be in flight at
# once, which keeps the I2S TX queue fed while the video pipeline does its long
# per-frame CPU burst.
CONFIG_MPIPE_AUD_BUFFER_POOL_SZ_MAX=65536

CONFIG_MPIPE_AUD_BUFFER_POOL_NUM_MAX=20

CONFIG_DMA_TCD_QUEUE_SIZE=4

# Video pipeline
CONFIG_VIDEO_BUFFER_POOL_NUM_MAX=3
CONFIG_VIDEO_BUFFER_POOL_HEAP_SIZE=11060400
CONFIG_VIDEO_ROTATION_ANGLE=270
CONFIG_VIDEO_FRAME_WIDTH=1280
CONFIG_VIDEO_FRAME_HEIGHT=720
CONFIG_MPIPE_BASE_CAPS_FILTER=y
```

## boards/native_sim_native_64.conf
```kconfig
#
# Copyright 2026 NXP
#
# SPDX-License-Identifier: Apache-2.0
#

# Shell

# Bind the native PTY UART to stdin/stdout so the shell reads keystrokes typed
# on the launching terminal (otherwise the shell sits on a separate PTY and the
# p/s/r/q commands never receive input).
CONFIG_UART_NATIVE_PTY_0_ON_STDINOUT=y

# Log directly to stdout via the native backend, which is active from boot so
# the boot banner and early log lines (before the shell is up) are printed.
# Disable the shell log backend so those same lines are not printed a second
# time once the shell starts.
CONFIG_LOG_BACKEND_NATIVE_POSIX=y
CONFIG_SHELL_LOG_BACKEND=n

# Threads on native_sim run on host stacks, so this size is never used and
# only reserves memory.
CONFIG_MPIPE_PLAYER_WORKER_STACK_SIZE=64

# Video
CONFIG_VIDEO_FRAME_WIDTH=320
CONFIG_VIDEO_FRAME_HEIGHT=240
CONFIG_MPIPE_BASE_CAPS_FILTER=y

CONFIG_AUDIO_CODEC=y
CONFIG_AUDIO_CODEC_DUMMY=y
CONFIG_AUDIO_DMIC=y
CONFIG_AUDIO_DMIC_NATIVE_SIM=y
CONFIG_I2S=y
CONFIG_I2S_NATIVE_SIM=y

CONFIG_MPIPE_AUD_BUFFER_POOL_SZ_MAX=4096
CONFIG_MPIPE_AUD_BUFFER_POOL_NUM_MAX=8

CONFIG_I2S_NATIVE_SIM_TX_FILE_PATH="build/native_sim_audio_pipeline_tx.pcm"
```

## src/main.c
```c
/*
 * Copyright 2025-2026 NXP
 *
 * SPDX-License-Identifier: Apache-2.0
 */

#include <zephyr/kernel.h>
#include <zephyr/zbus/zbus.h>
#include <zephyr/logging/log.h>
#include <zephyr/sys/util_macro.h>

#include <zephyr/mpipe/mpipe.h>
#include <zephyr/mpipe/mpipe_message.h>
#include <zephyr/mpipe/utils/mpipe_player.h>

#include <zephyr/mpipe/aud/mpipe_aud.h>
#include <zephyr/mpipe/aud/mpipe_aud_src.h>
#include <zephyr/mpipe/aud/mpipe_aud_i2s_codec_sink.h>
#include <zephyr/mpipe/aud/mpipe_aud_gain.h>
#include <zephyr/mpipe/aud/mpipe_aud_dmic_src.h>
#include <zephyr/mpipe/aud/mpipe_aud_buffer_pool.h>

#include <zephyr/drivers/video.h>
#include <zephyr/video/controls.h>
#include <zephyr/mpipe/disp/mpipe_disp_sink.h>
#include <zephyr/mpipe/vid/mpipe_vid_src.h>
#if DT_HAS_CHOSEN(zephyr_jpegdec) || DT_HAS_CHOSEN(zephyr_videotrans)
#include <zephyr/mpipe/vid/mpipe_vid_transform.h>
#endif
#if DT_HAS_CHOSEN(zephyr_jpegdec)
#include <zephyr/mpipe/vid/mpipe_vid_convert.h>
#endif

#if defined(CONFIG_MPIPE_BASE_CAPS_FILTER)
#include <zephyr/mpipe/base/mpipe_caps_filter.h>
#endif

LOG_MODULE_REGISTER(main, CONFIG_LOG_DEFAULT_LEVEL);

/*
 * Element IDs only need to be unique within a single pipeline. Each pipeline
 * has its own enum starting at 0.
 */
enum {
	AUD_PIPE_ID,
	AUD_DMIC_SRC_ID,
	AUD_CAPS_FILTER_ID,
	AUD_GAIN_ID,
	AUD_I2S_SINK_ID,
};

/*
 * WORKAROUND: Direct memory slab management in application code.
 *
 * TODO: Normally, applications should not set this because they do not need to
 * know about the memory slab audio buffers implementation.
 *
 * The __nocache attribute ensures this memory is not cached, which is required
 * for DMA operations used by audio hardware.
 */
__nocache struct k_mem_slab aud_mem_slab;

static struct mpipe aud_pipe;
static struct mpipe_player aud_player;
static struct mpipe_aud_dmic_src aud_source;
static struct mpipe_aud_gain aud_gain;
static struct mpipe_aud_i2s_codec_sink aud_sink;

#if defined(CONFIG_MPIPE_BASE_CAPS_FILTER)
static struct mpipe_caps_filter aud_caps_filter;
#endif

enum {
	VID_PIPE_ID = 1,
	VID_SRC_ID,
	VID_CAPS_FILTER_ID,
	VID_JPEG_DEC_ID,
	VID_CONV_ID,
	VID_TRANS_ID,
	VID_DISP_SINK_ID,
};

static struct mpipe vid_pipe;
static struct mpipe_player vid_player;
static struct mpipe_vid_src vid_src;
static struct mpipe_disp_sink disp_sink;

#if defined(CONFIG_MPIPE_BASE_CAPS_FILTER)
static struct mpipe_caps_filter vid_caps_filter;
#endif
#if (DT_HAS_CHOSEN(zephyr_jpegdec))
static struct mpipe_vid_transform jpeg_dec;
static struct mpipe_vid_convert vid_conv;
#endif
#if (DT_HAS_CHOSEN(zephyr_videotrans))
static struct mpipe_vid_transform vid_trans;
#endif

static int audio_pipeline_build(void)
{
	int gain_val = 90; /* Set gain to 90% (0.9x amplification) */
	int ret;

	ret = mpipe_pipeline_init(&aud_pipe, AUD_PIPE_ID);
	if (ret < 0) {
		return ret;
	}
	ret = mpipe_aud_dmic_src_init(&aud_source, AUD_DMIC_SRC_ID);
	if (ret < 0) {
		return ret;
	}
	ret = mpipe_aud_gain_init(&aud_gain, AUD_GAIN_ID);
	if (ret < 0) {
		return ret;
	}
	ret = mpipe_aud_i2s_codec_sink_init(&aud_sink, AUD_I2S_SINK_ID);
	if (ret < 0) {
		return ret;
	}

	ret = mpipe_object_set_properties((struct mpipe_object *)&aud_source,
					  MPIPE_PROP_AUD_SRC_SLAB_PTR, &aud_mem_slab,
					  MPIPE_PROP_LIST_END);
	if (ret < 0) {
		LOG_ERR("Failed to set properties for audio source element");
		return ret;
	}

	ret = mpipe_object_set_properties(
		(struct mpipe_object *)&aud_sink, MPIPE_PROP_AUD_SINK_SLAB_PTR, &aud_mem_slab,
#if (defined(CONFIG_USE_I2S_TARGET_CODEC_CONTROLLER) && CONFIG_USE_I2S_TARGET_CODEC_CONTROLLER == 1)
		MPIPE_PROP_AUD_SINK_CLK_ROLE, MPIPE_AUD_I2S_TARGET_CODEC_CONTROLLER,
#endif
		MPIPE_PROP_LIST_END);
	if (ret < 0) {
		LOG_ERR("Failed to set properties for audio sink element");
		return ret;
	}

	ret = mpipe_object_set_properties((struct mpipe_object *)&aud_gain,
					  MPIPE_PROP_AUD_TRANSFORM_GAIN, &gain_val,
					  MPIPE_PROP_LIST_END);
	if (ret < 0) {
		LOG_ERR("Failed to set properties for gain element");
		return ret;
	}

#if defined(CONFIG_MPIPE_BASE_CAPS_FILTER)
	ret = mpipe_caps_filter_init(&aud_caps_filter, AUD_CAPS_FILTER_ID);
	if (ret < 0) {
		return ret;
	}

	struct mpipe_structure aud_caps;

	ret = mpipe_structure_init_fields(
		&aud_caps, MPIPE_MEDIA_AUDIO_PCM, MPIPE_CAPS_FRAME_INTERVAL, MPIPE_TYPE_UINT, 10000,
		MPIPE_CAPS_NUM_OF_CHANNEL, MPIPE_TYPE_UINT, 2, MPIPE_CAPS_END);
	if (ret != 0) {
		LOG_ERR("Failed to create audio caps");
		return ret;
	}

	ret = mpipe_object_set_properties((struct mpipe_object *)&aud_caps_filter,
					  MPIPE_PROP_BASE_CAPS_FILTER_CAPS, &aud_caps,
					  MPIPE_PROP_LIST_END);
	if (ret < 0) {
		LOG_ERR("Failed to set properties for audio caps filter element");
		return ret;
	}
#endif /* CONFIG_MPIPE_BASE_CAPS_FILTER */

	/* clang-format off */
	/* Add elements to the pipeline - order does not matter */
	ret = mpipe_bin_add((struct mpipe_bin *)&aud_pipe,
			(struct mpipe_element *)&aud_source,
			IF_ENABLED(CONFIG_MPIPE_BASE_CAPS_FILTER,
				   ((struct mpipe_element *)&aud_caps_filter,))
			(struct mpipe_element *)&aud_gain,
			(struct mpipe_element *)&aud_sink, NULL);
	if (ret < 0) {
		LOG_ERR("Failed to add audio elements (%d)", ret);
		return ret;
	}

	/* Link elements together - order does matter */
	ret = mpipe_element_link((struct mpipe_element *)&aud_source,
			IF_ENABLED(CONFIG_MPIPE_BASE_CAPS_FILTER,
				   ((struct mpipe_element *)&aud_caps_filter,))
			(struct mpipe_element *)&aud_gain,
			(struct mpipe_element *)&aud_sink, NULL);
	if (ret < 0) {
		LOG_ERR("Failed to link audio elements (%d)", ret);
		return ret;
	}
	/* clang-format on */

	return 0;
}

static int video_pipeline_build(void)
{
	int ret;

	ret = mpipe_pipeline_init(&vid_pipe, VID_PIPE_ID);
	if (ret < 0) {
		return ret;
	}
	ret = mpipe_vid_src_init(&vid_src, VID_SRC_ID);
	if (ret < 0) {
		return ret;
	}
	ret = mpipe_disp_sink_init(&disp_sink, VID_DISP_SINK_ID);
	if (ret < 0) {
		return ret;
	}

	struct video_rect __maybe_unused crop = {
		CONFIG_VIDEO_SOURCE_CROP_LEFT, CONFIG_VIDEO_SOURCE_CROP_TOP,
		CONFIG_VIDEO_SOURCE_CROP_WIDTH, CONFIG_VIDEO_SOURCE_CROP_HEIGHT};

	/* clang-format off */
	ret = mpipe_object_set_properties((struct mpipe_object *)&vid_src,
		COND_CODE_0(CONFIG_PROP_NUM_BUFS, (),
			    (MPIPE_PROP_SRC_NUM_BUFS, CONFIG_PROP_NUM_BUFS,))
		COND_CODE_0(CONFIG_VIDEO_SOURCE_CROP_WIDTH, (), (MPIPE_PROP_VID_CROP, &crop,))
		IF_ENABLED(CONFIG_VIDEO_CTRL_HFLIP, (VIDEO_CID_HFLIP, CONFIG_VIDEO_CTRL_HFLIP,))
		IF_ENABLED(CONFIG_VIDEO_CTRL_VFLIP, (VIDEO_CID_VFLIP, CONFIG_VIDEO_CTRL_VFLIP,))
		MPIPE_PROP_LIST_END);
	/* clang-format on */
	if (ret < 0) {
		return ret;
	}

#if defined(CONFIG_MPIPE_BASE_CAPS_FILTER)
	ret = mpipe_caps_filter_init(&vid_caps_filter, VID_CAPS_FILTER_ID);
	if (ret < 0) {
		return ret;
	}

	/* clang-format off */
	struct mpipe_structure vid_caps;
	struct mpipe_value pixfmt;

	ret = mpipe_structure_init_fields(&vid_caps, MPIPE_MEDIA_VIDEO,
		COND_CODE_0(CONFIG_VIDEO_FRAME_WIDTH,
			(), (MPIPE_CAPS_IMAGE_WIDTH, MPIPE_TYPE_UINT, CONFIG_VIDEO_FRAME_WIDTH,))
		COND_CODE_0(CONFIG_VIDEO_FRAME_HEIGHT,
			(), (MPIPE_CAPS_IMAGE_HEIGHT, MPIPE_TYPE_UINT, CONFIG_VIDEO_FRAME_HEIGHT,))
		COND_CODE_0(CONFIG_VIDEO_FRAME_RATE, (),
			(MPIPE_CAPS_FRAME_INTERVAL, MPIPE_TYPE_UINT,
			 MPIPE_FRAME_INTERVAL_FROM_FPS(CONFIG_VIDEO_FRAME_RATE),))
		MPIPE_CAPS_END);
	/* clang-format on */
	if (ret != 0) {
		return ret;
	}

	if (strcmp(CONFIG_VIDEO_PIXEL_FORMAT, "") != 0) {
		mpipe_value_set(&pixfmt, MPIPE_TYPE_UINT,
				VIDEO_FOURCC_FROM_STR(CONFIG_VIDEO_PIXEL_FORMAT));
		mpipe_structure_append_value(&vid_caps, MPIPE_CAPS_PIXEL_FORMAT, &pixfmt);
	}

	ret = mpipe_object_set_properties((struct mpipe_object *)&vid_caps_filter,
					  MPIPE_PROP_BASE_CAPS_FILTER_CAPS, &vid_caps,
					  MPIPE_PROP_LIST_END);
	if (ret < 0) {
		return ret;
	}
#endif /* CONFIG_MPIPE_BASE_CAPS_FILTER */

#if (DT_HAS_CHOSEN(zephyr_jpegdec))
	ret = mpipe_vid_transform_init(&jpeg_dec, VID_JPEG_DEC_ID);
	if (ret < 0) {
		return ret;
	}
	ret = mpipe_vid_convert_init(&vid_conv, VID_CONV_ID);
	if (ret < 0) {
		return ret;
	}

	ret = mpipe_object_set_properties((struct mpipe_object *)&jpeg_dec, MPIPE_PROP_VID_DEVICE,
					  DEVICE_DT_GET_OR_NULL(DT_CHOSEN(zephyr_jpegdec)),
					  MPIPE_PROP_LIST_END);
	if (ret < 0) {
		return ret;
	}
#endif /* DT_HAS_CHOSEN(zephyr_jpegdec) */

#if (DT_HAS_CHOSEN(zephyr_videotrans))
	ret = mpipe_vid_transform_init(&vid_trans, VID_TRANS_ID);
	if (ret < 0) {
		return ret;
	}

	/* clang-format off */
	ret = mpipe_object_set_properties((struct mpipe_object *)&vid_trans,
		COND_CODE_0(CONFIG_VIDEO_ROTATION_ANGLE,
			(), (VIDEO_CID_ROTATE, CONFIG_VIDEO_ROTATION_ANGLE,)) MPIPE_PROP_LIST_END);
	/* clang-format on */
	if (ret < 0) {
		return ret;
	}
#endif /* DT_HAS_CHOSEN(zephyr_videotrans) */

	/* clang-format off */
	/* Add elements to the pipeline - order does not matter */
	ret = mpipe_bin_add((struct mpipe_bin *)&vid_pipe,
			(struct mpipe_element *)&vid_src,
			IF_ENABLED(CONFIG_MPIPE_BASE_CAPS_FILTER,
				   ((struct mpipe_element *)&vid_caps_filter,))
			IF_ENABLED(DT_HAS_CHOSEN(zephyr_jpegdec),
				   ((struct mpipe_element *)&jpeg_dec,))
			IF_ENABLED(DT_HAS_CHOSEN(zephyr_jpegdec),
				   ((struct mpipe_element *)&vid_conv,))
			IF_ENABLED(DT_HAS_CHOSEN(zephyr_videotrans),
				   ((struct mpipe_element *)&vid_trans,))
			(struct mpipe_element *)&disp_sink, NULL);
	if (ret < 0) {
		LOG_ERR("Failed to add video elements (%d)", ret);
		return ret;
	}

	/* Link elements together - order does matter */
	ret = mpipe_element_link((struct mpipe_element *)&vid_src,
			IF_ENABLED(CONFIG_MPIPE_BASE_CAPS_FILTER,
				   ((struct mpipe_element *)&vid_caps_filter,))
			IF_ENABLED(DT_HAS_CHOSEN(zephyr_jpegdec),
				   ((struct mpipe_element *)&jpeg_dec,))
			IF_ENABLED(DT_HAS_CHOSEN(zephyr_jpegdec),
				   ((struct mpipe_element *)&vid_conv,))
			IF_ENABLED(DT_HAS_CHOSEN(zephyr_videotrans),
				   ((struct mpipe_element *)&vid_trans,))
			(struct mpipe_element *)&disp_sink, NULL);
	if (ret < 0) {
		LOG_ERR("Failed to link video elements (%d)", ret);
		return ret;
	}
	/* clang-format on */

	return 0;
}

int main(void)
{
	int ret = 0;

	ret = audio_pipeline_build();
	if (ret < 0) {
		goto err;
	}

	ret = video_pipeline_build();
	if (ret < 0) {
		goto err;
	}

	/*
	 * Give each pipeline its own player. Each player registers with
	 * the mpipe_player layer, so the shell commands and single-letter
	 * shortcuts (p/s/r/q) drive every pipeline at once.
	 */
	ret = mpipe_player_init(&aud_player, &aud_pipe);
	if (ret != 0) {
		LOG_ERR("Failed to init audio player (%d)", ret);
		goto err_deinit;
	}

	ret = mpipe_player_init(&vid_player, &vid_pipe);
	if (ret != 0) {
		LOG_ERR("Failed to init video player (%d)", ret);
		goto err_deinit;
	}

	ret = mpipe_object_set_properties(
		(struct mpipe_object *)&aud_pipe, MPIPE_PROP_PIPELINE_THREAD_PRIORITY,
		&(intptr_t){CONFIG_APP_AUDIO_PIPELINE_THREAD_PRIORITY}, MPIPE_PROP_LIST_END);
	if (ret != 0) {
		LOG_ERR("Failed to set audio pipeline thread priority (%d)", ret);
		goto err_deinit;
	}

	ret = mpipe_object_set_properties(
		(struct mpipe_object *)&vid_pipe, MPIPE_PROP_PIPELINE_THREAD_PRIORITY,
		&(intptr_t){CONFIG_APP_VIDEO_PIPELINE_THREAD_PRIORITY}, MPIPE_PROP_LIST_END);
	if (ret != 0) {
		LOG_ERR("Failed to set video pipeline thread priority (%d)", ret);
		goto err_deinit;
	}

	LOG_INF("Starting dual pipeline (aud prio %d, vid prio %d)",
		CONFIG_APP_AUDIO_PIPELINE_THREAD_PRIORITY,
		CONFIG_APP_VIDEO_PIPELINE_THREAD_PRIORITY);

	// (void)mpipe_player_play(&aud_player);
	// (void)mpipe_player_play(&vid_player);

	(void)mpipe_player_wait_quit(&aud_player);
	(void)mpipe_player_deinit(&aud_player);

	(void)mpipe_player_wait_quit(&vid_player);
	(void)mpipe_player_deinit(&vid_player);

	LOG_INF("Done.");
	return 0;

err_deinit:
	(void)mpipe_player_deinit(&aud_player);
	(void)mpipe_player_deinit(&vid_player);
err:
	LOG_ERR("Aborting sample");
	return ret != 0 ? ret : -EIO;
}
```
