## CMakeLists.txt
```
cmake_minimum_required(VERSION 3.20.0)
find_package(Zephyr REQUIRED HINTS $ENV{ZEPHYR_BASE})
project(clock)

target_compile_definitions(app PUBLIC __ZEPHYR__)

# Define path to vglite_window folder
set(VGLITE_WINDOW_DIR ${CMAKE_CURRENT_SOURCE_DIR}/../vglite_window)

# Define path to vglite_layer folder
set(VGLITE_LAYER_DIR ${CMAKE_CURRENT_SOURCE_DIR}/../vglite_layer)

# Define path to qoi folder
set(QOI_DIR ${CMAKE_CURRENT_SOURCE_DIR}/../qoi)

# Add sources
target_sources(app PRIVATE
    src/main.c
    ${VGLITE_WINDOW_DIR}/vglite_window.c
    ${VGLITE_LAYER_DIR}/vglite_layer.c
)

# Include directories
target_include_directories(app PRIVATE ${VGLITE_WINDOW_DIR})
target_include_directories(app PRIVATE ${VGLITE_LAYER_DIR})
target_include_directories(app PRIVATE ${QOI_DIR})

# Path to gpu-vglite repo: modules/gpu-vglite
set(GPU_VGLITE_DIR ${ZEPHYR_BASE}/../modules/gpu-vglite)

# Add gpu-vglite so its CMakeLists.txt is processed
add_subdirectory(${GPU_VGLITE_DIR} ${CMAKE_CURRENT_BINARY_DIR}/gpu-vglite)

# Link libraries
target_link_libraries(app PRIVATE vglite)

target_link_libraries(app PRIVATE zephyr_interface)

# Zephyr-specific include directories
zephyr_include_directories(${CMAKE_CURRENT_SOURCE_DIR}/include)
zephyr_include_directories(${ZEPHYR_BASE}/../modules/gpu-vglite)
zephyr_include_directories(${ZEPHYR_BASE}/../modules/gpu-vglite/inc)
zephyr_include_directories(${ZEPHYR_BASE}/include)
zephyr_include_directories(${ZEPHYR_BASE}/include/zephyr)

if(${CONFIG_SOC_PART_NUMBER_MIMXRT1176DVMAA})
  zephyr_include_directories(${ZEPHYR_BASE}/boards/nxp/mimxrt1170_evk)

elseif(${CONFIG_SOC_PART_NUMBER_MIMXRT595SFFOC})
  zephyr_include_directories(${ZEPHYR_BASE}/boards/nxp/mimxrt595_evk)

elseif(${CONFIG_SOC_PART_NUMBER_MIMXRT798SGFOB})
  zephyr_include_directories(${ZEPHYR_BASE}/boards/nxp/mimxrt700_evk)

elseif(${CONFIG_SOC_PART_NUMBER_MIMXRT1166DVM6A})
  zephyr_include_directories(${ZEPHYR_BASE}/boards/nxp/mimxrt1160_evk)

else()
  message(WARNING "Unknown SOC part number — no board include directory set.")
endif()
```

## prj.conf
```kconfig
CONFIG_GPIO=y
CONFIG_LOG=y
CONFIG_LOG_MODE_IMMEDIATE=y
CONFIG_CONSOLE=y
CONFIG_PRINTK=y
CONFIG_HEAP_MEM_POOL_SIZE=2097152
CONFIG_SYS_CLOCK_EXISTS=y
CONFIG_TIMING_FUNCTIONS=y
CONFIG_DISPLAY=y
CONFIG_DISPLAY_MCUX_ELCDIF=y
CONFIG_GPU_DEV=y
CONFIG_GPU_DEV_NAME="GPU"
CONFIG_PM_DEVICE=y
CONFIG_VG_LITE_K_MEM_POOL_SIZE=0x200000
CONFIG_GPU_CLOCK_KHZ=996000
CONFIG_VGLITE=y
```

## src/main.c
```c
/*
 * Copyright 2019, 2021, 2024-2025 NXP
 * All rights reserved.
 *
 * SPDX-License-Identifier: BSD-3-Clause
 */

#include <zephyr/kernel.h>
#include <zephyr/device.h>
#include <zephyr/drivers/display.h>
#include <zephyr/sys/printk.h>
#include <zephyr/sys/util.h>

#include "vglite_layer.h"
#include "clock_analog.h"
#include "hour_needle.h"
#include "minute_needle.h"

#include "vglite_window.h"
/*-----------------------------------------------------------*/
#include "vg_lite.h"

/*******************************************************************************
 * Definitions
 ******************************************************************************/
#define VGLITE_STACK_SIZE 8192 /* Adjust as needed */
#define VGLITE_PRIORITY   0    /* Zephyr: lower number = higher priority */
#define DEFAULT_SIZE      256.0f;

K_THREAD_STACK_DEFINE(vglite_stack, VGLITE_STACK_SIZE);
static struct k_thread vglite_thread;

#define MAX_UI_LAYERS (3)
#define ANALAOG_DIAL  (0)
#define HOUR_NEEDLE   (1)
#define MINUTE_NEEDLE (2)

/*******************************************************************************
 * Prototypes
 ******************************************************************************/
static void vglite_task(void *arg1, void *arg2, void *arg3);

/*******************************************************************************
 * Variables
 ******************************************************************************/
static vg_lite_display_t display;
static vg_lite_window_t window;

/* Clock specific variables */
static vg_lite_matrix_t g_dial_matrix;
static vg_lite_matrix_t g_hour_matrix;
static vg_lite_matrix_t g_minute_matrix;
static vg_lite_float_t win_cx, win_cy;

static UILayers_t g_layers[MAX_UI_LAYERS] = {UI_LAYER_DATA(ClockDial), UI_LAYER_DATA(HourNeedle),
					     UI_LAYER_DATA(MinuteNeedle)};

/*******************************************************************************
 * Code
 ******************************************************************************/

int main(void)
{
	k_tid_t tid =
		k_thread_create(&vglite_thread, vglite_stack, K_THREAD_STACK_SIZEOF(vglite_stack),
				vglite_task, NULL, NULL, NULL, VGLITE_PRIORITY, 0, K_NO_WAIT);

	printk("Thread created, tid=%p\n", tid);

	while (1) {
		k_sleep(K_MSEC(1000));
	}
}

static void cleanup(void)
{
	vg_lite_error_t error;

	for (int i = 0; i < MAX_UI_LAYERS; i++) {
		error = layer_free(&g_layers[i]);
		if (error != VG_LITE_SUCCESS) {
			printk("\r\nERROR: layer_free failed for %s\r\n",
			       g_layers[i].img_info->image_name);
		}
	}
	gradient_cache_free();
	vg_lite_close();
}

static vg_lite_error_t init_vg_lite(vg_lite_display_t *display)
{
	vg_lite_error_t error = VG_LITE_SUCCESS;

	/* Initialize the window. */
	error = VGLITE_CreateWindow(display, &window);
	if (error) {
		printk("VGLITE_CreateWindow failed: VGLITE_CreateWindow() returned error %d\n",
		       error);
		return error;
	}
	/* Set GPU command buffer size for this drawing task. */
	error = vg_lite_set_command_buffer_size(VG_LITE_COMMAND_BUFFER_SIZE);
	if (error) {
		printk("vg_lite_set_command_buffer_size() returned error %d\n", error);
		cleanup();
		return error;
	}
	/* Initialize the draw. */
	error = vg_lite_init(DEFAULT_VG_LITE_TW_WIDTH, DEFAULT_VG_LITE_TW_HEIGHT);
	if (error) {
		printk("vg_lite engine init failed: vg_lite_init() returned error %d\n", error);
		cleanup();
		return error;
	}

	return error;
}

void animateClock(void)
{
	static float angle;

	angle += 0.5;

	vg_lite_identity(&g_hour_matrix);
	vg_lite_translate(win_cx, win_cy, &g_hour_matrix);
	vg_lite_rotate(angle, &g_hour_matrix);

	vg_lite_identity(&g_minute_matrix);
	vg_lite_translate(win_cx, win_cy, &g_minute_matrix);
	vg_lite_rotate(-angle, &g_minute_matrix);
}

static void redraw(void)
{
	vg_lite_buffer_t *rt = VGLITE_GetRenderTarget(&window);

	if (rt == NULL) {
		printk("vg_lite_get_renderTarget error\r\n");
		while (1) {
		}
	}

	/* Draw the path using the matrix. */
	vg_lite_clear(rt, NULL, 0xFFFFFFFF);

	layer_draw(rt, &g_layers[ANALAOG_DIAL], &g_dial_matrix);
	layer_draw(rt, &g_layers[HOUR_NEEDLE], &g_hour_matrix);
	layer_draw(rt, &g_layers[MINUTE_NEEDLE], &g_minute_matrix);
	VGLITE_SwapBuffers(&window);

	animateClock();
}

void init_graphic_assets(void)
{
	int ret = 0;
	vg_lite_error_t error;

	win_cx = window.width / 2.0f;
	win_cy = window.height / 2.0f;

	vg_lite_identity(&g_dial_matrix);
	vg_lite_translate(win_cx - g_layers[ANALAOG_DIAL].img_info->image_size[0] / 2,
			  win_cy - g_layers[ANALAOG_DIAL].img_info->image_size[1] / 2,
			  &g_dial_matrix);

	for (int i = 0; i < MAX_UI_LAYERS; i++) {
		ret = layer_init(&g_layers[i]);
		if (ret != VG_LITE_SUCCESS) {
			printk("\r\nERROR: layer_init failed for %s\r\n",
			       g_layers[i].img_info->image_name);
		}
	}
	error = gradient_cache_init();
	if (error != 0) {
		printk("init_cached_gradient failed: error %d\r\n", error);
		while (1) {
		}
	}
}

uint32_t getTime(void)
{
	return k_uptime_get_32(); /* milliseconds */
}

static void vglite_task(void *arg1, void *arg2, void *arg3)
{
	status_t status;
	vg_lite_error_t error;
	uint32_t startTime, time, n = 0, fps_x_1000;
	const struct device *display_dev;

	display_dev = DEVICE_DT_GET(DT_CHOSEN(zephyr_display));
	if (!device_is_ready(display_dev)) {
		printk("display device not ready\n");
		return;
	}

	display_blanking_off(display_dev);
	struct display_capabilities capabilities;

	display_get_capabilities(display_dev, &capabilities);

	vg_lite_display_t my_display = {.dev = display_dev,
					.width = capabilities.x_resolution,
					.height = capabilities.y_resolution};

	error = init_vg_lite(&my_display);
	if (error) {
		printk("init_vg_lite failed: init_vg_lite() returned error %d\n", error);
		while (1) {
		}
	}

	init_graphic_assets();

	startTime = getTime();
	while (1) {
		redraw();

		n++;
		if (n >= 60) {
			time = getTime() - startTime;
			fps_x_1000 = (n * 1000 * 1000) / time;
			printk("%d frames in %d mSec: %d.%d FPS\r\n", n, time, fps_x_1000 / 1000,
			       fps_x_1000 % 1000);
			n = 0;
			startTime = getTime();
		}
	}
}
```

## include/hour_needle.h
```c
/*
 * Copyright 2019, 2024-2025 NXP
 * All rights reserved.
 *
 * SPDX-License-Identifier: BSD-3-Clause
 */

#include "vglite_layer.h"
#ifndef STATIC_PATH_DEFINES_H
#define STATIC_PATH_DEFINES_H

#include "vg_lite.h"

typedef union data_mnemonic {
	int32_t cmd;
	int32_t data;
} data_mnemonic_t;

typedef struct path_info {
	uint32_t path_length;
	float bounding_box[4];
	int32_t *path_args;
	uint8_t *path_cmds;
	uint8_t end_path_flag;
} path_info_t;

typedef struct stroke_info {
	uint32_t dashPatternCnt;
	float dashPhase;
	float *dashPattern;
	float strokeWidth;
	float miterlimit;
	uint32_t strokeColor;
	vg_lite_cap_style_t linecap;
	vg_lite_join_style_t linejoin;
} stroke_info_t;

typedef struct image_info {
	char *image_name;
	int image_size[2];
	vg_lite_format_t data_format;
	float *transform;
	svg_node_t *render_sequence;
	int drawable_count;
	int path_count;
	stroke_info_t *stroke_info;
	uint8_t image_count;
	image_buf_data_t **raw_images;
	path_info_t paths_info[];
} image_info_t;

typedef struct stopValue {
	float offset;
	uint32_t stop_color;
} stopValue_t;

typedef struct linearGradient {
	uint32_t num_stop_points;
	vg_lite_linear_gradient_parameter_t linear_gradient;
	stopValue_t *stops;
} linearGradient_t;

typedef struct radialGradient {
	uint32_t num_stop_points;
	vg_lite_radial_gradient_parameter_t radial_gradient;
	stopValue_t *stops;
} radialGradient_t;

typedef struct hybridPath {
	fill_mode_t fillType;
	vg_lite_draw_path_type_t pathType;
} hybridPath_t;

typedef struct gradient_mode {
	linearGradient_t **linearGrads;
	radialGradient_t **radialGrads;
	hybridPath_t *hybridPath;
	vg_lite_fill_t *fillRule;
} gradient_mode_t;

typedef struct msg_glyph_item {
	uint16_t g_u16; /* Unicode number of glyph */
	uint16_t k;     /* Horizontal advancement for next glyph */
} msg_glyph_item_t;

typedef struct svg_text_string_data {
	int x, y;               /* Top,left co-ordinates of text region */
	int font_size;          /* font-size for text rendering */
	float *tmatrix;         /* Transform matrix for text area */
	uint32_t text_color;    /* Color value in ARGB format */
	font_info_t *font_face; /* Pointer to pre-defined font-face */
	int msg_len;            /* Length of message in number of unicode bytes */
	int direction;          /* Glyph layout direction */
				/*
				 * Supported: left->right
				 * Unsupported: right->left, top->bottom, bottom->top
				 */
	msg_glyph_item_t *msg_glyphs;
} svg_text_string_data_t;

typedef struct svg_text_info {
	int num_text_strings;
	svg_text_string_data_t *text_strings;
} svg_text_info_t;

#endif

/*path id=path826-3*/
static uint8_t HourNeedle_path_1_cmds[] = {VLC_OP_MOVE,  VLC_OP_CUBIC, VLC_OP_LINE,
					   VLC_OP_CUBIC, VLC_OP_CUBIC, VLC_OP_LINE,
					   VLC_OP_CUBIC, VLC_OP_LINE,  VLC_OP_END};

static int32_t HourNeedle_path_1_args[] = {
	-0.26, 115.57, -2.36, 115.57, -4.36, 113.57, -5.46, 109.47, -5.46, 10.87,  -3.86,
	11.67, -1.96,  12.17, -0.26,  12.17, 1.64,   12.17, 3.34,   11.77, 4.94,   10.87,
	4.94,  109.47, 3.84,  113.57, 1.74,  115.57, -0.26, 115.57, -0.26, 115.57,
};

/*path id=path848*/
static uint8_t HourNeedle_path_2_cmds[] = {VLC_OP_MOVE,  VLC_OP_CUBIC, VLC_OP_CUBIC, VLC_OP_CUBIC,
					   VLC_OP_CUBIC, VLC_OP_LINE,  VLC_OP_END};

static int32_t HourNeedle_path_2_args[] = {
	-0.26,  11.77,  5.94,  11.77,  11.14, 6.67,   11.14,  0.27,  11.14,  -6.03,
	6.14,   -11.23, -0.26, -11.23, -6.66, -11.23, -11.66, -6.03, -11.66, 0.27,
	-11.66, 6.57,   -6.66, 11.77,  -0.26, 11.77,  -0.26,  11.77,
};

/*path id=path851*/
static uint8_t HourNeedle_path_3_cmds[] = {VLC_OP_MOVE,  VLC_OP_CUBIC, VLC_OP_CUBIC, VLC_OP_CUBIC,
					   VLC_OP_CUBIC, VLC_OP_LINE,  VLC_OP_END};

static int32_t HourNeedle_path_3_args[] = {
	-0.26, 4.77,  2.44,  4.77,  4.54,  2.67,  4.54,  -0.03, 4.54,  -2.73,
	2.24,  -4.73, -0.26, -4.73, -2.76, -4.73, -5.06, -2.73, -5.06, -0.03,
	-5.06, 2.67,  -2.96, 4.77,  -0.26, 4.77,  -0.26, 4.77,
};

hybridPath_t HourNeedle_hybrid_path[] = {
	{.fillType = FILL_CONSTANT, .pathType = VG_LITE_DRAW_FILL_PATH},
	{.fillType = NO_FILL_MODE, .pathType = VG_LITE_DRAW_ZERO},
	{.fillType = FILL_CONSTANT, .pathType = VG_LITE_DRAW_FILL_PATH},
	{.fillType = NO_FILL_MODE, .pathType = VG_LITE_DRAW_ZERO},
	{.fillType = FILL_CONSTANT, .pathType = VG_LITE_DRAW_FILL_PATH},
	{.fillType = NO_FILL_MODE, .pathType = VG_LITE_DRAW_ZERO},

};

static vg_lite_fill_t HourNeedle_fill_rule[] = {VG_LITE_FILL_EVEN_ODD, VG_LITE_FILL_EVEN_ODD,
						VG_LITE_FILL_EVEN_ODD};

static gradient_mode_t HourNeedle_gradient_info = {.linearGrads = NULL,
						   .radialGrads = NULL,
						   .hybridPath = HourNeedle_hybrid_path,
						   .fillRule = HourNeedle_fill_rule};

static float HourNeedle_transform_matrix[] = {1.0f, 0.0f, 0.0f, 0.0f, 1.0f, 0.0f, 0.0f, 0.0f, 1.0f,
					      1.0f, 0.0f, 0.0f, 0.0f, 1.0f, 0.0f, 0.0f, 0.0f, 1.0f,
					      1.0f, 0.0f, 0.0f, 0.0f, 1.0f, 0.0f, 0.0f, 0.0f, 1.0f};

static svg_node_t HourNeedle_render_sequence[] = {
	ePathNode,
	ePathNode,
	ePathNode,
};

static image_info_t HourNeedle = {
	.image_name = "HourNeedle",
	.image_size = {400, 400},
	.data_format = VG_LITE_S32,
	.transform = HourNeedle_transform_matrix,
	.render_sequence = HourNeedle_render_sequence,
	.drawable_count = 3,
	.path_count = 3,
	.stroke_info = NULL,
	.image_count = 0,
	.raw_images = (image_buf_data_t **)NULL,
	.text_info = NULL,
	.paths_info = {{.path_cmds = (uint8_t *)HourNeedle_path_1_cmds,
			.path_args = (int32_t *)HourNeedle_path_1_args,
			.path_length = sizeof(HourNeedle_path_1_cmds),
			.end_path_flag = 0,
			.bounding_box = {0.26, 10.87, 5.46, 115.57}},
		       {.path_cmds = (uint8_t *)HourNeedle_path_2_cmds,
			.path_args = (int32_t *)HourNeedle_path_2_args,
			.path_length = sizeof(HourNeedle_path_2_cmds),
			.end_path_flag = 0,
			.bounding_box = {0.26, 6.03, 11.66, 11.77}},
		       {.path_cmds = (uint8_t *)HourNeedle_path_3_cmds,
			.path_args = (int32_t *)HourNeedle_path_3_args,
			.path_length = sizeof(HourNeedle_path_3_cmds),
			.end_path_flag = 0,
			.bounding_box = {0.26, 2.67, 5.06, 4.77}}},
};

uint32_t HourNeedle_color_data[] = {0xff8a3523, 0xff0b0d31, 0xff41e8df};
```

## include/minute_needle.h
```c
/*
 * Copyright 2019, 2024-2025 NXP
 * All rights reserved.
 *
 * SPDX-License-Identifier: BSD-3-Clause
 */

#include "vglite_layer.h"
#ifndef STATIC_PATH_DEFINES_H
#define STATIC_PATH_DEFINES_H

#include "vg_lite.h"

typedef union data_mnemonic {
	int32_t cmd;
	int32_t data;
} data_mnemonic_t;

typedef struct path_info {
	uint32_t path_length;
	float bounding_box[4];
	int32_t *path_args;
	uint8_t *path_cmds;
	uint8_t end_path_flag;
} path_info_t;

typedef struct stroke_info {
	uint32_t dashPatternCnt;
	float dashPhase;
	float *dashPattern;
	float strokeWidth;
	float miterlimit;
	uint32_t strokeColor;
	vg_lite_cap_style_t linecap;
	vg_lite_join_style_t linejoin;
} stroke_info_t;

typedef struct image_info {
	char *image_name;
	int image_size[2];
	vg_lite_format_t data_format;
	float *transform;
	svg_node_t *render_sequence;
	int drawable_count;
	int path_count;
	stroke_info_t *stroke_info;
	uint8_t image_count;
	image_buf_data_t **raw_images;
	path_info_t paths_info[];
} image_info_t;

typedef struct stopValue {
	float offset;
	uint32_t stop_color;
} stopValue_t;

typedef struct linearGradient {
	uint32_t num_stop_points;
	vg_lite_linear_gradient_parameter_t linear_gradient;
	stopValue_t *stops;
} linearGradient_t;

typedef struct radialGradient {
	uint32_t num_stop_points;
	vg_lite_radial_gradient_parameter_t radial_gradient;
	stopValue_t *stops;
} radialGradient_t;

typedef struct hybridPath {
	fill_mode_t fillType;
	vg_lite_draw_path_type_t pathType;
} hybridPath_t;

typedef struct gradient_mode {
	linearGradient_t **linearGrads;
	radialGradient_t **radialGrads;
	hybridPath_t *hybridPath;
	vg_lite_fill_t *fillRule;
} gradient_mode_t;

typedef struct msg_glyph_item {
	uint16_t g_u16; /* Unicode number of glyph */
	uint16_t k;     /* Horizontal advancement for next glyph */
} msg_glyph_item_t;

typedef struct svg_text_string_data {
	int x, y;               /* Top,left co-ordinates of text region */
	int font_size;          /* font-size for text rendering */
	float *tmatrix;         /* Transform matrix for text area */
	uint32_t text_color;    /* Color value in ARGB format */
	font_info_t *font_face; /* Pointer to pre-defined font-face */
	int msg_len;            /* Length of message in number of unicode bytes */
	int direction;          /* Glyph layout direction */
				/*
				 * Supported: left->right
				 * Unsupported: right->left, top->bottom, bottom->top
				 */
	msg_glyph_item_t *msg_glyphs;
} svg_text_string_data_t;

typedef struct svg_text_info {
	int num_text_strings;
	svg_text_string_data_t *text_strings;
} svg_text_info_t;

#endif

/*path id=path951*/
static uint8_t MinuteNeedle_path_1_cmds[] = {VLC_OP_MOVE,  VLC_OP_CUBIC, VLC_OP_CUBIC, VLC_OP_CUBIC,
					     VLC_OP_CUBIC, VLC_OP_LINE,  VLC_OP_END};

static int32_t MinuteNeedle_path_1_args[] = {
	-0.02,  12.30,  6.28,  12.30,  11.38, 7.20,   11.38,  0.90,  11.38,  -5.40,
	6.28,   -10.50, -0.02, -10.50, -6.32, -10.50, -11.42, -5.50, -11.42, 0.80,
	-11.42, 7.10,   -6.32, 12.30,  -0.02, 12.30,  -0.02,  12.30,
};

/*path id=path826-3-3*/
static uint8_t MinuteNeedle_path_2_cmds[] = {VLC_OP_MOVE,  VLC_OP_CUBIC, VLC_OP_LINE,
					     VLC_OP_CUBIC, VLC_OP_CUBIC, VLC_OP_LINE,
					     VLC_OP_CUBIC, VLC_OP_LINE,  VLC_OP_END};

static int32_t MinuteNeedle_path_2_args[] = {
	-0.02, 150.40, -2.02, 150.40, -4.12, 148.40, -5.22, 144.30, -5.22, 11.40,  -3.62,
	12.20, -1.82,  12.70, -0.02,  12.70, 1.78,   12.70, 3.58,   12.30, 5.18,   11.40,
	5.18,  144.30, 4.18,  148.40, 2.08,  150.40, -0.02, 150.40, -0.02, 150.40,
};

/*path id=path953*/
static uint8_t MinuteNeedle_path_3_cmds[] = {VLC_OP_MOVE,  VLC_OP_CUBIC, VLC_OP_CUBIC, VLC_OP_CUBIC,
					     VLC_OP_CUBIC, VLC_OP_LINE,  VLC_OP_END};

static int32_t MinuteNeedle_path_3_args[] = {
	0.19,  5.28,  2.79,  5.28,  4.89,  3.18,  4.89,  0.58,  4.89,  -2.02,
	2.79,  -4.12, 0.19,  -4.12, -2.41, -4.12, -4.51, -2.02, -4.51, 0.58,
	-4.51, 3.08,  -2.41, 5.28,  0.19,  5.28,  0.19,  5.28,
};

hybridPath_t MinuteNeedle_hybrid_path[] = {
	{.fillType = FILL_CONSTANT, .pathType = VG_LITE_DRAW_FILL_PATH},
	{.fillType = NO_FILL_MODE, .pathType = VG_LITE_DRAW_ZERO},
	{.fillType = FILL_CONSTANT, .pathType = VG_LITE_DRAW_FILL_PATH},
	{.fillType = NO_FILL_MODE, .pathType = VG_LITE_DRAW_ZERO},
	{.fillType = FILL_CONSTANT, .pathType = VG_LITE_DRAW_FILL_PATH},
	{.fillType = NO_FILL_MODE, .pathType = VG_LITE_DRAW_ZERO},

};

static vg_lite_fill_t MinuteNeedle_fill_rule[] = {VG_LITE_FILL_EVEN_ODD, VG_LITE_FILL_EVEN_ODD,
						  VG_LITE_FILL_EVEN_ODD};

static gradient_mode_t MinuteNeedle_gradient_info = {.linearGrads = NULL,
						     .radialGrads = NULL,
						     .hybridPath = MinuteNeedle_hybrid_path,
						     .fillRule = MinuteNeedle_fill_rule};

static float MinuteNeedle_transform_matrix[] = {
	1.0f, 0.0f, 0.0f, 0.0f, 1.0f, 0.0f, 0.0f, 0.0f, 1.0f, 1.0f, 0.0f, 0.0f, 0.0f, 1.0f,
	0.0f, 0.0f, 0.0f, 1.0f, 1.0f, 0.0f, 0.0f, 0.0f, 1.0f, 0.0f, 0.0f, 0.0f, 1.0f};

static svg_node_t MinuteNeedle_render_sequence[] = {
	ePathNode,
	ePathNode,
	ePathNode,
};

static image_info_t MinuteNeedle = {
	.image_name = "MinuteNeedle",
	.image_size = {400, 400},
	.data_format = VG_LITE_S32,
	.transform = MinuteNeedle_transform_matrix,
	.render_sequence = MinuteNeedle_render_sequence,
	.drawable_count = 3,
	.path_count = 3,
	.stroke_info = NULL,
	.image_count = 0,
	.raw_images = (image_buf_data_t **)NULL,
	.text_info = NULL,
	.paths_info = {{.path_cmds = (uint8_t *)MinuteNeedle_path_1_cmds,
			.path_args = (int32_t *)MinuteNeedle_path_1_args,
			.path_length = sizeof(MinuteNeedle_path_1_cmds),
			.end_path_flag = 0,
			.bounding_box = {0.02, 5.40, 11.42, 12.30}},
		       {.path_cmds = (uint8_t *)MinuteNeedle_path_2_cmds,
			.path_args = (int32_t *)MinuteNeedle_path_2_args,
			.path_length = sizeof(MinuteNeedle_path_2_cmds),
			.end_path_flag = 0,
			.bounding_box = {0.02, 11.40, 5.22, 150.40}},
		       {.path_cmds = (uint8_t *)MinuteNeedle_path_3_cmds,
			.path_args = (int32_t *)MinuteNeedle_path_3_args,
			.path_length = sizeof(MinuteNeedle_path_3_cmds),
			.end_path_flag = 0,
			.bounding_box = {0.19, 2.02, 4.89, 5.28}}},
};

uint32_t MinuteNeedle_color_data[] = {0xff0b0d31, 0xffe2d945, 0xff41e8df};
```
