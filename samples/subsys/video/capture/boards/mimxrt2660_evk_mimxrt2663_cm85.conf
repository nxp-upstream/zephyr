## subsys/usb/host/class/Kconfig.cdc_ncm
```kconfig
# SPDX-FileCopyrightText: Copyright 2026 NXP
# SPDX-License-Identifier: Apache-2.0

config USBH_CDC_NCM_CLASS
	bool "USB Communication Device Class (NCM) support [EXPERIMENTAL]"
	select EXPERIMENTAL
	select NET_L2_ETHERNET
	help
	  USB Host Communication Device Class - Network Control Model (CDC-NCM)
	  implementation.

	  Enables support for USB CDC-NCM devices (for example, USB Ethernet
	  adapters) and exposes them as Ethernet network interfaces.

if USBH_CDC_NCM_CLASS

config USBH_CDC_NCM_ETH_DRV_NAME
	string "Ethernet interface name"
	default "usbh_cdc_ncm_eth"
	help
	  This option sets the driver name and name of the network interface
	  in your host system. If there are multiple network interfaces
	  defined, then this value is used as a prefix and the interface names
	  will be usbh_cdc_ncm_eth0, usbh_cdc_ncm_eth1, etc.

config USBH_CDC_NCM_MAX_SEGMENT_SIZE
	int "Maximum supported Ethernet frame size"
	default 1514
	range 60 1522
	help
	  Maximum Ethernet frame size (excluding FCS) supported by the host.

	  Typical values (excluding FCS):

	  - 60: Minimum Ethernet frame size
	  - 1514: Standard Ethernet frame (1500 MTU + 14-byte header)
	  - 1522: Ethernet frame with VLAN tag (802.1Q)

	  Used as an upper bound for wMaxSegmentSize in the Ethernet Networking
	  Functional Descriptor.

	  The effective frame size is limited by both the device-reported value
	  and this host setting.

config USBH_CDC_NCM_MAX_NTB_SIZE
	int "Maximum NTB size"
	default 2048
	range 2048 16384
	help
	  Size of the buffers used to build and receive the NCM Transfer Blocks
	  (NTB).

	  This is also used as the initial value for the maximum NTB size the
	  device is allowed to send to the host (SetNtbInputSize), clamped to
	  the maximum size reported by the device. The host shall select at
	  least 2048 bytes (NCM100.pdf, 7.2.7).

config USBH_CDC_NCM_DEFAULT_MAC_ADDR_UNICODE_LANGID
	hex "Default LANGID for MAC address string descriptor"
	default 0x0409
	help
	  This option specifies the default USB language ID (LANGID) used to
	  retrieve the MAC address string descriptor from the CDC-NCM device.

	  If the device does not support the configured LANGID, the driver will
	  automatically fall back to one of the supported LANGIDs reported by
	  the device.

	  Common values:

	  - 0x0409: English (United States) [default]
	  - 0x0804: Chinese (Simplified)

config USBH_CDC_NCM_TX_PIPELINE_DEPTH
	int "TX pipeline depth"
	default 1
	range 1 16
	help
	  Number of concurrent USB bulk OUT transfers used for NTB
	  transmission.

	  Increasing this value improves throughput by allowing multiple
	  transfers to be in flight simultaneously, reducing USB bus idle time.

	  Higher values increase memory usage and latency per packet.

config USBH_CDC_NCM_RX_PIPELINE_DEPTH
	int "RX pipeline depth"
	default 1
	range 1 16
	help
	  Number of concurrent USB bulk IN transfers used for NTB reception.

	  Higher values reduce the likelihood of packet drops by ensuring
	  buffers are available for incoming data and minimizing USB receive
	  stalls, at the cost of additional memory usage.

module = USBH_CDC_NCM
module-str = "usbh cdc_ncm"
default-count = 1
source "subsys/logging/Kconfig.template.log_config"
source "subsys/usb/common/Kconfig.template.instances_count"

endif # USBH_CDC_NCM_CLASS
```

## tests/bluetooth/classic/b2b/ftp_server/testcase.yaml
```yaml
tests:
  bluetooth.classic.ftp.client:
    platform_allow:
    - native_sim
    integration_platforms:
    - native_sim
    tags:
    - bluetooth
    - ftp
    harness: pytest
    harness_config:
      pytest_dut_scope: session
      fixture: usb_hci
    timeout: 1200
  bluetooth.classic.ftp.client.no_blobs:
    platform_allow:
    - mimxrt1170_evk@B/mimxrt1176/cm7
    tags:
    - bluetooth
    - ftp
    extra_args:
    - CONFIG_BUILD_ONLY_NO_BLOBS=y
    timeout: 1200
    build_only: true
```

## tests/bluetooth/classic/bumble/rfcomm/Kconfig
```kconfig
# SPDX-FileCopyrightText: Copyright 2026 NXP
#
# SPDX-License-Identifier: Apache-2.0


config TEST_RFCOMM_MAX_CHANNEL_COUNT
	int "Maximum RFCOMM channel count"
	depends on BT_RFCOMM
	default 16
	range 2 255
	help
	  The maximum number of RFCOMM channels that can be created for testing.

config BT_BUF_ACL_RX_COUNT_EXTRA
	default TEST_RFCOMM_MAX_CHANNEL_COUNT

source "Kconfig.zephyr"

module = TEST_CLASSIC_RFCOMM_SIM
module-str = test_classic_rfcomm_sim
source "subsys/logging/Kconfig.template.log_config"
```

## tests/subsys/mp/build_all/testcase.yaml
```yaml
tests:
  libmp.core.build:
    tags:
      - subsys
      - mp
    platform_allow:
      - native_sim
      - native_sim/native/64
      - mimxrt1170_evk@B/mimxrt1176/cm7
      - mimxrt685_evk/mimxrt685s/cm33
    build_only: true

  libmp.video_plugin.build:
    tags:
      - subsys
      - mp
    build_only: true
    platform_allow:
      - native_sim
      - native_sim/native/64
      - mimxrt1170_evk@B/mimxrt1176/cm7
    extra_args:
      - platform:mimxrt1170_evk/mimxrt1176/cm7:SHIELD="nxp_btb44_ov5640;rk055hdmipi4ma0"
      - platform:mimxrt1170_evk@B/mimxrt1176/cm7:SHIELD="nxp_btb44_ov5640;rk055hdmipi4ma0"
      - CONFIG_MP_PLUGIN_ZVID=y
      - CONFIG_MP_PLUGIN_ZDISP=y
      - CONFIG_VIDEO=y
      - CONFIG_DISPLAY=y
      - CONFIG_MP_PLUGIN_ZJPEG=y

  libmp.fs_plugin.build:
    tags:
      - subsys
      - mp
    build_only: true
    platform_allow:
      - native_sim
      - native_sim/native/64
      - mimxrt1170_evk@B/mimxrt1176/cm7
    extra_args:
      - CONFIG_MP_PLUGIN_ZFS=y

  libmp.audio_plugin.build:
    tags:
      - subsys
      - mp
    build_only: true
    platform_allow:
      - mimxrt685_evk/mimxrt685s/cm33
    extra_args:
      - CONFIG_I2S=y
      - CONFIG_AUDIO=y
      - CONFIG_AUDIO_DMIC=y
      - CONFIG_AUDIO_CODEC=y
      - CONFIG_MP_PLUGIN_ZAUD=y

  libmp.zbase.build:
    tags:
      - subsys
      - mp
    build_only: true
    platform_allow:
      - native_sim
      - native_sim/native/64
      - qemu_x86
      - mimxrt1170_evk@B/mimxrt1176/cm7
    extra_args:
      - CONFIG_MP_PLUGIN_ZBASE=y
      - CONFIG_MP_CAPSFILTER=y
```

## tests/subsys/mp/core/pipeline/testcase.yaml
```yaml
tests:
  subsys.mp.core.pipeline:
    platform_allow:
      - native_sim/native/64
      - qemu_x86
    tags:
      - mp
      - pipeline
    integration_platforms:
      - native_sim/native/64
```

## tests/subsys/mp/core/unit/testcase.yaml
```yaml
tests:
  subsys.mp.core.unit:
    platform_allow:
      - native_sim/native/64
      - qemu_x86
    tags:
      - mp
      - unit
    integration_platforms:
      - native_sim/native/64
    timeout: 60 # Maximum execution time for a test
```
