## soc/nxp/mcx/mcxc/Kconfig.soc
```kconfig
# Copyright 2024 NXP
# SPDX-License-Identifier: Apache-2.0

config SOC_FAMILY_MCXC
	bool

config SOC_FAMILY
	default "mcxc" if SOC_FAMILY_MCXC

config SOC_MCXC141
	bool
	select SOC_FAMILY_MCXC

config SOC_MCXC142
	bool
	select SOC_FAMILY_MCXC

config SOC_MCXC242
	bool
	select SOC_FAMILY_MCXC

config SOC_MCXC444
	bool
	select SOC_FAMILY_MCXC

config SOC_MCXC454
	bool
	select SOC_FAMILY_MCXC

config SOC
	default "mcxc141" if SOC_MCXC141
	default "mcxc142" if SOC_MCXC142
	default "mcxc242" if SOC_MCXC242
	default "mcxc444" if SOC_MCXC444
	default "mcxc454" if SOC_MCXC454

config SOC_PART_NUMBER_MCXC141VLH
	bool

config SOC_PART_NUMBER_MCXC141VFM
	bool

config SOC_PART_NUMBER_MCXC142VFM
	bool

config SOC_PART_NUMBER_MCXC242VLH
	bool

config SOC_PART_NUMBER_MCXC242VFM
	bool

config SOC_PART_NUMBER_MCXC444VLH
	bool

config SOC_PART_NUMBER_MCXC444VMP
	bool

config SOC_PART_NUMBER_MCXC454VFM
	bool

config SOC_PART_NUMBER_MCXC454VFT
	bool

config SOC_PART_NUMBER_MCXC454VLF
	bool

config SOC_PART_NUMBER_MCXC454VLH
	bool

config SOC_PART_NUMBER_MCXC454VLK
	bool

config SOC_PART_NUMBER_MCXC454VMP
	bool

config SOC_PART_NUMBER
	default "MCXC141VLH" if SOC_PART_NUMBER_MCXC141VLH
	default "MCXC141VFM" if SOC_PART_NUMBER_MCXC141VFM
	default "MCXC142VFM" if SOC_PART_NUMBER_MCXC142VFM
	default "MCXC242VLH" if SOC_PART_NUMBER_MCXC242VLH
	default "MCXC242VFM" if SOC_PART_NUMBER_MCXC242VFM
	default "MCXC444VLH" if SOC_PART_NUMBER_MCXC444VLH
	default "MCXC444VMP" if SOC_PART_NUMBER_MCXC444VMP
	default "MCXC454VFM" if SOC_PART_NUMBER_MCXC454VFM
	default "MCXC454VFT" if SOC_PART_NUMBER_MCXC454VFT
	default "MCXC454VLF" if SOC_PART_NUMBER_MCXC454VLF
	default "MCXC454VLH" if SOC_PART_NUMBER_MCXC454VLH
	default "MCXC454VLK" if SOC_PART_NUMBER_MCXC454VLK
	default "MCXC454VMP" if SOC_PART_NUMBER_MCXC454VMP
```

## subsys/mp/utils/Kconfig
```kconfig
#
# Copyright 2026 NXP
#
# SPDX-License-Identifier: Apache-2.0
#

config MP_PLAYER
	bool "MultimediaPipe player helper"
	depends on MP
	select POLL
	imply SHELL
	imply SERIAL
	imply UART_CONSOLE
	help
	  Enable the mp_player control layer: a reusable, media-player-like
	  helper that owns the run-time lifecycle of a pipeline (play, pause,
	  stop, replay, quit). When SHELL is enabled it also registers
	  interactive shell commands ("player play|pause|stop|replay|status"
	  and the single-letter shortcuts p/s/r/q).

if MP_PLAYER

config MP_PLAYER_WORKER_STACK_SIZE
	int "Player worker thread stack size"
	default 6144
	help
	  Stack size (in bytes) for the player worker thread that serializes
	  pipeline state changes.

	  Capability negotiation runs on this thread and recurses from the source
	  down to the sinks. Each element keeps a few capabilities live while it
	  negotiates, roughly 800 bytes, so budget that much per element. The
	  default suits chains of up to about seven elements; raise it for longer
	  pipelines.

config MP_PLAYER_WORKER_PRIORITY
	int "Player worker thread priority"
	default 5
	help
	  Scheduling priority for the player worker thread.

config MP_PLAYER_CMD_QUEUE_DEPTH
	int "Player command queue depth"
	default 8
	help
	  Number of pending commands the player can buffer before a caller
	  blocks while enqueueing a new command.

config MP_PLAYER_DUMP_ON_STATE_CHANGE
	bool "Dump the pipeline on every state change and every error"
	depends on MP_DUMP
	help
	  Print the pipeline after each state the player drives it to, and
	  whenever an element reports an error.

	  The dump is taken once the transition has finished, never between
	  two of them, so it delays nothing: a failure stops the pipeline
	  where it broke and the graph is still that failure's graph.

	  It goes to the console rather than the shell, since no shell
	  instance exists at that point. Extract a graph from a capture with:

	    sed -n '/^digraph/,/^}/p' log > pipe.dot

endif # MP_PLAYER

config MP_DUMP_MAX_ELEMENTS
	int "Maximum number of elements a dump can index"
	depends on MP_DUMP
	range 2 256
	default 32
	help
	  A dump flattens nested bins, so it can hold more elements than one
	  bin's MP_BIN_MAX_CHILDREN. An element past this limit is left out
	  of the graph and the dump is marked truncated.
```

## subsys/mpipe/Kconfig
```kconfig
#
# Copyright 2025 NXP
#
# SPDX-License-Identifier: Apache-2.0
#

menuconfig MPIPE
	bool "Multimedia Pipeline framework"
	select NET_BUF
	help
	  Enable the Multimedia Pipeline framework.

if MPIPE

module = MPIPE
module-str = mpipe
source "subsys/logging/Kconfig.template.log_config"

# ---- Framework options ----

config MPIPE_STRUCTURE_MAX_FIELDS
	int "Maximum fields one caps structure can hold"
	range 1 255
	default 5
	help
	  Number of capability fields a single caps structure can hold at once.
	  Size this for the largest union of fields that can meet in one intersection,
	  not for the number of fields an element sets. An intersection carries through
	  the fields that only one side constrains, so its result can hold more fields
	  than either input. Negotiation reports -ENOSPC when a structure runs out of slots.

config MPIPE_THREADS_NUM
	int "Number of mpipe_thread wrappers used by the whole application"
	range 0 255
	default 1

config MPIPE_THREAD_STACK_SIZE
	int "Stack size of a thread"
	default 1024

config MPIPE_THREAD_DEFAULT_PRIORITY
	int "Priority of a thread"
	default 5

config MPIPE_WORKQUEUE
	bool "Element-level work offload (P4WQ)"
	select SCHED_DEADLINE
	help
	  Enable element-level work offloading via a shared P4WQ
	  (Pooled Parallel Preemptible Priority-based Work Queue)
	  thread pool. Elements can submit finite work items (e.g.,
	  decode, inference) to be processed on pool threads with
	  configurable priority.

config MPIPE_WORKQUEUE_THREADS_NUM
	int "Number of threads in mpipe workqueue pool"
	default 1
	depends on MPIPE_WORKQUEUE
	help
	  Number of threads in the shared P4WQ pool used for
	  element-level work offload.

config MPIPE_WORKQUEUE_STACK_SIZE
	int "Stack size for mpipe workqueue pool threads"
	default 4096
	depends on MPIPE_WORKQUEUE
	help
	  Stack size in bytes for each thread in the mpipe workqueue pool.

config MPIPE_NET_BUF_POOL_COUNT
	int "Number of buffers in the mpipe shared net_buf pool"
	default 1
	help
	  Number of buffers needed in the shared mpipe net_buf pool across pipelines.
	  This is sum of the maximum number of in-flight net_buf buffers of each
	  pipeline at any given time

config MPIPE_DUMP
	bool "Dump pipeline topology and information"
	help
	  If enabled, pipeline topology and other information like state, caps, element's
	  properties can be dumped for debugging purpose.

	  The dump is written in dot format to the console which can be gotten and rendered
	  by Graphviz on the host machine.

config MPIPE_BIN_MAX_CHILDREN
	int "Maximum number of elements in a bin/pipeline"
	range 2 64
	default 10
	help
	  Maximum number of child elements that can be added to a single
	  bin or pipeline. This is used to size the bin's internal arrays for
	  topological sort during state changes.

config MPIPE_FAKE_SRC
	bool "Fake source element"
	help
	  Emulated source element for pipeline testing.

config MPIPE_FAKE_SRC_BUF_SZ
	int "Buffer size of the fake source element (in bytes)"
	range 1 1024
	default 1
	depends on MPIPE_FAKE_SRC

config MPIPE_BUS_QUEUE_DEPTH
	int "Message bus queue depth"
	default 2
	help
	  Bus queue depth

config MPIPE_RPC
	bool "RPC support"

# ---- Plugins and utilities ----
# Each plugin/utility directory ships its own Kconfig, guarded by its own
# CONFIG_MPIPE_* option. Adding a new plugin needs no change to this file.
osource "subsys/mpipe/*/Kconfig"

endif # MPIPE
```

## subsys/mpipe/disp/Kconfig
```kconfig
#
# Copyright 2025 NXP
#
# SPDX-License-Identifier: Apache-2.0
#

config MPIPE_DISP
	bool "Display plugin support"
	select DISPLAY
```

## subsys/mpipe/erpc/Kconfig
```kconfig
#
# Copyright 2026 NXP
#
# SPDX-License-Identifier: Apache-2.0
#

config MPIPE_ERPC
	bool "eRPC backend for the transform clients"
	depends on MPIPE_RPC
	depends on ZEPHYR_ERPC_MODULE
	help
	  Carry the RPC hooks of the transform clients over eRPC, with the
	  Zephyr IPC service as the transport.

	  This brings up the eRPC client and reports its errors; each plugin
	  binds its own eRPC interface to that client. The interface
	  definitions are compiled at build time by the erpcgen host tool.

	  The library and its transport are the module's own options, ERPC
	  and ERPC_TRANSPORT_IPC_SERVICE: the application enables both.

if MPIPE_ERPC

config MPIPE_ERPC_INIT_DELAY_MS
	int "Delay before the first exchange with the remote core (in milliseconds)"
	default 300
	help
	  Time the client transport waits before it talks to the remote core,
	  which may still be booting when the pipeline is built.

endif # MPIPE_ERPC
```

## subsys/mpipe/img/Kconfig
```kconfig
# Copyright 2026 NXP
# SPDX-License-Identifier: Apache-2.0

config MPIPE_IMG
	bool "Image codec plugin support"
	help
	  Elements that turn a coded image stream into frames and decode them: a
	  JPEG parser that finds frame boundaries in undifferentiated bytes, and
	  an optional software JPEG decoder that produces raw pixels.

	  The two are separate because the split is real. The parser is what
	  first knows the format, and it can be followed either by the software
	  decoder here or by a hardware decoder from the video plugin, without
	  either side knowing which.

if MPIPE_IMG

config MPIPE_IMG_JPEG_PARSER_MAX_FRAME_SIZE
	int "Maximum JPEG frame size in bytes"
	default 0
	help
	  Longest frame the parser produces, and the size of the buffers in its
	  own pool. A frame that lies inside one input chunk is emitted as a view
	  of the chunk; a frame split across two chunks is copied into one of
	  these buffers. 0 reserves no pool, which only works when the element
	  downstream offers a pool of its own, in which case every frame is
	  copied into that pool.

config MPIPE_IMG_JPEG_PARSER_POOL_NUM
	int "Copy pool buffer count"
	range 1 255
	default 2
	help
	  Number of buffers in the parser's own pool. One frame is being copied
	  while the previous one is consumed downstream, so two is usually
	  enough; raise it when the elements downstream hold frames.

config MPIPE_IMG_JPEG_DECODER
	bool "Software JPEG decoder element"
	depends on ZEPHYR_JPEGDEC_MODULE
	select JPEGDEC
	help
	  Transform element that decodes JPEG frames to raw pixels with the
	  jpegdec module. Boards with a JPEG decoder block use the video
	  plugin's transform element instead.

if MPIPE_IMG_JPEG_DECODER

config MPIPE_IMG_JPEG_DECODER_POOL_NUM
	int "Number of buffers in the jpeg decoder's output pool"
	range 1 255
	default 1
	help
	  Number of buffers in the decoder's internal output pool, used when
	  downstream proposes no pool of its own.

	  One is enough where the element downstream consumes each frame before
	  the next arrives, which is the case for a display sink. Raise it when
	  downstream holds frames past the chain call: a frame decoded while
	  every buffer is held is dropped, not waited for.

config MPIPE_IMG_JPEG_DECODER_MAX_OUT_FRAME_SIZE
	int "Maximum decoded output frame size in bytes"
	default 153600
	help
	  Maximum decoded output frame size in bytes for the SW JPEG decoder internal pool.
	  Default value is set for 320x240 RGB565 format.

endif # MPIPE_IMG_JPEG_DECODER

endif # MPIPE_IMG
```

## subsys/mpipe/net/Kconfig
```kconfig
# Copyright 2026 NXP
# SPDX-License-Identifier: Apache-2.0

config MPIPE_NET
	bool "Network plugin support"
	depends on NETWORKING && NET_TCP && NET_SOCKETS
	select NET_IPV4_MAPPING_TO_IPV6 if NET_NATIVE_IPV6
	help
	  Elements that move a stream over a socket: a socket source and sink
	  reading and writing a connected socket the application hands them,
	  and a TCP server source and sink built on them that listen on a port
	  of their own and take one client.
	  With IPv6 enabled a single socket serves IPv4 clients too, through
	  IPv4-mapped addresses.

if MPIPE_NET

config MPIPE_NET_SINK_PORT
	int "Default port the TCP sink listens on"
	range 1 65535
	default 5000
	help
	  Used unless the application sets MPIPE_PROP_TCP_SERVER_SINK_PORT.

config MPIPE_NET_SRC_PORT
	int "Default port the TCP source listens on"
	range 1 65535
	default 5001
	help
	  Used unless the application sets MPIPE_PROP_TCP_SERVER_SRC_PORT.

config MPIPE_NET_LISTEN_BACKLOG
	int "Pending connections a listening socket keeps"
	range 1 16
	default 2
	help
	  Connections completed by the TCP stack but not yet accepted. An
	  element takes one client, but an application may accept further
	  connections on the same listening socket, and a peer that opens them
	  back to back has its second SYN dropped while the backlog is full,
	  until it retransmits.

config MPIPE_NET_SRC_BUF_SIZE
	int "Size of a socket source receive chunk in bytes"
	range 1024 16777216
	default 65536
	help
	  The stream is received into chunks of this size, and each read is
	  pushed downstream as a view of the chunk it landed in. A frame that
	  fits in a chunk reaches the consumer without being copied, so make
	  the chunk a few times larger than a frame.

config MPIPE_NET_SRC_NUM_BUFS
	int "Number of chunks in the socket source pool"
	range 2 255
	default 4
	help
	  A chunk returns to the pool once every view of it has been released,
	  so the frames downstream still holds pin their chunks. Two is the
	  minimum for the source to fill one while the other is consumed.

config MPIPE_NET_SRC_MIN_READ
	int "Room left in a chunk below which the next one is started"
	range 64 65536
	default 4096
	help
	  A read into the tail of a chunk is pushed as a view like any other;
	  this bounds how small such a tail read may get.

endif # MPIPE_NET
```

## subsys/mpipe/vid/Kconfig
```kconfig
#
# Copyright 2025 NXP
#
# SPDX-License-Identifier: Apache-2.0
#

config MPIPE_VID
	bool "Video plugin support"
	select VIDEO
	help
	  Elements backed by Zephyr video devices: capture from a camera, and
	  memory-to-memory transforms performed by hardware such as a scaler,
	  rotator or decoder.

	  This is where zero-copy matters most, so the pools here hand out the
	  driver's own buffers rather than copies, and a frame captured by a
	  camera reaches the display without being moved.

if MPIPE_VID

config MPIPE_VID_CONVERT
	bool "Software-based pixel format converter"
	help
	  A transform that converts a frame from one pixel format to another on
	  the CPU.

	  It exists as the fallback for a conversion no hardware on the board can
	  do, which is common between a decoder's output format and what a panel
	  accepts. It converts pixel formats only: it does not scale, crop or
	  rotate. Expect it to cost real CPU time per frame.

config MPIPE_VID_OVERLAY
	bool "Rectangle overlay"
	help
	  An in-place transform drawing rectangle outlines into the frames
	  passing through, typically detection boxes from an inference
	  running beside the pipeline. The application updates the set of
	  rectangles at any time through a property.

config MPIPE_VID_OVERLAY_MAX_RECTS
	int "Rectangles the overlay holds"
	depends on MPIPE_VID_OVERLAY
	range 1 255
	default 16
	help
	  Upper bound on the rectangles drawn into one frame. The element
	  keeps a copy of the set, and copies it again on the stack for each
	  frame, so this sizes both.

endif # MPIPE_VID
```
