## subsys/mp/core/Kconfig
```kconfig
#
# Copyright 2025-2026 NXP
#
# SPDX-License-Identifier: Apache-2.0
#

config MP_THREADS_NUM
	int "Number of mp_thread wrappers used by the whole application"
	range 0 255
	default 1

config MP_THREAD_STACK_SIZE
	int "Stack size of a thread"
	default 1024

config MP_THREAD_DEFAULT_PRIORITY
	int "Priority of a thread"
	default 5

config MP_CAPSFILTER
	bool "Capsfilter element"
	help
	  Enable the capsfilter element. Capsfilter restricts the media
	  format flowing between two elements by filtering on capabilities
	  such as sample rate, pixel format, etc. This allows forcing a
	  specific format at a given point in the pipeline.

config MP_QUEUE
	bool "Queue element (for pipeline-level threading)"
	help
	  Enable the queue element which decouples pipeline segments
	  into separate threads for parallel processing. The queue
	  deposits buffers into a FIFO and spawns a dedicated thread
	  to drive the downstream segment.

config MP_QUEUE_MAX_SIZE
	int "Max size of a queue element"
	range 1 255
	default 2
	depends on MP_QUEUE
	help
	  Maximum number of buffers that can be queued into a queue element

config MP_WORKQUEUE
	bool "Element-level work offload (P4WQ)"
	select SCHED_DEADLINE
	help
	  Enable element-level work offloading via a shared P4WQ
	  (Pooled Parallel Preemptible Priority-based Work Queue)
	  thread pool. Elements can submit finite work items (e.g.,
	  decode, inference) to be processed on pool threads with
	  configurable priority.

config MP_WORKQUEUE_THREADS_NUM
	int "Number of threads in MP workqueue pool"
	default 1
	depends on MP_WORKQUEUE
	help
	  Number of threads in the shared P4WQ pool used for
	  element-level work offload.

config MP_WORKQUEUE_STACK_SIZE
	int "Stack size for MP workqueue pool threads"
	default 4096
	depends on MP_WORKQUEUE
	help
	  Stack size in bytes for each thread in the MP workqueue pool.

config MP_NET_BUF_POOL_COUNT
	int "Number of buffers in the MP shared net_buf pool"
	default 1
	help
	  Number of buffers needed in the shared MP net_buf pool across pipelines.
	  This is sum of the maximum number of in-flight net_buf buffers of each
	  pipeline at any given time

config MP_BIN_MAX_CHILDREN
	int "Maximum number of elements in a bin/pipeline"
	range 2 64
	default 10
	help
	  Maximum number of child elements that can be added to a single
	  bin or pipeline. This is used to size the bin's internal arrays for
	  topological sort during state changes.

config MP_TEE
	bool "Tee element"
	help
	  Enable the tee element which splits a single input branch
	  into multiple output branches.

config MP_TEE_MAX_SRCPADS_NUM
	int "Maximum number of source pads of a tee element"
	range 2 8
	default 2
```

## subsys/mp/plugins/zaud/Kconfig
```kconfig
#
# Copyright 2025 NXP
#
# SPDX-License-Identifier: Apache-2.0
#

config MP_PLUGIN_ZAUD
	bool "Audio plugin support"
	select AUDIO

if MP_PLUGIN_ZAUD

config MP_ZAUD_BUFFER_POOL_SZ_MAX
	int "Size of the largest buffer in the buffer pool"
	default 98304

config MP_ZAUD_BUFFER_POOL_NUM_MAX
	int "Number of maximum sized buffers in the buffer pool"
	default 10

endif # MP_PLUGIN_ZAUD
```

## subsys/mp/src/plugins/Kconfig
```kconfig
#
# Copyright 2025 NXP
#
# SPDX-License-Identifier: Apache-2.0
#

menu "Media Pipe plugins"

osource "subsys/mp/src/plugins/*/Kconfig"

endmenu
```

## subsys/net/lib/mcp/Kconfig
```kconfig
# Copyright 2025 NXP
# SPDX-License-Identifier: Apache-2.0

menuconfig MCP_SERVER
	bool "Model Context Protocol (MCP) Server support"
	select JSON_LIBRARY
	help
	  Support for MCP Server functionality.

if MCP_SERVER
config MCP_SERVER_COUNT
	int "Number of MCP server instances"
	default 1
	range 1 10
	help
		Number of MCP server instances that can be created and run concurrently.

config MCP_REQUEST_WORKERS
	int "Number of MCP request worker threads"
	default 2
	range 1 8
	help
	  Number of worker threads that process incoming MCP requests.
	  More workers allow better concurrent handling of client requests.

config MCP_RESPONSE_WORKERS
	int "Number of MCP message worker threads"
	default 2
	range 0 8
	help
	  Number of worker threads that process outgoing MCP responses.
	  Set to 0 to disable response workers and process responses directly.

config MCP_REQUEST_QUEUE_SIZE
	int "MCP request queue size"
	default 5
	range 1 100
	help
	  Maximum number of pending MCP requests that can be queued for processing.

config MCP_RESPONSE_QUEUE_SIZE
	int "MCP response queue size"
	default 5
	range 1 100
	help
	  Maximum number of pending MCP responses that can be queued for sending.

config MCP_MAX_MESSAGE_SIZE
	int "Maximum MCP message size"
	default 2048
	help
	  Size of the buffer for MCP messages in bytes.

config MCP_SERVER_INFO_NAME_MAX_LEN
	int "Maximum server info name length"
	default 64
	help
	  Maximum length for the server name field in serverInfo.

config MCP_SERVER_INFO_NAME
	string "Server name"
	default "Zephyr MCP Server"
	help
	  The name of the MCP server reported in serverInfo.

config MCP_SERVER_INFO_VERSION_MAX_LEN
	int "Maximum server info version length"
	default 16
	help
	  Maximum length for the server version field in serverInfo.

config MCP_SERVER_INFO_VERSION
	string "Server version"
	default "1.0.0"
	help
	  The version of the MCP server reported in serverInfo.

config MCP_SERVER_INFO_TITLE
	bool "Include server title in serverInfo"
	default n
	help
	  Include optional title field in the serverInfo section.

if MCP_SERVER_INFO_TITLE

config MCP_SERVER_INFO_TITLE_MAX_LEN
	int "Maximum server info title length"
	default 64
	help
	  Maximum length for the server title field in serverInfo.

config MCP_SERVER_INFO_TITLE_VALUE
	string "Server title"
	default "Zephyr MCP Server"
	help
	  The title of the MCP server reported in serverInfo.

endif # MCP_SERVER_INFO_TITLE

config MCP_SERVER_INFO_INSTRUCTIONS
	bool "Include server instructions in serverInfo"
	default n
	help
	  Include optional instructions field in the serverInfo section.

if MCP_SERVER_INFO_INSTRUCTIONS

config MCP_SERVER_INFO_INSTRUCTIONS_MAX_LEN
	int "Maximum server info instructions length"
	default 256
	help
	  Maximum length for the server instructions field in serverInfo.

config MCP_SERVER_INFO_INSTRUCTIONS_VALUE
	string "Server instructions"
	default "This is a Zephyr-based MCP server providing tool capabilities."
	help
	  The instructions for the MCP server reported in serverInfo.

endif # MCP_SERVER_INFO_INSTRUCTIONS

config MCP_MAX_TOOLS
	int "Maximum number of registered tools"
	default 4

config MCP_TOOL_NAME_MAX_LEN
	int "Maximum tool name length"
	default 32
	help
	  Maximum length for tool name and title fields.

config MCP_TOOL_DESC
	bool "Include tool description in tools/list response"
	default n
	help
	  Include optional description field in the tools/list response.

if MCP_TOOL_DESC

config MCP_TOOL_DESC_MAX_LEN
	int "Maximum tool description length"
	default 256
	help
	  Maximum length for tool description field.

endif # MCP_TOOL_DESC

config MCP_TOOL_SCHEMA_MAX_LEN
	int "Maximum input/output schema length"
	default 512
	help
	  Maximum length for tool input and output schema fields.

config MCP_TOOL_INPUT_ARGS_MAX_LEN
	int "Maximum input argument length"
	default 512
	help
	  Maximum length for tool input arguments RPC field.

config MCP_TOOL_TITLE
	bool "Include tool title field"
	default n
	help
	  Include optional title field for tools. Adds memory overhead.

config MCP_TOOL_OUTPUT_SCHEMA
	bool "Include tool output schema field"
	default n
	help
	  Include optional output schema field for tools. Adds memory overhead.

config MCP_TOOL_RESULT_MAX_LEN
	int "Maximum tool execution result length"
	default 256
	help
			Maximum length for tool execution result.

config MCP_HEALTH_MONITOR
	bool "Health monitor usage"
	default y
	help
			This option enables the health monitoring thread that checks for execution timeouts
			and cancels long-running or stalled tool executions.

if MCP_HEALTH_MONITOR

config MCP_HEALTH_CHECK_INTERVAL_MS
	int "Health monitor check interval in milliseconds"
	default 30000
	help
			How often the health monitor thread checks execution contexts
			for timeout conditions.

config MCP_TOOL_EXEC_TIMEOUT_MS
	int "Maximum execution duration in milliseconds"
	default 600000
	help
			Maximum time allowed for a tool execution before it is canceled.
			Default is 10 minutes (600000 ms).

config MCP_TOOL_IDLE_TIMEOUT_MS
	int "Execution idle timeout in milliseconds"
	default 100000
	help
			Maximum time allowed since last message from a tool execution
			before it is canceled. Default is 5 minutes (300000 ms).

config MCP_TOOL_CANCEL_TIMEOUT_MS
	int "Execution cancellation timeout in milliseconds"
	default 300000
	help
			Maximum time allowed for a tool to acknowledge cancellation
			before an error is logged. Default is 1 minute (60000 ms).

endif # MCP_HEALTH_MONITOR

choice MCP_TRANSPORT
	prompt "MCP Transport Mechanism"
	default MCP_TRANSPORT_HTTP
	help
	  Select the transport mechanism for MCP communication.

config MCP_TRANSPORT_HTTP
	bool "HTTP transport"
	depends on NETWORKING
	select POSIX_API
	select NET_TCP
	select NET_IPV4
	select NET_IPV6
	select NET_SOCKETS
	select HTTP_SERVER
    select HTTP_SERVER_CAPTURE_HEADERS
	select UUID
	select UUID_V4
	select UUID_BASE64
	select ENTROPY_GENERATOR
	select MBEDTLS
	select MBEDTLS_PSA_CRYPTO_C
	select PSA_WANT_ALG_SHA_1
	select BASE64
	help
	  Use HTTP for MCP transport.

endchoice

if MCP_TRANSPORT_HTTP

config HTTP_SERVER_MAX_CLIENTS
	int "Max number of HTTP clients"
	default 3
	range 1 100
	help
	  This setting determines the maximum number of HTTP clients that
	  the server can handle at once.

config HTTP_SERVER_MAX_STREAMS
	int "Max number of HTTP streams"
	default 3
	range 1 100
	help
	  This setting determines the maximum number of HTTP streams for each client.

config MCP_HTTP_PORT
	int "HTTP server port"
	default 8080
	help
	  Port number for the MCP HTTP server.

config MCP_HTTP_ENDPOINT
    string "MCP endpoint path"
    default "/mcp"
    help
      URL path for MCP endpoint.

config MCP_HTTP_TIMEOUT_MS
	int "HTTP request timeout in milliseconds"
	default 500
	help
	  Maximum time in milliseconds to wait for an HTTP request to complete
	  before switching from blocking mode to polling mode. This timeout
	  applies to both client and server HTTP operations.

config MCP_HTTP_SSE_RETRY_MS
	int "SSE reconnection retry interval in milliseconds"
	default 5000
	help
	  Time interval in milliseconds sent to clients via the SSE 'retry' field.
	  In this implementation, the retry mechanism instructs clients how
	  frequently to poll for new responses via GET requests. When a client
	  receives an SSE event with this retry value, it should wait this amount
	  of time before making the next GET request to check for additional
	  server responses.

endif # MCP_TRANSPORT_HTTP

module = MCP
module-str = MCP Server
source "subsys/logging/Kconfig.template.log_config"

endif # MCP_SERVER
```

## subsys/pmci/mctp/Kconfig
```kconfig
# Copyright (c) 2024 Intel Corporation
# Copyright 2025 NXP
# SPDX-License-Identifier: Apache-2.0

menuconfig MCTP
	bool "Management Component Transport Protocol [EXPERIMENTAL]"
	select EXPERIMENTAL
	help
	  Enable the MCTP Subsystem and Module Usage

if MCTP

config MCTP_HEAP_SIZE
	int "MCTP Heap Size"
	default 1024
	help
	  MCTP requires a heap for allocating packet buffers. A dedicated
	  heap is provided to MCTP at startup avoiding the need to specify
	  libmctp's allocation operations. This setting defines the size of
	  the dedicated MCTP heap in bytes. Defaults to 1KB for small packets.

config MCTP_BTU
    int "MCTP Baseline Transmission Unit"
    default 64
    help
      Baseline transmission unit used by libmctp core for MTU checks and fragmentation.

config MCTP_UART
	bool "MCTP UART Binding"
	depends on UART_ASYNC_API
	help
	  Build the MCTP UART binding to use MCTP over Zephyr's async UART
	  interface.

config MCTP_I2C_GPIO_CONTROLLER
	bool "MCTP I2C+GPIO Controller Binding"
	depends on I2C
	depends on I2C_RTIO
	depends on GPIO
	help
	  Build the MCTP I2C+GPIO controller binding to use MCTP over Zephyr's I2C RTIO
	  interface and GPIO interrupts from targets to signal their request to write.

config MCTP_I2C_GPIO_TARGET
	bool "MCTP I2C+GPIO Target Binding"
	depends on I2C
	depends on GPIO
	help
	  Build the MCTP I2C+GPIO target binding to use MCTP over Zephyr's I2C target
	  interface and GPIO to signal writes to the bus controller.

config MCTP_I2C_SMBUS_TARGET
    bool "MCTP I2C+SMBUS Target Binding"
    depends on I2C
    depends on I2C_TARGET
    help
      Build the MCTP I2C+SMBUS target binding to use MCTP over Zephyr's I2C target
      interface and do role Switch to signal writes to the bus controller.

config MCTP_I2C_SMBUS_BLOCK_MAX
    int "MCTP SMBus block max payload (bytes)"
    default 32
    range 1 255
    depends on MCTP_I2C_SMBUS_TARGET
    help
      Maximum number of data bytes in SMBus Block Write for MCTP over SMBus.
      Classic SMBus is 32.

config MCTP_I3C_CONTROLLER
	bool "MCTP I3C Controller Binding"
	depends on I3C_CONTROLLER
	depends on I3C_USE_IBI
	help
	  Build the MCTP I3C controller binding to use MCTP over Zephyr's I3C
	  interface and IBI to signal from targets to a request to send messages.

config MCTP_I3C_TARGET
	bool "MCTP I3C Target Binding"
	depends on I3C_TARGET
	depends on I3C_USE_IBI
	depends on I3C_TARGET_BUFFER_MODE
	help
	  Build the MCTP I3C target binding to use MCTP over Zephyr's I3C target
	  interface and IBI to signal a request to send messages to the bus controller.

config MCTP_USB
	bool "MCTP USB Binding"
	depends on USB_DEVICE_STACK_NEXT
	help
	  Build the MCTP USB binding to use MCTP over Zephyr's USB device interface.

module = MCTP
module-str = MCTP
source "subsys/logging/Kconfig.template.log_config"

rsource "Kconfig.usb"

endif
```
