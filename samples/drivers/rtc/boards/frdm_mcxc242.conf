## samples/drivers/rtc/boards/frdm_mcxc242.conf
```kconfig
#
# Copyright 2025 NXP
#
# SPDX-License-Identifier: BSD-3-Clause
#

CONFIG_RTC_ALARM=y
CONFIG_RTC_UPDATE=y
CONFIG_RTC_CALIBRATION=y
```

## samples/modules/lvgl/demos/boards/mimxrt1060_evk.conf
```kconfig
# Copyright 2023 Fabian Blatz <fabianblatz@gmail.com>
# SPDX-License-Identifier: Apache-2.0

# Enable PXP DMA engine and set rotation angle to 0 degrees.
# This allows us to verify the DMA driver functions without altering
# the output image
CONFIG_DMA=y
CONFIG_MCUX_ELCDIF_PXP=y
# elcdif requires 8-byte alignment for the rendering buffer address
CONFIG_LV_Z_VDB_ALIGN=8
```

## samples/modules/lvgl/demos/boards/mimxrt700_evk_mimxrt798s_cm33_cpu0.conf
```kconfig
#
# Copyright 2025 NXP
#
# SPDX-License-Identifier: Apache-2.0
#

CONFIG_LV_Z_MEM_POOL_SIZE=81920
# RT700 uses DC8000 to drive all panels which requires a 64 byte align of buffer address and stride.
CONFIG_LV_DRAW_BUF_STRIDE_ALIGN=64
CONFIG_LV_DRAW_BUF_ALIGN=64

# Enable .lvgl_buf to move to PSRAM
CONFIG_LV_Z_VDB_CUSTOM_SECTION=y

# for LVGL performance
CONFIG_LV_Z_FULL_REFRESH=y
CONFIG_LV_Z_DOUBLE_VDB=y
CONFIG_LV_Z_VDB_SIZE=100
CONFIG_MCUX_DCNANO_LCDIF_MAINTAIN_CACHE=y
```

## samples/net/bridge/sample.yaml
```yaml
sample:
  description: Test bridge functionality
  name: bridge sample app
common:
  harness: net
  tags:
    - net
tests:
  sample.net.bridge:
    build_only: true
    platform_allow:
      - mimxrt1180_evk/mimxrt1189/cm33
    depends_on: eth
```

## samples/net/dhcpv4_client/boards/rd_rw612_bga.conf
```kconfig
CONFIG_USB_HOST_STACK=y
CONFIG_USBH_CDC_ECM_CLASS=y
CONFIG_USBH_CDC_ECM_LOG_LEVEL_DBG=y
```

## samples/subsys/fs/littlefs/boards/mimxrt1060_evk_mimxrt1062_qspi_C.conf
```kconfig
#
# Copyright (c) 2021 NXP.
# SPDX-License-Identifier: Apache-2.0
#

CONFIG_XIP=n
CONFIG_CODE_DATA_RELOCATION=n
#CONFIG_LOG=y
#CONFIG_FLASH_LOG_LEVEL_DBG=y
CONFIG_FS_LITTLEFS_READ_SIZE=2048
CONFIG_FS_LITTLEFS_PROG_SIZE=2048
CONFIG_FS_LITTLEFS_CACHE_SIZE=2048
CONFIG_FS_LITTLEFS_LOOKAHEAD_SIZE=2048
```

## soc/nxp/common/Kconfig.defconfig.nvic
```kconfig
# Copyright 2026 NXP
# SPDX-License-Identifier: Apache-2.0

# Compute NUM_IRQS automatically from the Arm v6/7/8-M NVIC devicetree
# node. dt_highest_controller_irq_number() returns the zero-based IRQn;
# increment it to obtain the table size (= max IRQn + 1).
#
# Only rsource this snippet from a Cortex-M Kconfig.defconfig: if the
# NVIC node is missing, the build will fail loudly here instead of
# silently defaulting NUM_IRQS to 0.
DT_NVIC_PATH := /soc/interrupt-controller@e000e100
DT_NVIC_MAX_IRQN := $(dt_highest_controller_irq_number,$(DT_NVIC_PATH),irq)

configdefault NUM_IRQS
	default $(inc,$(DT_NVIC_MAX_IRQN))
```

## soc/nxp/imx/imx9/Kconfig
```kconfig
# Copyright 2024 NXP
# SPDX-License-Identifier: Apache-2.0

if SOC_SERIES_IMX9

choice SOC_SERIES_IMX9_GCC_LARGE_TU_DIAGNOSTICS
	prompt "GCC diagnostics behavior for large translation units"
	default SOC_SERIES_IMX9_GCC_SUPPRESS_MISLEADING_INDENTATION
	help
	  Some i.MX9 builds pull in large NXP HAL headers, which can make GCC
	  disable column-tracking and then auto-disable -Wmisleading-indentation.
	  This choice lets you either suppress that warning (quiet builds) or
	  keep it by enabling -flarge-source-files (more diagnostics, higher cost).

config SOC_SERIES_IMX9_GCC_SUPPRESS_MISLEADING_INDENTATION
	bool "Suppress -Wmisleading-indentation (quiet builds)"
	help
	  Adds -Wno-misleading-indentation for i.MX9 builds.
	  This avoids noisy GCC notes when column-tracking gets disabled for
	  very large sources/headers.

config SOC_SERIES_IMX9_GCC_ENABLE_FLARGE_SOURCE_FILES
	bool "Use -flarge-source-files (keep column-tracking longer)"
	help
	  Adds -flarge-source-files for i.MX9 builds.
	  This helps GCC retain column-tracking for large sources/headers so
	  -Wmisleading-indentation can remain enabled, at the expense of
	  compilation time and memory.

endchoice

rsource "*/Kconfig"
endif
```

## soc/nxp/kinetis/kw45/Kconfig.defconfig.kw45b41z83
```kconfig
# NXP KW45 Platform configuration options

# Copyright 2023 NXP
# SPDX-License-Identifier: Apache-2.0

if SOC_KW45B41Z83

config SOC
	default "kw45b41z83"

config SYS_CLOCK_HW_CYCLES_PER_SEC
	default 96000000 if CORTEX_M_SYSTICK

endif # SOC_KW45B41Z83
```

## soc/nxp/kinetis/kw45/Kconfig.series
```kconfig
# KW45 Series

# Copyright 2023 NXP
# SPDX-License-Identifier: Apache-2.0

config SOC_SERIES_KINETIS_KW45
	bool "KW45 Series MCU"
	select ARM
	select CPU_CORTEX_M33
	select CPU_CORTEX_M_HAS_DWT
	select SOC_FAMILY_KINETIS
	select HAS_MCUX
	select PLATFORM_SPECIFIC_INIT
	select CLOCK_CONTROL
	help
	    Enable support for KW45 MCU series of MCU
```

## soc/nxp/kinetis/kw45/Kconfig.soc
```kconfig
# KW45 Series

# Copyright 2023 NXP
# SPDX-License-Identifier: Apache-2.0


choice
	prompt "KW45 Series MCU Selection"
	depends on SOC_SERIES_KINETIS_KW45

config SOC_KW45B41Z83
	bool "SOC_KW45B41Z83"
	select ARM_TRUSTZONE_M
	select CPU_CORTEX_M_HAS_SYSTICK
	select CPU_HAS_FPU
	select CPU_HAS_ARM_SAU
	select CPU_HAS_ARM_MPU

endchoice

if SOC_SERIES_KINETIS_KW45

config SOC_PART_NUMBER_KW45B41Z83AFTA
	bool

config SOC_PART_NUMBER_KINETIS_KW45
	string
	default "KW45B41Z83AFTA" if SOC_PART_NUMBER_KW45B41Z83AFTA
	help
	    This string holds the full part number of the SOC.
	    It is a hidden option that you should not set directly.
	    The part number selection choice defines the
	    default value for this string.

endif # SOC_SERIES_KINETIS_KW45
```

## soc/nxp/mcx/mcxe/mcxe24x/Kconfig.defconfig
```kconfig
# Copyright 2025-2026 NXP
# SPDX-License-Identifier: Apache-2.0

if SOC_SERIES_MCXE24X

configdefault MCUX_LPTMR_TIMER
	default y

config CORTEX_M_SYSTICK
	default n if MCUX_LPTMR_TIMER

config SYS_CLOCK_HW_CYCLES_PER_SEC
	default $(dt_node_int_prop_int,/cpus/cpu@0,clock-frequency) if CORTEX_M_SYSTICK
	default $(dt_node_int_prop_int,/soc/timer@40040000,clock-frequency) if MCUX_LPTMR_TIMER

config SYS_CLOCK_TICKS_PER_SEC
	default 1000 if MCUX_LPTMR_TIMER

config NUM_IRQS
	default 146

config CPU_HAS_CUSTOM_FIXED_SOC_MPU_REGIONS
	default y

config GPIO
	default y

# Enable cache management features
configdefault CACHE_MANAGEMENT
	default y

choice CACHE_TYPE
	default EXTERNAL_CACHE
endchoice

endif # SOC_SERIES_MCXE24X
```

## soc/nxp/mcx/mcxe24/Kconfig
```kconfig
# Copyright 2025 NXP
# SPDX-License-Identifier: Apache-2.0

config SOC_SERIES_MCXE24
	select ARM
	select CPU_CORTEX_M4
	select CPU_CORTEX_M_HAS_DWT
	select CPU_HAS_FPU
	select CLOCK_CONTROL
	select HAS_MCUX
	select HAS_MCUX_CACHE
	select HAS_MCUX_FLEXCAN
	select HAS_MCUX_FTFC
	select HAS_MCUX_LPI2C
	select HAS_MCUX_LPSPI
	select HAS_MCUX_LPUART
	select HAS_MCUX_PCC
	select HAS_MCUX_RTC
	select HAS_MCUX_SIM
	select HAS_MCUX_ADC12
	select HAS_MCUX_SCG
	select HAS_MCUX_WDOG32
	select HAS_MCUX_FTM
	select HAS_MCUX_LPTMR
	select HAS_MCUX_EDMA
	select HAS_MCUX_RCM
	select SOC_RESET_HOOK
	select SOC_EARLY_INIT_HOOK

if SOC_SERIES_MCXE24

config MCXE_FLASH_CONFIG
	bool "MCXE flash configuration field"
	default y if XIP && !BOOTLOADER_MCUBOOT
	help
	  Include the 16-byte flash configuration field that stores default
	  protection settings (loaded on reset) and security information that
	  allows the MCU to restrict access to the FTFC module.

config WDOG_ENABLE_AT_BOOT
	bool "Keep watchdog timer enabled at boot"
	help
	  Leave SOC watchdog timer enabled at boot. The specific timeout
	  and clock configuration of the watchdog at boot is SOC dependent.
	  Note: if the watchdog timer is enabled at boot, the user will
	  need to configure the watchdog using z_arm_watchdog_init, as
	  the SOC requires watchdog configuration before initial expiration

# Enable watchdog configuration function if watchdog is left enabled at boot
config WDOG_INIT
	bool
	default WDOG_ENABLE_AT_BOOT

endif # SOC_SERIES_MCXE24
```

## soc/nxp/mcx/mcxe24/Kconfig.soc
```kconfig
# Copyright 2025 NXP
# SPDX-License-Identifier: Apache-2.0

config SOC_SERIES_MCXE24
	bool
	select SOC_FAMILY_NXP_MCX

config SOC_SERIES
	default "mcxe24" if SOC_SERIES_MCXE24

config SOC_MCXE245
	bool
	select SOC_SERIES_MCXE24

config SOC_MCXE246
	bool
	select SOC_SERIES_MCXE24

config SOC_MCXE247
	bool
	select SOC_SERIES_MCXE24

config SOC
	default "mcxe245" if SOC_MCXE245
	default "mcxe246" if SOC_MCXE246
	default "mcxe247" if SOC_MCXE247

config SOC_PART_NUMBER_MCXE245VLF
	bool

config SOC_PART_NUMBER_MCXE245VLH
	bool

config SOC_PART_NUMBER_MCXE245VLL
	bool

config SOC_PART_NUMBER_MCXE246VLH
	bool

config SOC_PART_NUMBER_MCXE246VLL
	bool

config SOC_PART_NUMBER_MCXE246VLQ
	bool

config SOC_PART_NUMBER_MCXE247VLL
	bool

config SOC_PART_NUMBER_MCXE247VLQ
	bool

config SOC_PART_NUMBER
	default "MCXE245VLF" if SOC_PART_NUMBER_MCXE245VLF
	default "MCXE245VLH" if SOC_PART_NUMBER_MCXE245VLH
	default "MCXE245VLL" if SOC_PART_NUMBER_MCXE245VLL
	default "MCXE246VLH" if SOC_PART_NUMBER_MCXE246VLH
	default "MCXE246VLL" if SOC_PART_NUMBER_MCXE246VLL
	default "MCXE246VLQ" if SOC_PART_NUMBER_MCXE246VLQ
	default "MCXE247VLL" if SOC_PART_NUMBER_MCXE247VLL
	default "MCXE247VLQ" if SOC_PART_NUMBER_MCXE247VLQ
```

## soc/nxp/mcx/mcxw/mcxw7xx/Kconfig
```kconfig
# Copyright 2025-2026 NXP
#
# SPDX-License-Identifier: Apache-2.0

rsource "../../../common/Kconfig.nbu"

config MCUX_CORE_SUFFIX
	default "_cm33_core0" if SOC_MCXW727C

config SOC_MCXW716C
	bool
	select NXP_MULTICORE if NXP_NBU
	select HAS_PM

config SOC_MCXW727C
	bool
	select NXP_MULTICORE if NXP_NBU
	select HAS_PM
```

## soc/nxp/mcx/mcxw2x/Kconfig
```kconfig
# Copyright 2025 NXP
#
# SPDX-License-Identifier: Apache-2.0

config SOC_FAMILY_MCXW2X
	select ARM
	select CLOCK_CONTROL
	select HAS_MCUX
	select HAS_MCUX_FLEXCOMM
	select HAS_MCUX_SYSCON
	select HAS_MCUX_WWDT
	select CPU_CORTEX_M_HAS_SYSTICK
	select CPU_CORTEX_M_HAS_DWT
	select SOC_RESET_HOOK

config SOC_MCXW236
	select CPU_CORTEX_M33
	select CPU_HAS_ARM_SAU
	select CPU_HAS_ARM_MPU
	select CPU_HAS_FPU
	select ARMV8_M_DSP
	select ARM_TRUSTZONE_M
	select HAS_MCUX_IAP if !TRUSTED_EXECUTION_NONSECURE
	select HAS_MCUX_MCAN
	select HAS_MCUX_RNG

if SOC_FAMILY_MCXW2X

config MCXW23X_SRAM_CLOCKS
	bool "Clock MCXW23 SRAM banks"

endif # SOC_FAMILY_MCXW2X
```

## subsys/cpu_workload/Kconfig
```kconfig
# Copyright 2026 NXP
#
# SPDX-License-Identifier: Apache-2.0

menuconfig CPU_WORKLOAD
	bool "CPU Workload"
	select EXPERIMENTAL
	help
	  CPU workload subsystem.

if CPU_WORKLOAD

module = CPU_WORKLOAD
module-str = CPU Workload
source "subsys/logging/Kconfig.template.log_config"

config CPU_WORKLOAD_HISTORY
	bool "CPU runtime-history workload"
	select THREAD_RUNTIME_STATS
	select SCHED_THREAD_USAGE
	select SCHED_THREAD_USAGE_ALL
	select SCHED_THREAD_USAGE_AUTO_ENABLE
	help
	  Track recent CPU runtime history from scheduler runtime statistics.
	  The history workload reports non-idle cycles, elapsed runtime-stat cycles,
	  load percentage, and confidence since the previous cpu_workload query.

config CPU_WORKLOAD_THREAD_PROFILE
	bool "Per-thread workload profile"
	select THREAD_RUNTIME_STATS
	select SCHED_THREAD_USAGE
	select SCHED_THREAD_USAGE_ACTIVATION_STATS
	select SCHED_THREAD_USAGE_AUTO_ENABLE
	help
	  Build a per-thread workload profile from complete thread activations.
	  Threads without completed activation samples remain unprofiled and report
	  zero confidence.

config CPU_WORKLOAD_READY_BACKLOG
	bool "CPU ready backlog workload"
	select THREAD_MONITOR
	select THREAD_RUNTIME_STATS
	select SCHED_THREAD_USAGE
	select SCHED_THREAD_USAGE_AUTO_ENABLE
	select CPU_WORKLOAD_THREAD_PROFILE
	help
	  Estimate runnable backlog work by scanning runnable threads and summing
	  their per-thread CPU burst profiles. This exposes forward-looking runnable
	  work that has not yet completed.

config CPU_WORKLOAD_READY_BACKLOG_MIN_CONFIDENCE
	int "Minimum thread profile confidence for ready backlog"
	default 20
	range 0 100
	depends on CPU_WORKLOAD_READY_BACKLOG
	help
	  Minimum per-thread burst profile confidence required before that profile
	  contributes its average burst cycles to the ready backlog.

config CPU_WORKLOAD_ARRIVAL
	bool "CPU wakeup-arrival workload"
	select THREAD_MONITOR
	select THREAD_RUNTIME_STATS
	select SCHED_THREAD_USAGE
	select SCHED_THREAD_USAGE_ARRIVAL_STATS
	select SCHED_THREAD_USAGE_AUTO_ENABLE
	select CPU_WORKLOAD_THREAD_PROFILE
	help
	  Attribute thread wakeups to arrival sources and estimate the expected
	  cycles from those arrivals using per-thread burst profiles. This provides
	  forward-looking workload for work that arrived since the previous query.

config CPU_WORKLOAD_ESTIMATE
	bool "Unified CPU workload estimate"
	select CPU_WORKLOAD_HISTORY
	select CPU_WORKLOAD_READY_BACKLOG
	select CPU_WORKLOAD_ARRIVAL
	help
	  Combine runtime history, ready backlog, and arrival attribution into a
	  single estimated cycle count. The estimate uses recent runtime history as
	  a conservative floor and adds the forward-looking ready backlog and arrival
	  workloads.

config CPU_WORKLOAD_DIAGNOSTIC
	bool "CPU workload contributor diagnostics"
	select CPU_WORKLOAD_READY_BACKLOG
	select CPU_WORKLOAD_ARRIVAL
	help
	  Expose per-thread diagnostic contributors for evaluation and debugging.
	  This lets samples explain which threads contributed to ready-backlog and
	  arrival workload before the unified estimate consumes the arrival window.

endif # CPU_WORKLOAD
```

## subsys/ipc/ipc_service/backends/Kconfig.rpmsg-lite
```kconfig
#
# Copyright 2026 NXP
#
# SPDX-License-Identifier: Apache-2.0
#

if IPC_SERVICE_BACKEND_RPMSG_LITE

config IPC_SERVICE_BACKEND_RPMSG_LITE_WQ_STACK_SIZE
	int "Size of RX work queue stack"
	default 1024
	help
	  Size of stack used by work queue RX thread. This work queue is
	  created in the multi-instance / multi-core RPMSG-Lite backend module to
	  prevent notifying service users about received data from the system
	  work queue. Size is the same for all instances.

config IPC_SERVICE_BACKEND_RPMSG_LITE_NUM_ENDPOINTS_PER_INSTANCE
	int "Max number of registered endpoints per instance"
	default 2
	help
	  Maximal number of endpoints that can be registered for one instance
	  for RPMSG-Lite backend.

endif # IPC_SERVICE_BACKEND_RPMSG_LITE
```

## subsys/mcp_server/Kconfig
```kconfig
# Copyright 2025 NXP
# SPDX-License-Identifier: Apache-2.0

menuconfig MCP_SERVER
	bool "Model Context Protocol (MCP) Server support"
	depends on NETWORKING && HTTP_SERVER && JSON_LIBRARY
	help
	  Enable support for MCP Server functionality.

if MCP_SERVER

module = MCP
module-str = MCP Server
source "subsys/logging/Kconfig.template.log_config"

endif # MCP_SERVER
```
