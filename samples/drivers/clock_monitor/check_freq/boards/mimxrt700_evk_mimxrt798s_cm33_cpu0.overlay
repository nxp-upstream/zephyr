/*
 * SPDX-FileCopyrightText: 2026 NXP
 *
 * SPDX-License-Identifier: Apache-2.0
 */

/* freqme0 is enabled and fully configured (clocks, INPUTMUX routing) at the
 * SoC / board devicetree level. The "monitored" clock (FRO1, ~192 MHz) in the
 * SoC node lets WINDOW mode auto-derive the expected frequency.
 */

/ {
	aliases {
		clock-monitor = &freqme0;
	};
};
