## sample.yaml
```
sample:
  name: Video capture
tests:
  sample.video.capture:
    tags:
      - video
      - shield
      - samples
    extra_args:
      - platform:mimxrt1064_evk:SHIELD="dvp_fpc24_mt9m114;rk043fn66hs_ctg"
      - platform:mimxrt1170_evk/mimxrt1176/cm7:SHIELD="nxp_btb44_ov5640;rk055hdmipi4ma0"
      - platform:mimxrt1170_evk@B/mimxrt1176/cm7:SHIELD="nxp_btb44_ov5640;rk055hdmipi4ma0"
    harness: console
    harness_config:
      fixture: fixture_camera
      type: multi_line
      ordered: true
      regex:
        - "Capture started"
        - "Got frame"
        - "size"
        - "timestamp"
        - "Pattern OK"
        - "^(?!.*Pattern KO).*$" # Not sure if this is correct
    platform_allow:
      - arduino_nicla_vision/stm32h747xx/m7
      - mimxrt1064_evk
      - mimxrt1170_evk/mimxrt1176/cm7
      - mimxrt1170_evk@B/mimxrt1176/cm7
      - mm_swiftio
    depends_on: video
    integration_platforms:
      - mimxrt1064_evk
      - mimxrt1170_evk/mimxrt1176/cm7
      - mimxrt1170_evk@B/mimxrt1176/cm7
```

## prj.conf
```kconfig
CONFIG_VIDEO=y
CONFIG_USB_HOST_STACK=y
CONFIG_PRINTK=y
CONFIG_LOG=y
CONFIG_DISPLAY=y
CONFIG_REQUIRES_FLOAT_PRINTF=y
CONFIG_LOG_MODE_DEFERRED=y
CONFIG_USBH_VIDEO_LOG_LEVEL_WRN=y
```

## prj - Copy.conf
```kconfig
CONFIG_POLL=y
CONFIG_EVENTS=y
CONFIG_SHELL=y
CONFIG_MPIX=y
CONFIG_DEVICE_SHELL=y
CONFIG_VIDEO=y
CONFIG_USB_HOST_STACK=y
CONFIG_PRINTK=y
CONFIG_LOG=y
CONFIG_DISPLAY=y
CONFIG_REQUIRES_FLOAT_PRINTF=y
CONFIG_DEBUG_OPTIMIZATIONS=y
CONFIG_USBH_VIDEO_LOG_LEVEL_WRN=y
CONFIG_VIDEO_FRAME_WIDTH=160
CONFIG_VIDEO_FRAME_HEIGHT=120
```

## boards/imx95_evk_mimx9596_m7_ddr.conf
```kconfig
# nothing here
CONFIG_PM_DEVICE=y

# I2C
CONFIG_I2C=y

# GPIO
CONFIG_GPIO=y

# Pinctrl
CONFIG_PINCTRL=y

# Regulator
CONFIG_REGULATOR=y

# Video (Camera)
CONFIG_VIDEO=y
CONFIG_VIDEO_BUFFER_POOL_NUM_MAX=10
CONFIG_VIDEO_BUFFER_POOL_HEAP_SIZE=16000000
CONFIG_VIDEO_AP1302=y

# GPIO Expanders
CONFIG_GPIO_PCAL64XXA=y
CONFIG_MFD=y
CONFIG_MFD_ADP5585=y
CONFIG_GPIO_ADP5585=y

#MIPI CSI

#ISI
CONFIG_VIDEO_MCUX_ISI=y

#Shell
CONFIG_I2C_SHELL=y

CONFIG_LOG=y
CONFIG_LOG_DEFAULT_LEVEL=3

CONFIG_VIDEO_AP1302_BUILTIN_FIRMWARE=y

CONFIG_VIDEO_CTRL_VFLIP=y
CONFIG_VIDEO_CTRL_HFLIP=y
CONFIG_LOG_BUFFER_SIZE=102400

# this mean get image context from left 270 and 585, it will re-set into needed 540*1170 site
CONFIG_VIDEO_SOURCE_CROP_LEFT=0
CONFIG_VIDEO_SOURCE_CROP_TOP=0
CONFIG_VIDEO_SOURCE_CROP_WIDTH=540
CONFIG_VIDEO_SOURCE_CROP_HEIGHT=1170
```

## boards/rd_rw612_bga.conf
```kconfig
CONFIG_UHC_DRIVER=y
CONFIG_USB_HOST_STACK=y
CONFIG_USBH_VIDEO_CLASS=y

# Video buffer configuration
CONFIG_VIDEO_BUFFER_POOL_SZ_MAX=154000
CONFIG_VIDEO_BUFFER_POOL_NUM_MAX=2
CONFIG_VIDEO_BUFFER_POOL_ALIGN=32


# Memory configuration for USB transfers
CONFIG_HEAP_MEM_POOL_SIZE=70000
CONFIG_MAIN_STACK_SIZE=80960
CONFIG_USBH_USB_DEVICE_HEAP=8912
CONFIG_UHC_BUF_POOL_SIZE=4096
```

## src/main.c
```c
/*
 * Copyright (c) 2019 Linaro Limited
 * Copyright 2025-2026 NXP
 *
 * SPDX-License-Identifier: Apache-2.0
 */

#include <zephyr/kernel.h>
#include <zephyr/device.h>

#include <zephyr/drivers/display.h>
#include <zephyr/drivers/video.h>
#include <zephyr/drivers/video-controls.h>

#include <zephyr/logging/log.h>
LOG_MODULE_REGISTER(main, CONFIG_LOG_DEFAULT_LEVEL);

/*
 * Include transform.h unconditionally to ensure it's compiled and checked by CI,
 * even though the functions in this header are not used here at all.
 * This prevents silent breakage when APIs change.
 */
#include "transform.h"

#if !DT_HAS_CHOSEN(zephyr_camera)
#error No camera chosen in devicetree. Missing "--shield" or "--snippet video-sw-generator" flag?
#endif

/* The default transform implementation is a pass-through when no transform device is available */
int __weak app_setup_video_transform(const struct device *const transform_dev,
				     struct video_format *const in_fmt,
				     struct video_format *const out_fmt,
				     struct video_buffer **out_buf)
{
	*out_fmt = *in_fmt;
	out_fmt->pixelformat = VIDEO_PIX_FMT_RGB565;

	return 0;
}

int __weak app_transform_frame(const struct device *const transform_dev,
			       struct video_buffer *in_buf, struct video_buffer **out_buf)
{
	*out_buf = in_buf;

	return 0;
}

static inline int app_setup_display(const struct device *const display_dev, const uint32_t pixfmt)
{
	struct display_capabilities capabilities;
	int ret = 0;

	LOG_INF("Display device: %s", display_dev->name);

	if (!device_is_ready(display_dev)) {
		LOG_ERR("%s: display device not ready.", display_dev->name);
		return -ENOSYS;
	}

	display_get_capabilities(display_dev, &capabilities);

	LOG_INF("- Capabilities:");
	LOG_INF("  x_resolution = %u, y_resolution = %u, supported_pixel_formats = %u"
		"  current_pixel_format = %u, current_orientation = %u",
		capabilities.x_resolution, capabilities.y_resolution,
		capabilities.supported_pixel_formats, capabilities.current_pixel_format,
		capabilities.current_orientation);

	/* Set display pixel format to match the one in use by the camera */
	switch (pixfmt) {
	case VIDEO_PIX_FMT_RGB565:
		if (capabilities.current_pixel_format != PIXEL_FORMAT_RGB_565) {
			ret = display_set_pixel_format(display_dev, PIXEL_FORMAT_RGB_565);
		}
		break;
	case VIDEO_PIX_FMT_BGRX32:
		if (capabilities.current_pixel_format != PIXEL_FORMAT_XRGB_8888) {
			ret = display_set_pixel_format(display_dev, PIXEL_FORMAT_XRGB_8888);
			if (ret < 0) {
				/* If failed with PIXEL_FORMAT_XRGB_8888, PIXEL_FORMAT_ARGB_8888 is
				 * still applicable
				 */
				ret = display_set_pixel_format(display_dev, PIXEL_FORMAT_ARGB_8888);
			}
		}
		break;
	default:
		LOG_ERR("Display pixel format not supported by this sample");
		return -ENOTSUP;
	}
	if (ret < 0) {
		LOG_ERR("Unable to set display format");
		return ret;
	}

	/* Turn off blanking if driver supports it */
	ret = display_blanking_off(display_dev);
	if (ret == -ENOSYS) {
		LOG_DBG("Display blanking off not available");
		ret = 0;
	}

	return ret;
}

static int app_display_frame(const struct device *const display_dev,
			     const struct video_buffer *const vbuf,
			     const struct video_format *const fmt)
{
	struct display_buffer_descriptor buf_desc = {
		.buf_size = vbuf->bytesused,
		.width = fmt->width,
		.pitch = buf_desc.width,
		.height = vbuf->bytesused / fmt->pitch,
	};

	return display_write(display_dev, 0, vbuf->line_offset, &buf_desc, vbuf->buffer);
}

static int app_setup_video_selection(const struct device *const camera_dev,
				     const struct video_format *const fmt)
{
	struct video_selection sel = {
		.type = VIDEO_BUF_TYPE_OUTPUT,
	};
	int ret;

	/* Set the crop setting only if configured */
	if (CONFIG_VIDEO_SOURCE_CROP_WIDTH > 0) {
		sel.target = VIDEO_SEL_TGT_CROP;
		sel.rect.left = CONFIG_VIDEO_SOURCE_CROP_LEFT;
		sel.rect.top = CONFIG_VIDEO_SOURCE_CROP_TOP;
		sel.rect.width = CONFIG_VIDEO_SOURCE_CROP_WIDTH;
		sel.rect.height = CONFIG_VIDEO_SOURCE_CROP_HEIGHT;

		ret = video_set_selection(camera_dev, &sel);
		if (ret < 0) {
			LOG_ERR("Unable to set selection crop");
			return ret;
		}

		LOG_INF("Crop window set to (%u,%u)/%ux%u",
			sel.rect.left, sel.rect.top, sel.rect.width, sel.rect.height);
	}

	return 0;
}

static int app_query_video_info(const struct device *const camera_dev,
				struct video_caps *const caps,
				struct video_format *const fmt)
{
	int ret;

	LOG_INF("Camera device: %s", camera_dev->name);

	if (!device_is_ready(camera_dev)) {
		LOG_ERR("%s: camera device is not ready", camera_dev->name);
		return -ENOSYS;
	}

	/* Get capabilities */
	ret = video_get_caps(camera_dev, caps);
	if (ret < 0) {
		LOG_ERR("Unable to retrieve video capabilities");
		return ret;
	}

	LOG_INF("- Capabilities:");
	for (int i = 0; caps->format_caps[i].pixelformat; i++) {
		const struct video_format_cap *fcap = &caps->format_caps[i];

		LOG_INF("  %s width [%u; %u; %u] height [%u; %u; %u]",
			VIDEO_FOURCC_TO_STR(fcap->pixelformat),
			fcap->width_min, fcap->width_max, fcap->width_step,
			fcap->height_min, fcap->height_max, fcap->height_step);
	}

	/* Get default/native format */
	ret = video_get_format(camera_dev, fmt);
	if (ret < 0) {
		LOG_ERR("Unable to retrieve video format");
	}

	/* Adjust video format according to the configuration */
	if (CONFIG_VIDEO_FRAME_HEIGHT > 0) {
		fmt->height = CONFIG_VIDEO_FRAME_HEIGHT;
	}
	if (CONFIG_VIDEO_FRAME_WIDTH > 0) {
		fmt->width = CONFIG_VIDEO_FRAME_WIDTH;
	}
	if (strcmp(CONFIG_VIDEO_PIXEL_FORMAT, "") != 0) {
		fmt->pixelformat = VIDEO_FOURCC_FROM_STR(CONFIG_VIDEO_PIXEL_FORMAT);
	}

	return 0;
}

static int app_setup_video_format(const struct device *const camera_dev,
				  struct video_format *const fmt)
{
	int ret;

	LOG_INF("- Video format: %s %ux%u",
		VIDEO_FOURCC_TO_STR(fmt->pixelformat), fmt->width, fmt->height);

	ret = video_set_compose_format(camera_dev, fmt);
	if (ret < 0) {
		LOG_ERR("Unable to set format");
		return ret;
	}

	return 0;
}

static int app_setup_video_frmival(const struct device *const camera_dev,
				   struct video_format *const fmt)
{
	struct video_frmival frmival = {};
	struct video_frmival_enum fie = {
		.format = fmt,
	};
	int ret;

	LOG_INF("- Supported frame intervals for the default format:");

	while (video_enum_frmival(camera_dev, &fie) == 0) {
		if (fie.type == VIDEO_FRMIVAL_TYPE_DISCRETE) {
			LOG_INF("   %u/%u", fie.discrete.numerator, fie.discrete.denominator);
		} else {
			LOG_INF("   [min = %u/%u; max = %u/%u; step = %u/%u]",
				fie.stepwise.min.numerator, fie.stepwise.min.denominator,
				fie.stepwise.max.numerator, fie.stepwise.max.denominator,
				fie.stepwise.step.numerator, fie.stepwise.step.denominator);
		}
		fie.index++;
	}

	ret = video_get_frmival(camera_dev, &frmival);
	if (ret == -ENOTSUP || ret == -ENOSYS) {
		LOG_WRN("The video source does not support frame rate control");
	} else if (ret < 0) {
		LOG_ERR("Error while getting the frame interval");
		return ret;
	} else if (ret == 0) {
		LOG_INF("- Default frame rate : %f fps",
			1.0 * frmival.denominator / frmival.numerator);
	}

	return 0;
}

static int app_setup_video_controls(const struct device *const camera_dev)
{
	int ret;

	/* Get supported controls */
	LOG_INF("- Supported controls:");
	const struct device *last_dev = NULL;
	struct video_ctrl_query cq = {.dev = camera_dev, .id = VIDEO_CTRL_FLAG_NEXT_CTRL};

	while (video_query_ctrl(&cq) == 0) {
		if (cq.dev != last_dev) {
			last_dev = cq.dev;
			LOG_INF("\t\tdevice: %s", cq.dev->name);
		}
		video_print_ctrl(&cq);
		cq.id |= VIDEO_CTRL_FLAG_NEXT_CTRL;
	}

	/* Set controls */
	struct video_control ctrl = {.id = VIDEO_CID_HFLIP, .val = 1};

	if (IS_ENABLED(CONFIG_VIDEO_CTRL_HFLIP)) {
		ret = video_set_ctrl(camera_dev, &ctrl);
		if (ret < 0) {
			LOG_ERR("Failed to set horizontal flip");
			return ret;
		}
	}

	if (IS_ENABLED(CONFIG_VIDEO_CTRL_VFLIP)) {
		ctrl.id = VIDEO_CID_VFLIP;
		ret = video_set_ctrl(camera_dev, &ctrl);
		if (ret < 0) {
			LOG_ERR("Failed to set vertical flip");
			return ret;
		}
	}

	if (IS_ENABLED(CONFIG_TEST)) {
		ctrl.id = VIDEO_CID_TEST_PATTERN;
		ret = video_set_ctrl(camera_dev, &ctrl);
		if (ret < 0 && ret != -ENOTSUP) {
			LOG_WRN("Failed to set the test pattern");
		}
	}

	return 0;
}

static int app_setup_video_buffers(const struct device *const camera_dev,
				   struct video_caps *const caps,
				   struct video_format *const fmt)
{
	int ret;

	/* Alloc video buffers and enqueue for capture */
	if (caps->min_vbuf_count > 3) {
		LOG_ERR("Not enough buffers to start streaming");
		return -EINVAL;
	}

	for (uint8_t i = 0; i < 3; i++) {
		struct video_buffer *vbuf;

		/*
		 * For some hardwares, such as the PxP used on i.MX RT1170 to do image rotation,
		 * buffer alignment is needed in order to achieve the best performance
		 */
		vbuf = video_buffer_aligned_alloc(fmt->size, CONFIG_VIDEO_BUFFER_POOL_ALIGN,
						  K_NO_WAIT);
		if (vbuf == NULL) {
			LOG_ERR("Unable to alloc video buffer");
			return -ENOMEM;
		}

		vbuf->type = VIDEO_BUF_TYPE_OUTPUT;

		ret = video_enqueue(camera_dev, vbuf);
		if (ret < 0) {
			LOG_ERR("Failed to enqueue video buffer");
			return ret;
		}
	}

	return 0;
}

int l = 1;
int main(void)
{
	//while (l == 1)
	{
		;
	}
	const struct device *const camera_dev = DEVICE_DT_GET(DT_CHOSEN(zephyr_camera));
	const struct device *const display_dev = DEVICE_DT_GET_OR_NULL(DT_CHOSEN(zephyr_display));
	const struct device *transform_dev = NULL;
	struct video_buffer *camera_vbuf = &(struct video_buffer){};
	struct video_buffer *transformed_vbuf = &(struct video_buffer){};
	struct video_format camera_fmt = {
		.type = VIDEO_BUF_TYPE_OUTPUT,
	};
	struct video_format transformed_fmt = {
		.type = VIDEO_BUF_TYPE_OUTPUT,
	};
	struct video_caps caps = {
		.type = VIDEO_BUF_TYPE_OUTPUT,
	};
	unsigned int frame = 0;
	uint32_t last_ts = 0;
	int ret;

	/* When the video shell is enabled, do not run the capture loop unless requested */
	if (IS_ENABLED(CONFIG_VIDEO_SHELL) && !IS_ENABLED(CONFIG_VIDEO_SHELL_AND_CAPTURE)) {
		LOG_INF("Letting the user control the device with the video shell");
		return 0;
	}

	transform_dev = DEVICE_DT_GET_OR_NULL(DT_CHOSEN(zephyr_videotrans));
	if (transform_dev == NULL) {
		transform_dev = DEVICE_DT_GET_OR_NULL(DT_CHOSEN(zephyr_videodec));
	}

	ret = app_query_video_info(camera_dev, &caps, &camera_fmt);
	if (ret < 0) {
		goto err;
	}

	ret = app_setup_video_selection(camera_dev, &camera_fmt);
	if (ret < 0) {
		goto err;
	}

	ret = app_setup_video_format(camera_dev, &camera_fmt);
	if (ret < 0) {
		goto err;
	}

	ret = app_setup_video_frmival(camera_dev, &camera_fmt);
	if (ret < 0) {
		goto err;
	}

	ret = app_setup_video_controls(camera_dev);
	if (ret < 0) {
		goto err;
	}

	ret = app_setup_video_transform(transform_dev, &camera_fmt, &transformed_fmt,
					&transformed_vbuf);
	if (ret < 0) {
		LOG_ERR("Unable to setup video transform");
		goto err;
	}

	if (DT_HAS_CHOSEN(zephyr_display)) {
		ret = app_setup_display(display_dev, transformed_fmt.pixelformat);
		if (ret < 0) {
			goto err;
		}
	}

	ret = app_setup_video_buffers(camera_dev, &caps, &camera_fmt);
	if (ret < 0) {
		goto err;
	}

	ret = video_stream_start(camera_dev, VIDEO_BUF_TYPE_OUTPUT);
	if (ret < 0) {
		LOG_ERR("Unable to start capture (interface)");
		goto err;
	}

	LOG_INF("Capture started");

	camera_vbuf->type = VIDEO_BUF_TYPE_OUTPUT;
	while (1) {
		ret = video_dequeue(camera_dev, &camera_vbuf, K_FOREVER);
		if (ret < 0) {
			LOG_ERR("Unable to dequeue video buf");
			goto err;
		}

		if ((frame % 60U) == 0U) {
		LOG_INF("Got frame %u! size: %u; timestamp %u ms (delta %u ms)", frame++,
			camera_vbuf->bytesused, camera_vbuf->timestamp,
			camera_vbuf->timestamp - last_ts);
		}
		else
		{
			frame++;
		}
		last_ts = camera_vbuf->timestamp;

		ret = app_transform_frame(transform_dev, camera_vbuf, &transformed_vbuf);
		if (ret < 0) {
			LOG_ERR("Unable to transform video frame");
			goto err;
		}

		if (DT_HAS_CHOSEN(zephyr_display)) {
			ret = app_display_frame(display_dev, transformed_vbuf, &transformed_fmt);
			if (ret != 0) {
				LOG_WRN("Failed to display this frame");
			}
		}

		ret = video_enqueue(camera_dev, camera_vbuf);
		if (ret < 0) {
			LOG_ERR("Unable to requeue video buf");
			goto err;
		}
	}

err:
	LOG_ERR("Aborting sample");
	return 0;
}
```

## src/transform_nxp_jpegdec.c
```c
/*
 * Copyright 2026 NXP
 *
 * SPDX-License-Identifier: Apache-2.0
 */

#include <zephyr/kernel.h>
#include <zephyr/device.h>
#include <zephyr/drivers/video.h>
#include "transform.h"

#ifdef CONFIG_VIDEO_NXP_JPEGDEC_CSC
static void app_convert_yuv420_to_rgb565(uint16_t width, uint16_t height, uint32_t yAddr,
				     uint32_t uvAddr, uint32_t rgbAddr)
{
	uint16_t *rgb = (void *)rgbAddr;
	int16_t r, g, b;
	uint8_t R, G, B, y, u, v;

	uint16_t i, j;

	for (i = 0U; i < height; i++) {
		for (j = 0U; j < width; j++) {
			y = *(((uint8_t *)yAddr) + width * i + j);
			u = *(((uint8_t *)uvAddr) + width * (i / 2) + j - (j % 2));
			v = *(((uint8_t *)uvAddr) + width * (i / 2) + j + 1 - (j % 2));
			r = y + 1402 * (v - 128) / 1000;
			g = y - (344 * (u - 128) + 714 * (v - 128)) / 1000;
			b = y + 1772 * (u - 128) / 1000;
			R = CLAMP(r, 0, 255);
			G = CLAMP(g, 0, 255);
			B = CLAMP(b, 0, 255);
			*rgb++ = (uint16_t)((((uint16_t)R & 0xF8) << 8U) |
					    (((uint16_t)G & 0xFC) << 3U) |
					    (((uint16_t)B & 0xF8) >> 3U));
		}
	}
}
#endif

int app_setup_video_transform(const struct device *const transform_dev, struct video_format in_fmt,
			      struct video_format *const out_fmt, struct video_buffer **out_buf)
{
	out_fmt->pixelformat = VIDEO_PIX_FMT_NV12; /* Decoder output format shall be NV12 */
	out_fmt->width = CONFIG_VIDEO_FRAME_WIDTH;
	out_fmt->height = CONFIG_VIDEO_FRAME_HEIGHT;
	out_fmt->pitch = out_fmt->width;
	out_fmt->size = out_fmt->width * out_fmt->height * 2U;

	int ret = setup_video_transform(transform_dev, in_fmt, out_fmt, out_buf);

#ifdef CONFIG_VIDEO_NXP_JPEGDEC_CSC
	if (ret < 0) {
		return ret;
	}

	/* The transfromed format shall be RGB565 for display panel to show. */
	out_fmt->pixelformat = VIDEO_PIX_FMT_RGB565;
	out_fmt->pitch = out_fmt->width * 2U;

	return 0;
#else
	return ret;
#endif
}

int app_transform_frame(const struct device *const transform_dev, struct video_buffer *in_buf,
			struct video_buffer **out_buf)
{
	int ret = transform_frame(transform_dev, in_buf, out_buf);

#ifdef CONFIG_VIDEO_NXP_JPEGDEC_CSC
	if (ret < 0) {
		return ret;
	}

	/* Change the decoded NV12 2-p pixel to RGB565 for display to show. */
	uint8_t *rgb565 = k_aligned_alloc(CONFIG_VIDEO_BUFFER_POOL_ALIGN, (*out_buf)->bytesused);

	app_convert_yuv420_to_rgb565(CONFIG_VIDEO_FRAME_WIDTH, CONFIG_VIDEO_FRAME_HEIGHT,
				 (uint32_t)(*out_buf)->buffer,
				 (uint32_t)((*out_buf)->buffer +
					    CONFIG_VIDEO_FRAME_WIDTH * CONFIG_VIDEO_FRAME_HEIGHT),
				 (uint32_t)rgb565);

	memcpy((*out_buf)->buffer, rgb565,
	       CONFIG_VIDEO_FRAME_WIDTH * CONFIG_VIDEO_FRAME_HEIGHT * 2U);

	return 0;
#else
	return ret;
#endif
}
```
