## CMakeLists.txt
```
# SPDX-License-Identifier: Apache-2.0

cmake_minimum_required(VERSION 3.20.0)
find_package(Zephyr REQUIRED HINTS $ENV{ZEPHYR_BASE})
project(nvmem)

FILE(GLOB app_sources src/*.c)
target_sources(app PRIVATE ${app_sources})
```

## sample.yaml
```
sample:
  name: NVMEM Sample

tests:
  sample.drivers.nvmem:
    tags: nvmem
    platform_allow:
      #- gd32f450i_eval
      #- native_sim
      #- native_sim/native/64
      #- adafruit_qt_py_rp2040/rp2040
    integration_platforms:
      #- native_sim/native/64
    extra_args:
      - platform:adafruit_qt_py_rp2040/rp2040:SHIELD="adafruit_24lc32"
    harness: console
    harness_config:
      type: one_line
      regex:
        - "Reset the MCU to see the increasing boot counter."
  sample.drivers.nvmem.shield.x_nucleo_eeprma2:
    tags:
      - nvmem
      - shield
    depends_on:
      - arduino_gpio
      - arduino_i2c
      - arduino_spi
    platform_exclude:
      - ubx_evkannab1/nrf52832
      - sam_v71_xult/samv71q21
      - sam_v71_xult/samv71q21b
      - pan1781_evb
      - pan1782_evb
      - pan1770_evb
      - pan1780_evb
      - mimxrt1010_evk
    extra_args: SHIELD=x_nucleo_eeprma2
    harness: console
    harness_config:
      fixture: fixture_shield_x_nucleo_eeprma2
    integration_platforms:
      #- nucleo_f070rb
```

## prj.conf
```kconfig
CONFIG_PRINTK=y
CONFIG_NVMEM_MODEL=y
```

## boards/gd32e103v_eval.conf
```kconfig
CONFIG_NVMEM_INIT_PRIORITY=75
```

## src/main.c
```c
/*
 * Copied from eeprom sample and modified to use nvmem API
 *
 * Copyright (c) 2021 Thomas Stranger
 * Copyright 2025 NXP
 *
 * SPDX-License-Identifier: Apache-2.0
 */

#include <zephyr/kernel.h>
#include <zephyr/sys/printk.h>
#include <zephyr/drivers/nvmem.h>
#include <zephyr/device.h>

#define NVMEM_SAMPLE_OFFSET 0
#define NVMEM_SAMPLE_MAGIC  0xEE9703

struct perisistant_values {
	uint32_t magic;
	uint32_t boot_count;
};

/*
 * Get a device structure from a devicetree node with alias nvmem-0
 */
static const struct device *get_nvmem_device(void)
{
	const struct device *const dev = DEVICE_DT_GET(DT_ALIAS(nvmem_0));

	if (!device_is_ready(dev)) {
		printk("\nError: Device \"%s\" is not ready; "
		       "check the driver initialization logs for errors.\n",
		       dev->name);
		return NULL;
	}

	printk("Found NVMEM device \"%s\"\n", dev->name);
	return dev;
}

int main(void)
{
	const struct device *nvmem = get_nvmem_device();
	size_t nvmem_size;
	struct perisistant_values values;
	int rc;

	if (nvmem == NULL) {
		return 0;
	}

	nvmem_size = nvmem_get_size(nvmem);
	printk("Using nvmem with size of: %zu.\n", nvmem_size);

	rc = nvmem_read(nvmem, NVMEM_SAMPLE_OFFSET, &values, sizeof(values));
	if (rc < 0) {
		printk("Error: Couldn't read nvmem: err: %d.\n", rc);
		return 0;
	}

	if (values.magic != NVMEM_SAMPLE_MAGIC) {
		values.magic = NVMEM_SAMPLE_MAGIC;
		values.boot_count = 0;
	}

	values.boot_count++;
	printk("Device booted %d times.\n", values.boot_count);

	rc = nvmem_write(nvmem, NVMEM_SAMPLE_OFFSET, &values, sizeof(values));
	if (rc < 0) {
		printk("Error: Couldn't write nvmem: err:%d.\n", rc);
		return 0;
	}

	printk("Reset the MCU to see the increasing boot counter.\n\n");
	return 0;
}
```
