## CMakeLists.txt
```
# SPDX-FileCopyrightText: Copyright 2026 NXP
# SPDX-License-Identifier: Apache-2.0

cmake_minimum_required(VERSION 3.20.0)

option(LC3_TEST_HOST "Build codec/protocol host tests instead of firmware" OFF)
option(LC3_TEST_HOST_EXTENSIONS "Enable LC3plus and HR in host tests" OFF)

if(LC3_TEST_HOST)
  project(lc3_codec_host_test C)
  set(LIBLC3_DIR "" CACHE PATH "Path to the unmodified liblc3 module")
  if(NOT EXISTS "${LIBLC3_DIR}/include/lc3.h")
    message(FATAL_ERROR "Set LIBLC3_DIR to the west liblc3 checkout")
  endif()
  add_executable(lc3_codec_test
    src/codec.c
    src/protocol.c
    tests/test_codec.c
    "${LIBLC3_DIR}/src/attdet.c"
    "${LIBLC3_DIR}/src/bits.c"
    "${LIBLC3_DIR}/src/bwdet.c"
    "${LIBLC3_DIR}/src/energy.c"
    "${LIBLC3_DIR}/src/lc3.c"
    "${LIBLC3_DIR}/src/ltpf.c"
    "${LIBLC3_DIR}/src/mdct.c"
    "${LIBLC3_DIR}/src/plc.c"
    "${LIBLC3_DIR}/src/sns.c"
    "${LIBLC3_DIR}/src/spec.c"
    "${LIBLC3_DIR}/src/tables.c"
    "${LIBLC3_DIR}/src/tns.c"
  )
  target_include_directories(lc3_codec_test PRIVATE
    src
    "${LIBLC3_DIR}/include"
    "${CMAKE_CURRENT_SOURCE_DIR}/../../../../include"
  )
  target_compile_features(lc3_codec_test PRIVATE c_std_11)
  target_compile_options(lc3_codec_test PRIVATE -Wall -Wextra -Werror -UNDEBUG)
  target_compile_definitions(lc3_codec_test PRIVATE
    CONFIG_ARCH_POSIX=1
    CONFIG_LITTLE_ENDIAN=1
    LC3_PLUS=$<BOOL:${LC3_TEST_HOST_EXTENSIONS}>
    LC3_PLUS_HR=$<BOOL:${LC3_TEST_HOST_EXTENSIONS}>
  )
  if(LC3_TEST_HOST_EXTENSIONS)
    target_compile_definitions(lc3_codec_test PRIVATE CONFIG_LIBLC3_PLUS=1 CONFIG_LIBLC3_PLUS_HR=1)
  endif()
  target_link_libraries(lc3_codec_test PRIVATE m)
  enable_testing()
  add_test(NAME codec_protocol COMMAND lc3_codec_test)
  return()
endif()

find_package(Zephyr REQUIRED HINTS $ENV{ZEPHYR_BASE})
project(lc3_codec_test)

include("${ZEPHYR_BASE}/samples/subsys/usb/common/common.cmake")
target_sources(app PRIVATE
  src/main.c
  src/codec.c
  src/protocol.c
)
```

## Kconfig
```
# SPDX-FileCopyrightText: Copyright 2026 NXP
# SPDX-License-Identifier: Apache-2.0

source "samples/subsys/usb/common/Kconfig.sample_usbd"

source "Kconfig.zephyr"
```

## prj.conf
```kconfig
# SPDX-FileCopyrightText: Copyright 2026 NXP
# SPDX-License-Identifier: Apache-2.0

CONFIG_LIBLC3=y
CONFIG_LIBLC3_PLUS=n
CONFIG_LIBLC3_PLUS_HR=n
CONFIG_FPU=y

CONFIG_USB_DEVICE_STACK_NEXT=y
CONFIG_SERIAL=y
CONFIG_UART_INTERRUPT_DRIVEN=y
CONFIG_UART_LINE_CTRL=y
CONFIG_CDC_ACM_SERIAL_INITIALIZE_AT_BOOT=n
CONFIG_SAMPLE_USBD_PRODUCT="LC3 codec test"

CONFIG_CONSOLE=y
CONFIG_UART_CONSOLE=y
CONFIG_STDOUT_CONSOLE=y
CONFIG_LOG=y
CONFIG_LOG_BACKEND_UART=y
CONFIG_LOG_PRINTK=y
CONFIG_SHELL=n

CONFIG_MAIN_STACK_SIZE=8192
CONFIG_SYSTEM_WORKQUEUE_STACK_SIZE=2048
CONFIG_HEAP_MEM_POOL_SIZE=16384
```

## lc3plus.conf
```kconfig
# SPDX-FileCopyrightText: Copyright 2026 NXP
# SPDX-License-Identifier: Apache-2.0

CONFIG_LIBLC3_PLUS=y
CONFIG_LIBLC3_PLUS_HR=y
```

## app.overlay
```dts
/*
 * SPDX-FileCopyrightText: Copyright 2026 NXP
 * SPDX-License-Identifier: Apache-2.0
 */

&zephyr_udc0 {
	cdc_acm_uart0 {
		compatible = "zephyr,cdc-acm-uart";
		label = "LC3 codec test";
	};
};
```

## boards/mimxrt1170_evk_mimxrt1176_cm7_B.overlay
```dts
/*
 * Copyright 2025 NXP
 *
 * SPDX-License-Identifier: Apache-2.0
 */

#include "../app.overlay"

/ {
	chosen {
		zephyr,sram = &dtcm;
	};
};
```

## src/main.c
```c
/*
 * SPDX-FileCopyrightText: Copyright 2026 NXP
 * SPDX-License-Identifier: Apache-2.0
 */

#include "protocol.h"

#include <sample_usbd.h>
#include <zephyr/device.h>
#include <zephyr/drivers/uart.h>
#include <zephyr/kernel.h>
#include <zephyr/logging/log.h>
#include <zephyr/sys/byteorder.h>
#include <zephyr/sys/ring_buffer.h>

LOG_MODULE_REGISTER(lc3_codec_test, LOG_LEVEL_INF);

static const struct device *const cdc = DEVICE_DT_GET_ONE(zephyr_cdc_acm_uart);
RING_BUF_DECLARE(rx_ring, 8192U);
RING_BUF_DECLARE(tx_ring, 4096U);
K_SEM_DEFINE(io_event, 0, 1);
static struct k_spinlock io_lock;
static bool connected;
static bool rx_throttled;
static uint32_t generation;
static uint32_t worker_generation;

static void connection_set(bool active)
{
	k_spinlock_key_t key = k_spin_lock(&io_lock);

	connected = active;
	generation++;
	uart_irq_rx_disable(cdc);
	uart_irq_tx_disable(cdc);
	k_spin_unlock(&io_lock, key);
	k_sem_give(&io_event);
}

static void usb_message(struct usbd_context *const context, const struct usbd_msg *message)
{
	if (message->type == USBD_MSG_CDC_ACM_CONTROL_LINE_STATE) {
		uint32_t dtr = 0U;

		if (uart_line_ctrl_get(message->dev, UART_LINE_CTRL_DTR, &dtr) == 0) {
			connection_set(dtr != 0U);
		}
	} else if (message->type == USBD_MSG_RESET || message->type == USBD_MSG_UDC_ERROR ||
		   message->type == USBD_MSG_STACK_ERROR ||
		   (message->type == USBD_MSG_CONFIGURATION && message->status == 0)) {
		connection_set(false);
	}
	if (usbd_can_detect_vbus(context)) {
		if (message->type == USBD_MSG_VBUS_READY) {
			if (usbd_enable(context) != 0) {
				LOG_ERR("USB enable failed");
			}
		} else if (message->type == USBD_MSG_VBUS_REMOVED) {
			connection_set(false);
			if (usbd_disable(context) != 0) {
				LOG_ERR("USB disable failed");
			}
		}
	}
}

static void uart_interrupt(const struct device *device, void *user_data)
{
	ARG_UNUSED(user_data);

	while (true) {
		uart_irq_update(device);
		if (uart_irq_is_pending(device) <= 0) {
			break;
		}

		k_spinlock_key_t key = k_spin_lock(&io_lock);
		bool progress = false;
		uint8_t *buffer;
		uint32_t space;
		int transferred;
		int tx_ready;

		if (!connected || generation != worker_generation) {
			k_spin_unlock(&io_lock, key);
			break;
		}
		if (!rx_throttled && uart_irq_rx_ready(device) > 0) {
			space = MIN(ring_buf_put_ptr(&rx_ring, &buffer, 0U), 256U);
			if (space == 0U) {
				uart_irq_rx_disable(device);
				rx_throttled = true;
			} else {
				transferred = uart_fifo_read(device, buffer, space);
				ring_buf_commit(&rx_ring, transferred > 0 ? transferred : 0U);
				progress = transferred > 0;
			}
		}
		tx_ready = uart_irq_tx_ready(device);
		if (tx_ready > 0) {
			space = MIN(ring_buf_get_ptr(&tx_ring, &buffer, 0U), MIN(tx_ready, 256U));
			if (space == 0U) {
				uart_irq_tx_disable(device);
			} else {
				transferred = uart_fifo_fill(device, buffer, space);
				ring_buf_consume(&tx_ring, transferred > 0 ? transferred : 0U);
				progress = progress || transferred > 0;
			}
		}
		k_spin_unlock(&io_lock, key);
		if (progress) {
			k_sem_give(&io_event);
		} else {
			break;
		}
	}
}

static int send_bytes(const uint8_t *data, size_t length)
{
	int64_t deadline = k_uptime_get() + 30000;

	while (length > 0U) {
		k_spinlock_key_t key = k_spin_lock(&io_lock);
		uint32_t sent;

		if (!connected || generation != worker_generation) {
			k_spin_unlock(&io_lock, key);
			return -ECONNRESET;
		}
		sent = ring_buf_put(&tx_ring, data, length);
		uart_irq_tx_enable(cdc);
		k_spin_unlock(&io_lock, key);
		data += sent;
		length -= sent;
		if (sent == 0U) {
			if (k_uptime_get() >= deadline) {
				connection_set(false);
				return -ETIMEDOUT;
			}
			k_sem_take(&io_event, K_MSEC(100));
		}
	}
	return 0;
}

static int send_packet(uint8_t type, const void *data, size_t length)
{
	uint8_t header[PROTOCOL_HEADER_SIZE] = {type};
	int ret;

	sys_put_le32(length, header + 1U);
	ret = send_bytes(header, sizeof(header));
	if (ret != 0) {
		return ret;
	}
	return send_bytes(data, length);
}

int main(void)
{
	struct usbd_context *usb;
	uint8_t chunk[256];
	int ret;

	if (!device_is_ready(cdc)) {
		LOG_ERR("USB CDC device not ready");
		return -ENODEV;
	}
	ret = uart_irq_callback_user_data_set(cdc, uart_interrupt, NULL);
	if (ret != 0) {
		LOG_ERR("USB CDC IRQ callback: %d", ret);
		return ret;
	}
	usb = sample_usbd_init_device(usb_message);
	if (usb == NULL) {
		return -ENODEV;
	}
	if (!usbd_can_detect_vbus(usb)) {
		ret = usbd_enable(usb);
		if (ret != 0) {
			return ret;
		}
	}
	LOG_INF("LC3 USB test ready; console remains on debug UART");

	while (true) {
		k_spinlock_key_t key = k_spin_lock(&io_lock);
		size_t length = 0U;

		if (generation != worker_generation) {
			protocol_reset();
			ring_buf_reset(&rx_ring);
			ring_buf_reset(&tx_ring);
			worker_generation = generation;
			rx_throttled = false;
			if (connected) {
				uart_irq_rx_enable(cdc);
			}
		}
		if (connected) {
			length = ring_buf_get(&rx_ring, chunk, sizeof(chunk));
			if (rx_throttled && length > 0U) {
				rx_throttled = false;
				uart_irq_rx_enable(cdc);
			}
		}
		k_spin_unlock(&io_lock, key);
		if (length == 0U) {
			k_sem_take(&io_event, K_FOREVER);
			continue;
		}
		ret = protocol_feed(chunk, length, send_packet);
		if (ret != 0) {
			LOG_WRN("USB response interrupted: %d", ret);
			protocol_reset();
		}
	}
	return 0;
}
```

## src/codec.c
```c
/*
 * SPDX-FileCopyrightText: Copyright 2026 NXP
 * SPDX-License-Identifier: Apache-2.0
 */

#include "codec.h"

#include <errno.h>
#include <string.h>

static struct codec_status encoder_status;
static struct codec_status decoder_status;
static lc3_encoder_t encoder;
static lc3_decoder_t decoder;

int codec_config_check(const struct codec_config *config)
{
	if (config == NULL || config->format < LC3_PCM_FORMAT_S16 ||
	    config->format > LC3_PCM_FORMAT_FLOAT || config->sr_pcm_hz < 0) {
		return -EINVAL;
	}
#if !defined(CONFIG_LIBLC3_PLUS_HR)
	if (config->hrmode) {
		return -ENOTSUP;
	}
#endif
#if !defined(CONFIG_LIBLC3_PLUS)
	if (config->dt_us == 2500 || config->dt_us == 5000) {
		return -ENOTSUP;
	}
#endif
	if (lc3_hr_frame_samples(config->hrmode, config->dt_us, config->sr_hz) <= 0) {
		return -EINVAL;
	}
	if (config->sr_pcm_hz != 0 &&
	    (config->sr_pcm_hz < config->sr_hz ||
	     lc3_hr_frame_samples(config->hrmode, config->dt_us, config->sr_pcm_hz) <= 0)) {
		return -EINVAL;
	}
	return 0;
}

size_t codec_pcm_size(const struct codec_status *status)
{
	static const uint8_t widths[] = {2U, 4U, 3U, 4U};

	if (!status->configured) {
		return 0U;
	}
	return (size_t)status->frame_samples * widths[status->config.format];
}

int codec_encoder_setup(const struct codec_config *config, int32_t bitrate, bool disable_ltpf)
{
#if defined(CONFIG_LIBLC3_PLUS_HR)
	static LC3_ENCODER_MEM_T(10000, 96000) memory;
#else
	static lc3_encoder_mem_48k_t memory;
#endif
	int ret;
	int32_t pcm_rate;
	int32_t frame_bytes;

	encoder = NULL;
	memset(&encoder_status, 0, sizeof(encoder_status));
	if (disable_ltpf) {
		return -ENOTSUP;
	}
	ret = codec_config_check(config);
	if (ret != 0) {
		return ret;
	}
	if (bitrate <= 0) {
		return -EINVAL;
	}
	frame_bytes = lc3_hr_frame_bytes(config->hrmode, config->dt_us, config->sr_hz, bitrate);
	if (frame_bytes <= 0) {
		return -EINVAL;
	}
	pcm_rate = config->sr_pcm_hz != 0 ? config->sr_pcm_hz : config->sr_hz;
	if (lc3_hr_encoder_size(config->hrmode, config->dt_us, pcm_rate) > sizeof(memory)) {
		return -ENOMEM;
	}
	encoder = lc3_hr_setup_encoder(config->hrmode, config->dt_us, config->sr_hz,
				      pcm_rate, &memory);
	if (encoder == NULL) {
		return -EINVAL;
	}
	encoder_status.config = *config;
	encoder_status.config.sr_pcm_hz = pcm_rate;
	encoder_status.bitrate = bitrate;
	encoder_status.frame_samples = lc3_hr_frame_samples(config->hrmode, config->dt_us, pcm_rate);
	encoder_status.frame_bytes = frame_bytes;
	encoder_status.configured = true;
	return 0;
}

int codec_decoder_setup(const struct codec_config *config)
{
#if defined(CONFIG_LIBLC3_PLUS_HR)
	static LC3_DECODER_MEM_T(10000, 96000) memory;
#else
	static lc3_decoder_mem_48k_t memory;
#endif
	int ret;
	int32_t pcm_rate;

	decoder = NULL;
	memset(&decoder_status, 0, sizeof(decoder_status));
	ret = codec_config_check(config);
	if (ret != 0) {
		return ret;
	}
	pcm_rate = config->sr_pcm_hz != 0 ? config->sr_pcm_hz : config->sr_hz;
	if (lc3_hr_decoder_size(config->hrmode, config->dt_us, pcm_rate) > sizeof(memory)) {
		return -ENOMEM;
	}
	decoder = lc3_hr_setup_decoder(config->hrmode, config->dt_us, config->sr_hz,
				      pcm_rate, &memory);
	if (decoder == NULL) {
		return -EINVAL;
	}
	decoder_status.config = *config;
	decoder_status.config.sr_pcm_hz = pcm_rate;
	decoder_status.frame_samples = lc3_hr_frame_samples(config->hrmode, config->dt_us, pcm_rate);
	decoder_status.configured = true;
	return 0;
}

int codec_encode(const void *pcm, size_t pcm_size, void *output, size_t output_size)
{
	int ret;

	if (!encoder_status.configured) {
		return -EPERM;
	}
	if (pcm == NULL || output == NULL || pcm_size != codec_pcm_size(&encoder_status) ||
	    output_size < (size_t)encoder_status.frame_bytes) {
		return -EINVAL;
	}
	ret = lc3_encode(encoder, encoder_status.config.format, pcm, 1,
			 encoder_status.frame_bytes, output);
	if (ret == 0) {
		encoder_status.frames++;
	} else {
		encoder_status.errors++;
	}
	return ret;
}

int codec_decode(const void *frame, size_t frame_size, void *pcm, size_t pcm_size)
{
	int ret;

	if (!decoder_status.configured) {
		return -EPERM;
	}
	if (pcm == NULL || pcm_size < codec_pcm_size(&decoder_status) ||
	    frame_size > LC3_HR_MAX_FRAME_BYTES || (frame == NULL && frame_size != 0U) ||
	    (frame != NULL && frame_size == 0U)) {
		return -EINVAL;
	}
	ret = lc3_decode(decoder, frame, (int)frame_size, decoder_status.config.format, pcm, 1);
	if (ret >= 0) {
		decoder_status.frames++;
		if (ret == 1) {
			decoder_status.plc++;
		}
	} else {
		decoder_status.errors++;
	}
	return ret;
}

const struct codec_status *codec_encoder_status(void)
{
	return &encoder_status;
}

const struct codec_status *codec_decoder_status(void)
{
	return &decoder_status;
}

void codec_reset(void)
{
	encoder = NULL;
	decoder = NULL;
	memset(&encoder_status, 0, sizeof(encoder_status));
	memset(&decoder_status, 0, sizeof(decoder_status));
}
```

## src/codec.h
```c
/*
 * SPDX-FileCopyrightText: Copyright 2026 NXP
 * SPDX-License-Identifier: Apache-2.0
 */

#ifndef LC3_TEST_CODEC_H_
#define LC3_TEST_CODEC_H_

#include <lc3.h>
#include <stdbool.h>
#include <stddef.h>
#include <stdint.h>

struct codec_config {
	bool hrmode;
	int32_t dt_us;
	int32_t sr_hz;
	int32_t sr_pcm_hz;
	enum lc3_pcm_format format;
};

struct codec_status {
	struct codec_config config;
	bool configured;
	int32_t bitrate;
	int32_t frame_samples;
	int32_t frame_bytes;
	uint32_t frames;
	uint32_t errors;
	uint32_t plc;
};

int codec_config_check(const struct codec_config *config);
size_t codec_pcm_size(const struct codec_status *status);
int codec_encoder_setup(const struct codec_config *config, int32_t bitrate, bool disable_ltpf);
int codec_decoder_setup(const struct codec_config *config);
int codec_encode(const void *pcm, size_t pcm_size, void *output, size_t output_size);
int codec_decode(const void *frame, size_t frame_size, void *pcm, size_t pcm_size);
const struct codec_status *codec_encoder_status(void);
const struct codec_status *codec_decoder_status(void);
void codec_reset(void);

#endif
```

## src/protocol.c
```c
/*
 * SPDX-FileCopyrightText: Copyright 2026 NXP
 * SPDX-License-Identifier: Apache-2.0
 */

#include "codec.h"
#include "protocol.h"

#include <errno.h>
#include <stdio.h>
#include <string.h>
#include <zephyr/sys/byteorder.h>

static uint8_t header[PROTOCOL_HEADER_SIZE];
static uint8_t payload[PROTOCOL_MAX_PAYLOAD];
static union {
	uint8_t bytes[PROTOCOL_MAX_PAYLOAD];
	int16_t s16[PROTOCOL_MAX_PAYLOAD / 2U];
	int32_t s24[PROTOCOL_MAX_PAYLOAD / 4U];
	float fp[PROTOCOL_MAX_PAYLOAD / 4U];
} output;
static union {
	int16_t s16[LC3_HR_MAX_FRAME_SAMPLES];
	int32_t s24[LC3_HR_MAX_FRAME_SAMPLES];
	uint8_t packed[LC3_HR_MAX_FRAME_SAMPLES * 3U];
	float fp[LC3_HR_MAX_FRAME_SAMPLES];
} pcm_input;
static size_t header_pos;
static size_t payload_pos;
static uint32_t payload_length;
static uint32_t discard;

static void *input_pcm(enum lc3_pcm_format format)
{
	switch (format) {
	case LC3_PCM_FORMAT_S16:
		return pcm_input.s16;
	case LC3_PCM_FORMAT_S24:
		return pcm_input.s24;
	case LC3_PCM_FORMAT_S24_3LE:
		return pcm_input.packed;
	case LC3_PCM_FORMAT_FLOAT:
		return pcm_input.fp;
	default:
		return NULL;
	}
}

static void setup_config(struct codec_config *config, size_t flags_offset)
{
	*config = (struct codec_config){
		.dt_us = (int32_t)sys_get_le32(payload),
		.sr_hz = (int32_t)sys_get_le32(payload + 4U),
		.sr_pcm_hz = (int32_t)sys_get_le32(payload + 8U),
		.hrmode = payload_length > flags_offset && payload[flags_offset] != 0U,
		.format = payload_length > flags_offset + 1U ?
			  (enum lc3_pcm_format)payload[flags_offset + 1U] : LC3_PCM_FORMAT_S16,
	};
}

static int encode_frames(bool batch)
{
	const struct codec_status *status = codec_encoder_status();
	uint32_t count = 1U;
	size_t offset = 0U;
	size_t pcm_size;
	void *pcm;
	int ret;

	if (!status->configured) {
		return -EPERM;
	}
	if (batch) {
		if (payload_length < 4U) {
			return -EINVAL;
		}
		count = sys_get_le32(payload);
		offset = 4U;
	}
	if (count == 0U || count > 100U) {
		return -EINVAL;
	}
	pcm_size = codec_pcm_size(status);
	if (payload_length - offset != count * pcm_size) {
		return -EINVAL;
	}
	if (count * (size_t)status->frame_bytes > sizeof(output.bytes)) {
		return -ENOSPC;
	}
	pcm = input_pcm(status->config.format);
	for (uint32_t index = 0U; index < count; index++) {
		memcpy(pcm, payload + offset + index * pcm_size, pcm_size);
		ret = codec_encode(pcm, pcm_size, output.bytes + index * status->frame_bytes,
				   status->frame_bytes);
		if (ret != 0) {
			return ret;
		}
	}
	return (int)(count * status->frame_bytes);
}

static int decode_frames(uint8_t command)
{
	const struct codec_status *status = codec_decoder_status();
	uint32_t count = 1U;
	size_t offset = 0U;
	size_t frame_size = payload_length;
	size_t pcm_size;
	int ret;

	if (!status->configured) {
		return -EPERM;
	}
	if (command == CMD_DEC_FRAMES) {
		if (payload_length < 4U) {
			return -EINVAL;
		}
		count = sys_get_le32(payload);
		offset = 4U;
	} else if (command == CMD_DEC_PLC) {
		if (payload_length != 0U && payload_length != 4U) {
			return -EINVAL;
		}
		count = payload_length == 4U ? sys_get_le32(payload) : 1U;
	}
	if (count == 0U || count > 100U) {
		return -EINVAL;
	}
	if (command != CMD_DEC_PLC) {
		if ((payload_length - offset) % count != 0U) {
			return -EINVAL;
		}
		frame_size = (payload_length - offset) / count;
		if (frame_size == 0U || frame_size > LC3_HR_MAX_FRAME_BYTES) {
			return -EINVAL;
		}
	}
	pcm_size = codec_pcm_size(status);
	if (count * pcm_size > sizeof(output.bytes)) {
		return -ENOSPC;
	}
	for (uint32_t index = 0U; index < count; index++) {
		const void *frame = command == CMD_DEC_PLC ? NULL :
				    payload + offset + index * frame_size;

		ret = codec_decode(frame, frame != NULL ? frame_size : 0U,
				   output.bytes + index * pcm_size, pcm_size);
		if (ret < 0) {
			return ret;
		}
	}
	return (int)(count * pcm_size);
}

static int query(void)
{
	bool hrmode;
	int32_t dt_us;
	int32_t rate;
	int32_t bitrate;
	int32_t channels;
	int32_t nbytes;
	int32_t values[7];

	if (payload_length != 25U) {
		return -EINVAL;
	}
	hrmode = payload[0] != 0U;
	dt_us = (int32_t)sys_get_le32(payload + 1U);
	rate = (int32_t)sys_get_le32(payload + 5U);
	bitrate = (int32_t)sys_get_le32(payload + 13U);
	channels = (int32_t)sys_get_le32(payload + 17U);
	nbytes = (int32_t)sys_get_le32(payload + 21U);
#if !defined(CONFIG_LIBLC3_PLUS_HR)
	if (hrmode) {
		return -ENOTSUP;
	}
#endif
#if !defined(CONFIG_LIBLC3_PLUS)
	if (dt_us == 2500 || dt_us == 5000) {
		return -ENOTSUP;
	}
#endif
	if (channels < 0 || channels > 8) {
		return -EINVAL;
	}
	values[0] = lc3_hr_frame_samples(hrmode, dt_us, rate);
	values[1] = lc3_hr_frame_bytes(hrmode, dt_us, rate, bitrate);
	values[2] = lc3_hr_frame_block_bytes(hrmode, dt_us, rate, channels, bitrate);
	values[3] = lc3_hr_resolve_bitrate(hrmode, dt_us, rate, nbytes);
	values[4] = lc3_hr_delay_samples(hrmode, dt_us, rate);
	values[5] = lc3_hr_encoder_size(hrmode, dt_us, rate);
	values[6] = lc3_hr_decoder_size(hrmode, dt_us, rate);
	for (size_t index = 0U; index < 7U; index++) {
		sys_put_le32((uint32_t)values[index], output.bytes + index * 4U);
	}
	return sizeof(values);
}

static int dispatch(void)
{
	struct codec_config config;
	const struct codec_status *enc = codec_encoder_status();
	const struct codec_status *dec = codec_decoder_status();
	int ret;

	switch (header[0]) {
	case CMD_ENC_SETUP:
		if (payload_length < 16U || payload_length > 19U) {
			return -EINVAL;
		}
		setup_config(&config, 16U);
		ret = codec_encoder_setup(&config, (int32_t)sys_get_le32(payload + 12U),
					  payload_length == 19U && payload[18] != 0U);
		if (ret != 0) {
			return ret;
		}
		sys_put_le32(enc->frame_samples, output.bytes);
		sys_put_le32(enc->frame_bytes, output.bytes + 4U);
		return 8;
	case CMD_DEC_SETUP:
		if (payload_length < 12U || payload_length > 14U) {
			return -EINVAL;
		}
		setup_config(&config, 12U);
		ret = codec_decoder_setup(&config);
		if (ret != 0) {
			return ret;
		}
		sys_put_le32(dec->frame_samples, output.bytes);
		return 4;
	case CMD_ENC_FRAME:
	case CMD_ENC_FRAMES:
		return encode_frames(header[0] == CMD_ENC_FRAMES);
	case CMD_DEC_FRAME:
	case CMD_DEC_FRAMES:
	case CMD_DEC_PLC:
		return decode_frames(header[0]);
	case CMD_QUERY:
		return query();
	case CMD_INFO:
		if (payload_length != 0U) {
			return -EINVAL;
		}
		return snprintf((char *)output.bytes, sizeof(output.bytes),
			"Zephyr liblc3; LC3plus=%d HR=%d LTPF-disable=unsupported\r\n"
			"=== LC3 Encoder ===\r\n"
			"  configured=%d hrmode=%d dt_us=%d sr_hz=%d sr_pcm_hz=%d\r\n"
			"  bitrate=%d frame_samples=%d frame_bytes=%d\r\n"
			"  frames_enc=%u errors=%u\r\n"
			"=== LC3 Decoder ===\r\n"
			"  configured=%d hrmode=%d dt_us=%d sr_hz=%d sr_pcm_hz=%d\r\n"
			"  frame_samples=%d frames_dec=%u plc=%u errors=%u\r\n",
#if defined(CONFIG_LIBLC3_PLUS)
			1,
#else
			0,
#endif
#if defined(CONFIG_LIBLC3_PLUS_HR)
			1,
#else
			0,
#endif
			enc->configured, enc->config.hrmode, enc->config.dt_us,
			enc->config.sr_hz, enc->config.sr_pcm_hz, enc->bitrate,
			enc->frame_samples, enc->frame_bytes, enc->frames, enc->errors,
			dec->configured, dec->config.hrmode, dec->config.dt_us,
			dec->config.sr_hz, dec->config.sr_pcm_hz,
			dec->frame_samples, dec->frames, dec->plc, dec->errors);
	case CMD_RESET:
		if (payload_length != 0U) {
			return -EINVAL;
		}
		codec_reset();
		return 0;
	default:
		return -EINVAL;
	}
}

static int send_error(protocol_send_fn send, int error)
{
	uint8_t message[80];
	int length;

	sys_put_le32((uint32_t)error, message);
	length = snprintf((char *)message + 4U, sizeof(message) - 4U,
			  "command 0x%02x: %s", header[0],
			  error == -ENOTSUP ? "mode not supported" : "invalid request or codec error");
	return send(PROTOCOL_ERROR, message, 4U + (size_t)length);
}

void protocol_reset(void)
{
	header_pos = 0U;
	payload_pos = 0U;
	payload_length = 0U;
	discard = 0U;
}

int protocol_feed(const uint8_t *data, size_t length, protocol_send_fn send)
{
	while (length > 0U) {
		size_t part;
		int ret;

		if (discard != 0U) {
			part = length < discard ? length : discard;
			discard -= part;
		} else if (header_pos < sizeof(header)) {
			part = sizeof(header) - header_pos;
			part = part < length ? part : length;
			memcpy(header + header_pos, data, part);
			header_pos += part;
			if (header_pos == sizeof(header)) {
				payload_length = sys_get_le32(header + 1U);
				if (payload_length > sizeof(payload)) {
					discard = payload_length;
					ret = send_error(send, -ENOSPC);
					header_pos = 0U;
					if (ret != 0) {
						return ret;
					}
				}
			}
		} else {
			part = payload_length - payload_pos;
			part = part < length ? part : length;
			memcpy(payload + payload_pos, data, part);
			payload_pos += part;
		}
		data += part;
		length -= part;
		if (header_pos == sizeof(header) && payload_pos == payload_length) {
			ret = dispatch();
			ret = ret < 0 ? send_error(send, ret) :
					send(header[0] | 0x80U, output.bytes, (size_t)ret);
			protocol_reset();
			if (ret != 0) {
				return ret;
			}
		}
	}
	return 0;
}
```

## src/protocol.h
```c
/*
 * SPDX-FileCopyrightText: Copyright 2026 NXP
 * SPDX-License-Identifier: Apache-2.0
 */

#ifndef LC3_TEST_PROTOCOL_H_
#define LC3_TEST_PROTOCOL_H_

#include <stddef.h>
#include <stdint.h>

#define PROTOCOL_HEADER_SIZE 5U
#define PROTOCOL_MAX_PAYLOAD 49152U
#define PROTOCOL_ERROR 0xffU

enum protocol_command {
	CMD_ENC_SETUP = 0x01,
	CMD_ENC_FRAME = 0x02,
	CMD_ENC_FRAMES = 0x03,
	CMD_DEC_SETUP = 0x10,
	CMD_DEC_FRAME = 0x11,
	CMD_DEC_FRAMES = 0x12,
	CMD_DEC_PLC = 0x13,
	CMD_INFO = 0x20,
	CMD_RESET = 0x21,
	CMD_QUERY = 0x22,
};

typedef int (*protocol_send_fn)(uint8_t type, const void *payload, size_t length);

void protocol_reset(void);
int protocol_feed(const uint8_t *data, size_t length, protocol_send_fn send);

#endif
```
