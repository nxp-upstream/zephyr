## CMakeLists.txt
```
# SPDX-License-Identifier: Apache-2.0

cmake_minimum_required(VERSION 3.20.0)

find_package(Zephyr REQUIRED HINTS $ENV{ZEPHYR_BASE})
project(openthread_border_router)

FILE(GLOB app_sources src/main.c)

target_sources_ifdef(CONFIG_HDLC_RCP_IF_SPI_NO_AUTO_START app PRIVATE
    boards/mimxrt1060_evk_mimxrt1062_qspi_C/src/iw61x_init.c
)
target_include_directories_ifdef(CONFIG_HDLC_RCP_IF_SPI_NO_AUTO_START app PRIVATE
    boards/mimxrt1060_evk_mimxrt1062_qspi_C/src
)

# add Web Server source files
if(CONFIG_OTBR_WEB_SERVER)
  set(gen_dir ${ZEPHYR_BINARY_DIR}/include/generated/)

  if(${CONFIG_OPENTHREAD_NET_DIAG_VENDOR_NAME} STREQUAL "NXP")
    set(VENDOR_LOGO "nxp_logo.png")
  else()
    set(VENDOR_LOGO "zephyr_logo.png")
  endif()

  file(READ ${CMAKE_CURRENT_SOURCE_DIR}/src/web_server/static_web_resources/index.html INDEX_HTML_CONTENT)
  string(REPLACE "@BOARD_NAME@" "${CONFIG_OPENTHREAD_NET_DIAG_VENDOR_MODEL}" INDEX_HTML_CONTENT "${INDEX_HTML_CONTENT}")
  file(WRITE ${CMAKE_CURRENT_BINARY_DIR}/index.html "${INDEX_HTML_CONTENT}")

  generate_inc_file_for_target(app
    ${CMAKE_CURRENT_BINARY_DIR}/index.html
    ${gen_dir}/index.html.gz.inc
    --gzip
  )
  generate_inc_file_for_target(app
    src/web_server/static_web_resources/images/${VENDOR_LOGO}
    ${gen_dir}/images/vendor_logo.png.gz.inc
    --gzip
  )

  foreach(web_resource
    style.css
    app.js
    images/zephyr_logo.png
  )
  generate_inc_file_for_target(app
  src/web_server/static_web_resources/${web_resource}
  ${gen_dir}/${web_resource}.gz.inc
  --gzip
  )
  endforeach()

  message(STATUS "Adding Web Server and Rest APIs source files")
  list(APPEND app_sources src/web_server/web_server.c)
  list(APPEND app_sources src/web_server/rest_api.c)

  message(STATUS "Adding HTTP resource linker sections")
  zephyr_linker_sources(SECTIONS src/web_server/sections-rom.ld)
endif()

target_sources(app PRIVATE ${app_sources})
```

## prj.conf
```kconfig
CONFIG_EARLY_CONSOLE=y
# Generic networking options
CONFIG_NETWORKING=y
CONFIG_NET_UDP=y
CONFIG_NET_TCP=y
CONFIG_NET_IPV6=y
CONFIG_NET_IPV4=y
CONFIG_NET_IPV4_MAPPING_TO_IPV6=y
CONFIG_NET_SOCKETS=y
CONFIG_NET_DHCPV4=y
CONFIG_NET_MGMT_EVENT=y
CONFIG_NET_MGMT_EVENT_INFO=y
CONFIG_NET_MGMT_EVENT_STACK_SIZE=2048
CONFIG_NET_CONNECTION_MANAGER=y
CONFIG_NET_ROUTE_MCAST=y
CONFIG_NET_SOCKETS_SERVICE=y
CONFIG_NET_CONTEXT_RECV_PKTINFO=y
CONFIG_NET_CONTEXT_RECV_HOPLIMIT=y
CONFIG_ZVFS_POLL_MAX=16
CONFIG_NET_SOCKETS_SERVICE_STACK_SIZE=12288
CONFIG_NET_MAX_CONN=16
CONFIG_NET_CONNECTION_MANAGER_MONITOR_STACK_SIZE=2048
# Number of socket descriptors might need adjusting
# if there are more than 1 handlers defined.
CONFIG_ZVFS_OPEN_ADD_SIZE_NET_SAMPLE=16

# printing of scan results puts pressure on queues in new locking
# design in net_mgmt. So, use a higher timeout for a crowded
# environment.
CONFIG_NET_MGMT_EVENT_QUEUE_TIMEOUT=5000
CONFIG_NET_MGMT_EVENT_QUEUE_SIZE=16

# Generic OT options
CONFIG_NET_L2_OPENTHREAD=y
CONFIG_OPENTHREAD_SHELL=y
CONFIG_OPENTHREAD_THREAD_VERSION_1_4=y
CONFIG_OPENTHREAD_ZEPHYR_BORDER_ROUTER=y
CONFIG_OPENTHREAD_ZEPHYR_BORDER_ROUTER_NAT64_TRANSLATOR=y

# Net multicast routing
CONFIG_NET_MAX_MCAST_ROUTES=10
CONFIG_NET_MCAST_ROUTE_MLD_REPORTS=y
CONFIG_NET_IPV6_NBR_CACHE=y

# Kernel options
CONFIG_MAIN_STACK_SIZE=5120
CONFIG_SHELL_STACK_SIZE=4096
CONFIG_OPENTHREAD_THREAD_STACK_SIZE=8192
CONFIG_LOG_PROCESS_THREAD_STACK_SIZE=4096

CONFIG_NET_TX_STACK_SIZE=4096
CONFIG_NET_RX_STACK_SIZE=4096
CONFIG_NET_MGMT_EVENT_STACK_SIZE=8192
CONFIG_ENTROPY_GENERATOR=y
CONFIG_TEST_RANDOM_GENERATOR=y
CONFIG_INIT_STACKS=y

# Logging
CONFIG_NET_LOG=y
CONFIG_LOG=y
CONFIG_LOG_PROCESS_THREAD=y
CONFIG_NET_STATISTICS=y
CONFIG_PRINTK=y

# Network buffers
CONFIG_NET_PKT_RX_COUNT=16
CONFIG_NET_PKT_TX_COUNT=16
CONFIG_NET_BUF_RX_COUNT=64
CONFIG_NET_BUF_TX_COUNT=64
CONFIG_NET_MAX_CONTEXTS=15
CONFIG_NET_CONTEXT_NET_PKT_POOL=y

# IP address options
CONFIG_NET_IF_UNICAST_IPV6_ADDR_COUNT=6
CONFIG_NET_IF_MCAST_IPV6_ADDR_COUNT=6
CONFIG_NET_IF_MAX_IPV4_COUNT=2
CONFIG_NET_IF_MAX_IPV6_COUNT=6

# DNS resolver required by DNS upstream resolver
CONFIG_DNS_RESOLVER=y
CONFIG_DNS_RESOLVER_PACKET_FORWARDING=y
CONFIG_DNS_RESOLVER_MAX_SERVERS=5
CONFIG_DNS_NUM_CONCUR_QUERIES=8
CONFIG_DNS_RESOLVER_MAX_NAME_LEN=128

CONFIG_SYSTEM_WORKQUEUE_STACK_SIZE=4096
CONFIG_STACK_SENTINEL=y

# OT Border Router flags
CONFIG_OPENTHREAD_BACKBONE_ROUTER_MULTICAST_ROUTING=y
CONFIG_OPENTHREAD_SLAAC=y
CONFIG_OPENTHREAD_ENABLE_SERVICE=y
CONFIG_OPENTHREAD_BORDER_ROUTER=y
CONFIG_OPENTHREAD_BORDER_ROUTING=y
CONFIG_OPENTHREAD_BORDER_ROUTING_COUNTERS=y
CONFIG_OPENTHREAD_BORDER_AGENT=y
CONFIG_OPENTHREAD_BORDER_AGENT_ID=y
CONFIG_OPENTHREAD_NETDATA_PUBLISHER=y
CONFIG_OPENTHREAD_BACKBONE_ROUTER=y
CONFIG_OPENTHREAD_DNSSD_SERVER=y
CONFIG_OPENTHREAD_EXTERNAL_HEAP=y
CONFIG_OPENTHREAD_JOINER=y
CONFIG_OPENTHREAD_COMMISSIONER=y
CONFIG_OPENTHREAD_PLATFORM_UDP=y
CONFIG_OPENTHREAD_MULTICAST_DNS=y
CONFIG_OPENTHREAD_MAX_STATECHANGE_HANDLERS=3
CONFIG_OPENTHREAD_INTERFACE_EARLY_UP=y
CONFIG_OPENTHREAD_ECDSA=y
CONFIG_OPENTHREAD_IP6_FRAGM=y
CONFIG_OPENTHREAD_COAP=y
CONFIG_OPENTHREAD_SETTINGS_RAM=y
CONFIG_OPENTHREAD_BORDER_AGENT_EPHEMERAL_KEY_ENABLE=y
CONFIG_OPENTHREAD_VERHOEFF_CHECKSUM=y
CONFIG_OPENTHREAD_BORDER_AGENT_MESHCOP_SERVICE=y
CONFIG_OPENTHREAD_TREL=y
CONFIG_OPENTHREAD_TREL_MANAGE_DNSSD=y
CONFIG_OPENTHREAD_BORDER_ROUTING_DHCP6_PD=y
CONFIG_OPENTHREAD_BORDER_ROUTING_DHCP6_PD_CLIENT=y
CONFIG_OPENTHREAD_DHCP6_CLIENT=y
CONFIG_OPENTHREAD_DHCP6_SERVER=y
CONFIG_OPENTHREAD_DNS_UPSTREAM_QUERY=y
CONFIG_OPENTHREAD_SRP_CLIENT=y
CONFIG_OPENTHREAD_SRP_SERVER=y
CONFIG_OPENTHREAD_SRP_ADV_PROXY=y
CONFIG_OPENTHREAD_DNSSD_DISCOVERY_PROXY=y
CONFIG_OPENTHREAD_PING_SENDER=y
CONFIG_OPENTHREAD_REFERENCE_DEVICE=y
CONFIG_OPENTHREAD_LINK_METRICS_INITIATOR=y
CONFIG_OPENTHREAD_DUA=y
CONFIG_OPENTHREAD_MLR=y
CONFIG_OPENTHREAD_DNS_CLIENT=y
CONFIG_OPENTHREAD_DNS_CLIENT_OVER_TCP=y
CONFIG_OPENTHREAD_TCP_ENABLE=y
CONFIG_OPENTHREAD_NETDIAG_VENDOR_INFO=y
CONFIG_OPENTHREAD_LINK_METRICS_SUBJECT=y
CONFIG_OPENTHREAD_LINK_METRICS_MANAGER=y
CONFIG_OPENTHREAD_LINK_METRICS_INITIATOR=y
CONFIG_OPENTHREAD_MAC_FILTER=y
CONFIG_NET_SOCKETS_INET_RAW=y

CONFIG_STACK_SENTINEL=y
```

## overlay-webserver.conf
```kconfig
#
# Copyright 2026, NXP
#
CONFIG_OPENTHREAD_ZEPHYR_BORDER_ROUTER_WEB_SERVER=y

# Optional: Increase buffer sizes for JSON payloads
CONFIG_HTTP_SERVER_CLIENT_BUFFER_SIZE=1024
CONFIG_HTTP_SERVER_MAX_CONTENT_TYPE_LENGTH=128

#CONFIG_HEAP_MEM_POOL_SIZE=81920
CONFIG_ZVFS_EVENTFD_MAX=10

CONFIG_HTTP_SERVER_STACK_SIZE=8192

CONFIG_OPENTHREAD_DEBUG=y
CONFIG_OPENTHREAD_LOG_LEVEL_INFO=y
CONFIG_OPENTHREAD_L2_DEBUG=y
CONFIG_OPENTHREAD_L2_LOG_LEVEL_INF=y


# all the following is to advertise http MDNS 
CONFIG_ZVFS_POLL_MAX=64
# Network socket service
CONFIG_NET_SOCKETS_SERVICE=y
CONFIG_NET_SOCKETS_SERVICE_STACK_SIZE=2048

# mDNS/DNS-SD support
CONFIG_MDNS_RESPONDER=y
CONFIG_DNS_SD=y
CONFIG_MDNS_RESPONDER_DNS_SD=y
CONFIG_NET_HOSTNAME_ENABLE=y
CONFIG_NET_HOSTNAME="zephyr-nxp-rw612-otbr"

# more connections than 16 in prj.conf
CONFIG_NET_MAX_CONTEXTS=32

# Increase network buffers
CONFIG_NET_PKT_RX_COUNT=32
CONFIG_NET_PKT_TX_COUNT=32
CONFIG_NET_BUF_RX_COUNT=128
CONFIG_NET_BUF_TX_COUNT=128

# Increase simultanate TCP connections
CONFIG_NET_MAX_CONN=32

# Increase IPv6 address number
CONFIG_NET_IF_UNICAST_IPV6_ADDR_COUNT=8
CONFIG_NET_IF_MCAST_IPV6_ADDR_COUNT=8

# Increase buffers size for NAT64
CONFIG_NET_BUF_DATA_SIZE=256

# Increase heap size for more connections
CONFIG_HEAP_MEM_POOL_SIZE=131072
```

## src/main.c
```c
/*
 * Copyright 2025-2026 NXP
 *
 * SPDX-License-Identifier: Apache-2.0
 */

#if defined(CONFIG_OTBR_WEB_SERVER) || defined(CONFIG_HDLC_RCP_IF_SPI_NO_AUTO_START)
#include <zephyr/logging/log.h>
LOG_MODULE_REGISTER(border_router_main, CONFIG_OTBR_LOG_LEVEL);
#endif

#ifdef CONFIG_HDLC_RCP_IF_SPI_NO_AUTO_START
#include <zephyr/kernel.h>
#include <zephyr/net/net_if.h>
#include <zephyr/net/net_l2.h>
#include <zephyr/net/openthread.h>
#include <zephyr/logging/log.h>
#include <zephyr/net/ieee802154_radio.h>
#include <zephyr/net/hdlc_rcp_if/hdlc_rcp_if.h>
#include "iw61x_init.h"
#endif

#ifdef CONFIG_OTBR_WEB_SERVER
#include "web_server/web_server.h"
#endif

int main(void)
{
#ifdef CONFIG_HDLC_RCP_IF_SPI_NO_AUTO_START
	LOG_INF("=== OpenThread Border Router Starting ===");
	int err;

	/* Wait for IW61X bringup */
	err = iw61x_wait_ready(K_SECONDS(20));
	if (err) {
		LOG_ERR("IW612X bringup failed: %d", err);
		return err;
	}

	/* Get OpenThread network interface */
	struct net_if *ot_iface = net_if_get_first_by_type(
					&NET_L2_GET_NAME(OPENTHREAD));
	if (!ot_iface) {
		LOG_ERR("OpenThread interface not found");
		return -ENODEV;
	}

	/* Start HDLC RCP */
	const struct hdlc_api *api = net_if_get_device(ot_iface)->api;

	if (api && api->start) {
		api->start();
		LOG_INF("15.4 RCP SPI interface started");
	}

	/* Initialize IEEE 802.15.4 / OpenThread */
	ieee802154_init(ot_iface);
	LOG_INF("ieee802154_init done");

	/* Bring up OpenThread interface */
	net_if_up(ot_iface);
	LOG_INF("OpenThread interface up");

#endif /* CONFIG_HDLC_RCP_IF_SPI_NO_AUTO_START */

#ifdef CONFIG_OTBR_WEB_SERVER
	/* Setup web server */
	LOG_INF("Zephyr OTBR Web Server setup ...");
	web_server_setup();
#endif

	/* Nothing to do here. The Border Router is automatically started in the background. */

	return 0;
}
```
