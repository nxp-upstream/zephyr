## prj.conf
```kconfig
# Network configuration
CONFIG_NETWORKING=y
CONFIG_NET_TCP=y
CONFIG_NET_IPV4=y
CONFIG_NET_IPV6=n

# HTTP Server
CONFIG_HTTP_SERVER=y
CONFIG_HTTP_SERVER_MAX_CLIENTS=2
CONFIG_HTTP_SERVER_MAX_STREAMS=2

# JSON Library
CONFIG_JSON_LIBRARY=y

# Logging
CONFIG_LOG=y
```

## boards/qemu_x86.conf
```kconfig
# QEMU x86 specific configuration
CONFIG_NET_QEMU_ETHERNET=y
CONFIG_NET_CONFIG_SETTINGS=y
CONFIG_NET_CONFIG_NEED_IPV4=y
```

## src/main.c
```c
/*
 * Copyright 2025 NXP
 *
 * SPDX-License-Identifier: Apache-2.0
 */

#include <zephyr/kernel.h>
#include <zephyr/logging/log.h>
#include <zephyr/mcp_server/mcp_server.h>

LOG_MODULE_REGISTER(mcp_sample_hello, LOG_LEVEL_INF);

int main(void)
{
	return 0;
}
```
