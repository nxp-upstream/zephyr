## CMakeLists.txt
```
cmake_minimum_required(VERSION 3.20.0)
find_package(Zephyr REQUIRED HINTS $ENV{ZEPHYR_BASE})
project(nxp_power_mgmt_mode_switch)

target_sources(app PRIVATE src/main.c)
```

## prj.conf
```kconfig
CONFIG_PM=y
CONFIG_PM_DEVICE=y
CONFIG_PM_DEVICE_RUNTIME=y
CONFIG_POWER_DOMAIN=y
```

## src/main.c
```c
#include <zephyr/kernel.h>
#include <zephyr/device.h>
#include <zephyr/pm/device.h>
#include <zephyr/sys/printk.h>


const struct device *core_main_pd = DEVICE_DT_GET(DT_NODELABEL(pd_core_main));
const struct device *core_wake_pd = DEVICE_DT_GET(DT_NODELABEL(pd_core_wake));

int main(void)
{
    printk("Power management mode switch sample application started.\n");

    printk("Will enter Deep Sleep1 Mode\r\n");
    pm_device_action_run(core_main_pd, PM_DEVICE_ACTION_SUSPEND);
    pm_device_action_run(core_wake_pd, PM_DEVICE_ACTION_RESUME);
    k_sleep(K_SECONDS(2));
    printk("Wakeup from Deep Sleep1 Mode\r\n");

    // printk("Will enter Deep Sleep2 Mode\r\n");
    // pm_device_action_run(core_main_pd, PM_DEVICE_ACTION_SUSPEND);
    // pm_device_action_run(core_wake_pd, PM_DEVICE_ACTION_SUSPEND);
    // k_sleep(K_SECONDS(2));
    // printk("Wakeup from Deep Sleep2 Mode\r\n");

    // printk("Will enter Power Down 1 Mode\r\n");
    // pm_device_action_run(core_main_pd, PM_DEVICE_ACTION_TURN_OFF);
    // pm_device_action_run(core_wake_pd, PM_DEVICE_ACTION_SUSPEND);
    // k_sleep(K_SECONDS(2));
    // printk("Wakeup from Power Down 1 Mode\r\n");

    // printk("Will enter Power Down 2 Mode\r\n");
    // pm_device_action_run(core_main_pd, PM_DEVICE_ACTION_TURN_OFF);
    // pm_device_action_run(core_wake_pd, PM_DEVICE_ACTION_TURN_OFF);
    // k_sleep(K_SECONDS(2));
    // printk("Wakeup from Power Down 2 Mode\r\n");

    return 0;
}
```
