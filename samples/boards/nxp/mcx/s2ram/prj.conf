## Kconfig
```
# SPDX-FileCopyrightText: Copyright 2026 NXP
# SPDX-License-Identifier: Apache-2.0

mainmenu "NXP MCX suspend-to-RAM sample"

choice
	prompt "Suspend-to-RAM wakeup source"
	default S2RAM_WAKEUP_TIMER
	help
	  Select how the SoC is woken from suspend-to-RAM (Deep Power Down).

config S2RAM_WAKEUP_TIMER
	bool "Timed wakeup"
	help
	  Wake after a fixed delay using a low-power timer.

config S2RAM_WAKEUP_BUTTON
	bool "Button wakeup"
	help
	  Wake on a user button press.

endchoice

source "Kconfig.zephyr"
```

## sample.yaml
```
# SPDX-FileCopyrightText: Copyright 2026 NXP
# SPDX-License-Identifier: Apache-2.0

sample:
  name: Suspend-to-RAM for NXP MCX

common:
  tags:
    - power
    - pm
  platform_allow:
    - frdm_mcxn947/mcxn947/cpu0
    - mcx_n5xx_evk/mcxn547/cpu0
    - mcx_n9xx_evk/mcxn947/cpu0
    - frdm_mcxn236
    - frdm_mcxa153
    - frdm_mcxa156
    - frdm_mcxa344
    - frdm_mcxa266
    - frdm_mcxa346
    - frdm_mcxa366
    - frdm_mcxa577
  integration_platforms:
    - frdm_mcxn947/mcxn947/cpu0
    - frdm_mcxa156
  harness: console
  harness_config:
    type: one_line
    regex:
      - "suspend-to-RAM demo"

tests:
  sample.boards.nxp.mcx.s2ram.timer:
    timeout: 120
    harness_config:
      type: one_line
      regex:
        - "Completed 10 suspend-to-RAM cycles"
    extra_configs:
      - CONFIG_SAMPLE_S2RAM_WAKEUP_TIMER=y
  sample.boards.nxp.mcx.s2ram.button:
    extra_configs:
      - CONFIG_SAMPLE_S2RAM_WAKEUP_BUTTON=y
```

## prj.conf
```kconfig
# SPDX-FileCopyrightText: Copyright 2026 NXP
# SPDX-License-Identifier: Apache-2.0

CONFIG_PM=y
CONFIG_WUC=y
CONFIG_COUNTER=y
CONFIG_COUNTER_MCUX_LPTMR_ALARM=y
CONFIG_CONSOLE_SUBSYS=y
CONFIG_CONSOLE_GETCHAR=y
```

## boards/frdm_mcxa153.overlay
```dts
/*
 * SPDX-FileCopyrightText: Copyright 2026 NXP
 *
 * SPDX-License-Identifier: Apache-2.0
 */

&ostimer0 {
	status = "disabled";
};

&systick {
	status = "okay";
};
```

## boards/frdm_mcxn236.overlay
```dts
/*
 * SPDX-FileCopyrightText: Copyright 2026 NXP
 *
 * SPDX-License-Identifier: Apache-2.0
 */

/* Constrain zephyr,sram to RAMA1-RAMA3 (24 KB at 0x20002000) so the whole
 * retained working set is both kept across Deep Power Down and kept clear of
 * the boot ROM scratch.
 */
&sram0 {
	reg = <0x20002000 0x6000>;
};
```

## src/main.c
```c
/*
 * SPDX-FileCopyrightText: Copyright 2026 NXP
 *
 * SPDX-License-Identifier: Apache-2.0
 */

#include <zephyr/kernel.h>
#include <zephyr/device.h>
#include <zephyr/pm/pm.h>
#include <zephyr/pm/policy.h>
#include <zephyr/console/console.h>
#if defined(CONFIG_S2RAM_WAKEUP_BUTTON)
#include <zephyr/drivers/wuc.h>
#endif

#define WAKEUP_DELAY_S 3U

#define APP_STACK_SIZE 2048
#define APP_PRIORITY   5

/* Incremented before every suspend. Its value surviving the suspend/resume
 * cycle proves the RAM was retained while the CORE domain was powered down.
 */
static uint32_t cycles;

#define CONSOLE_NODE   DT_CHOSEN(zephyr_console)
#define CONSOLE_PARENT DT_PARENT(CONSOLE_NODE)

static const struct device *const console_dev = DEVICE_DT_GET(CONSOLE_NODE);
#if DT_NODE_HAS_COMPAT(CONSOLE_PARENT, nxp_lp_flexcomm)
#define HAS_FLEXCOMM_PARENT 1
static const struct device *const flexcomm_dev = DEVICE_DT_GET(CONSOLE_PARENT);
#endif

/*
 * Deep Power Down resets every CORE-domain peripheral. On a transparent resume
 * the SoC restores the CPU context and clocks, but the console UART driver has
 * no device pm hooks, so re-initialise it before printing. Three clock gates
 * that Deep Power Down switched off have to be re-opened, bottom up, before the
 * console can drive its pins again:
 *
 *   1. the PORT pin-mux controllers - their gate must be on for the LPUART
 *      pinctrl re-apply (step 3) to actually reach the pad-mux registers,
 *   2. the parent LP_FLEXCOMM - its init re-enables the peripheral clock gate
 *      and re-selects LPUART mode, then
 *   3. the LPUART itself - its init re-applies pinctrl and the baud/format.
 *
 * device_init() is a no-op on an already-initialised device, so clear the
 * initialised flag to force each driver to re-run its init against the reset
 * hardware. (A production driver would do this through a PM_DEVICE_ACTION_RESUME
 * handler instead.)
 */
#define REINIT_DEVICE(dev)				\
	do {						\
		(dev)->state->initialized = false;	\
		(void)device_init(dev);			\
	} while (0)

#define REINIT_PORT(node_id) REINIT_DEVICE(DEVICE_DT_GET(node_id));

static void resume_console(void)
{
	/* Re-open every PORT pin-mux clock gate that Deep Power Down closed. */
	DT_FOREACH_STATUS_OKAY(nxp_port_pinmux, REINIT_PORT)

#ifdef HAS_FLEXCOMM_PARENT
	REINIT_DEVICE(flexcomm_dev);
#endif
	REINIT_DEVICE(console_dev);

	(void)console_init();
}

#if defined(CONFIG_S2RAM_WAKEUP_BUTTON)
/* In real-world applications, the button's wake-up event should be handled
 * via the driver hook, allowing the application to directly wait for input
 * events without needing to consider the existence of WUU. However, due to
 * the current lack of hook handling, we use the PM notifier to handle the
 * wake-up event.
 */
static K_SEM_DEFINE(button_wakeup, 0, 1);
static const struct wuc_dt_spec button = WUC_DT_SPEC_GET(DT_ALIAS(wakeup_button));

static void on_pm_state_exit(enum pm_state state)
{
	if (state == PM_STATE_SUSPEND_TO_RAM) {
		k_sem_give(&button_wakeup);
	}
}

static struct pm_notifier button_pm_notifier = {
	.state_exit = on_pm_state_exit,
};
#endif /* CONFIG_S2RAM_WAKEUP_BUTTON */

static void app_thread(void *p1, void *p2, void *p3)
{
	ARG_UNUSED(p1);
	ARG_UNUSED(p2);
	ARG_UNUSED(p3);

	while (true) {
		cycles++;

		/* Wait for a console key press before suspending. Until a key
		 * arrives the SoC stays awake and debuggable, so a freshly
		 * programmed board never bricks its debug port by entering Deep
		 * Power Down on its own before it can be re-flashed.
		 */
		printk("Press any key to enter suspend-to-RAM (cycle %u)\n", cycles);
		(void)console_getchar();

#if defined(CONFIG_S2RAM_WAKEUP_BUTTON)
		printk("Entering suspend-to-RAM; press SW2 to wake\n");
#else
		printk("Entering suspend-to-RAM; wake in %u s\n", WAKEUP_DELAY_S);
#endif

		/* Let the UART finish shifting out the line above before DPD cuts its clock. */
		k_busy_wait(2000);

		pm_state_force(0U, &(struct pm_state_info){PM_STATE_SUSPEND_TO_RAM, 0, 0});
#if defined(CONFIG_S2RAM_WAKEUP_BUTTON)
		/* Block until SW2 wakes the SoC; the PM notifier gives this. */
		k_sem_take(&button_wakeup, K_FOREVER);
#else
		k_sleep(K_SECONDS(WAKEUP_DELAY_S));
#endif

		resume_console();
		printk("Resumed from suspend-to-RAM; retained counter is %u\n", cycles);
	}
}

K_THREAD_STACK_DEFINE(app_stack, APP_STACK_SIZE);
static struct k_thread app_thread_data;

int main(void)
{
	console_init();

	printk("%s suspend-to-RAM demo\n", CONFIG_BOARD);
	printk("Retained S2RAM cycle counter: %u\n", cycles);

	pm_policy_state_lock_get(PM_STATE_RUNTIME_IDLE, PM_ALL_SUBSTATES);
	pm_policy_state_lock_get(PM_STATE_SUSPEND_TO_IDLE, PM_ALL_SUBSTATES);
	pm_policy_state_lock_get(PM_STATE_STANDBY, PM_ALL_SUBSTATES);
	pm_policy_state_lock_get(PM_STATE_SUSPEND_TO_RAM, PM_ALL_SUBSTATES);

#if defined(CONFIG_S2RAM_WAKEUP_BUTTON)
	pm_notifier_register(&button_pm_notifier);
	(void)wuc_enable_wakeup_source_dt(&button);
#endif

	k_thread_create(&app_thread_data, app_stack, APP_STACK_SIZE, app_thread,
			NULL, NULL, NULL, APP_PRIORITY, 0, K_NO_WAIT);

	return 0;
}
```
