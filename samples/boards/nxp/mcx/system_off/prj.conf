## Kconfig
```
# SPDX-FileCopyrightText: Copyright 2026 NXP
# SPDX-License-Identifier: Apache-2.0

mainmenu "NXP MCX system off sample"

choice
	prompt "Deep Power Down wakeup source"
	default SYSTEM_OFF_WAKEUP_TIMER
	help
	  Select how the SoC is woken from Deep Power Down (system off).

config SYSTEM_OFF_WAKEUP_TIMER
	bool "Timed wakeup"
	help
	  Wake after a fixed delay using a low-power timer.

config SYSTEM_OFF_WAKEUP_BUTTON
	bool "Button wakeup"
	help
	  Wake on a user button press.

endchoice

source "Kconfig.zephyr"
```

## sample.yaml
```
# SPDX-FileCopyrightText: Copyright 2026 NXP
# SPDX-License-Identifier: Apache-2.0

sample:
  name: System Off for NXP MCX

common:
  tags:
    - power
    - poweroff
  platform_allow:
    - frdm_mcxn947/mcxn947/cpu0
    - mcx_n5xx_evk/mcxn547/cpu0
    - mcx_n9xx_evk/mcxn947/cpu0
    - frdm_mcxn236
    - frdm_mcxa153
    - frdm_mcxa156
    - frdm_mcxa344
    - frdm_mcxa266
    - frdm_mcxa346
    - frdm_mcxa366
    - frdm_mcxa577
  integration_platforms:
    - frdm_mcxn947/mcxn947/cpu0
    - frdm_mcxa156
  harness: console
  harness_config:
    type: one_line
    regex:
      - "system off demo"

tests:
  sample.boards.nxp.mcx.system_off.timer:
    timeout: 120
    harness_config:
      type: one_line
      regex:
        - "Completed 10 system-off cycles"
    extra_configs:
      - CONFIG_SAMPLE_SYSTEM_OFF_WAKEUP_TIMER=y
  sample.boards.nxp.mcx.system_off.button:
    timeout: 300
    extra_configs:
      - CONFIG_SAMPLE_SYSTEM_OFF_WAKEUP_BUTTON=y
```

## prj.conf
```kconfig
# SPDX-FileCopyrightText: Copyright 2026 NXP
# SPDX-License-Identifier: Apache-2.0

CONFIG_POWEROFF=y
CONFIG_WUC=y
CONFIG_COUNTER=y
CONFIG_COUNTER_MCUX_LPTMR_ALARM=y

# Both variants wait for a console key press before each system-off cycle, so a
# freshly programmed board stays awake and flashable until a key is pressed.
CONFIG_CONSOLE_SUBSYS=y
CONFIG_CONSOLE_GETCHAR=y
```

## src/main.c
```c
/*
 * SPDX-FileCopyrightText: Copyright 2026 NXP
 *
 * SPDX-License-Identifier: Apache-2.0
 */

#include <zephyr/kernel.h>
#include <zephyr/device.h>
#include <zephyr/sys/poweroff.h>
#include <zephyr/drivers/wuc.h>

#include <zephyr/console/console.h>

#if defined(CONFIG_SYSTEM_OFF_WAKEUP_TIMER)
#include <zephyr/drivers/counter.h>

#define WAKEUP_DELAY_S 5U
static const struct device *const lptmr = DEVICE_DT_GET(DT_NODELABEL(lptmr0));
/* LPTMR0 reaches the core as a WUU internal-module wakeup source. */
static const struct wuc_dt_spec wakeup = WUC_DT_SPEC_GET(DT_NODELABEL(lptmr0));
#else
/* The wakeup button (a WUU external pin) is described per board and aliased as
 * "wakeup-button".
 */
static const struct wuc_dt_spec wakeup = WUC_DT_SPEC_GET(DT_ALIAS(wakeup_button));
#endif

#if defined(CONFIG_SYSTEM_OFF_WAKEUP_TIMER)
static void wakeup_alarm_cb(const struct device *dev, uint8_t chan_id, uint32_t ticks,
			    void *user_data)
{
	ARG_UNUSED(dev);
	ARG_UNUSED(chan_id);
	ARG_UNUSED(ticks);
	ARG_UNUSED(user_data);
}

static int arm_timer_wakeup(void)
{
	struct counter_alarm_cfg cfg = {
		.callback = wakeup_alarm_cb,
		.ticks = counter_us_to_ticks(lptmr, (uint64_t)WAKEUP_DELAY_S * USEC_PER_SEC),
		.flags = 0,
	};

	(void)counter_start(lptmr);

	return counter_set_channel_alarm(lptmr, 0, &cfg);
}
#endif

int main(void)
{
	int ret;

	printk("%s system off demo\n", CONFIG_BOARD);

	if (!device_is_ready(wakeup.dev)) {
		printk("WUC device %s not ready\n", wakeup.dev->name);
		return 0;
	}

#if defined(CONFIG_SYSTEM_OFF_WAKEUP_TIMER)
	if (!device_is_ready(lptmr)) {
		printk("LPTMR counter device not ready\n");
		return 0;
	}
#endif

	/* Wait for a console key press before entering system off. Until a key
	 * arrives the SoC stays awake and debuggable, so a freshly programmed
	 * board never bricks its debug port by powering off on its own before
	 * it can be re-flashed. The wakeup then resets the board, which re-runs
	 * main() and prompts again - one key press per system-off cycle.
	 */
	console_init();
	printk("Press any key to enter system off\n");
	(void)console_getchar();

#if defined(CONFIG_SYSTEM_OFF_WAKEUP_TIMER)
	ret = arm_timer_wakeup();
	if (ret < 0) {
		printk("Failed to arm LPTMR wakeup (%d)\n", ret);
		return 0;
	}
#endif

	ret = wuc_enable_wakeup_source_dt(&wakeup);
	if (ret < 0) {
		printk("Failed to enable wakeup source (%d)\n", ret);
		return 0;
	}

#if defined(CONFIG_SYSTEM_OFF_WAKEUP_TIMER)
	printk("Entering system off; the timer wakes it in %u s\r\n", WAKEUP_DELAY_S);
#else
	printk("Entering system off; trigger the wakeup pin to restart\r\n");
#endif

	sys_poweroff();

	/* Deep Power Down wakes through the reset routine, so this is never
	 * reached on a working system off.
	 */
	printk("ERROR: System off failed\n");

	return 0;
}
```
