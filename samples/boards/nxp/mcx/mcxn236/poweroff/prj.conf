## CMakeLists.txt
```
# Copyright 2025 NXP
#
# SPDX-License-Identifier: Apache-2.0

cmake_minimum_required(VERSION 3.20.0)
find_package(Zephyr REQUIRED HINTS $ENV{ZEPHYR_BASE})
project(frdm_mcxn236_poweroff)

target_sources(app PRIVATE src/main.c)
```

## Kconfig
```
# Copyright 2025 NXP
#
# SPDX-License-Identifier: Apache-2.0

mainmenu "FRDM MCXN236 POWER OFF DEMO"

source "Kconfig.zephyr"
```

## sample.yaml
```
# Copyright 2025 NXP
#
# SPDX-License-Identifier: Apache-2.0

sample:
  name: Deep Power Down State Sample for FRDM MCXN236
common:
  tags: power
tests:
  sample.boards.frdm_mcxn236.system_off:
    build_only: true
    platform_allow: frdm_mcxn236
```

## prj.conf
```kconfig
# Copyright 2025 NXP
# SPDX-License-Identifier: Apache-2.0

CONFIG_PM=y
CONFIG_POWEROFF=y
CONFIG_COUNTER=y
CONFIG_CONSOLE_SUBSYS=y
CONFIG_CONSOLE_GETCHAR=y
```

## src/main.c
```c
/*
 * Copyright 2025 NXP
 *
 * SPDX-License-Identifier: Apache-2.0
 */

#include <stdio.h>

#include <zephyr/drivers/counter.h>
#include <zephyr/sys/poweroff.h>
#include <zephyr/sys_clock.h>
#include <zephyr/console/console.h>
#include <zephyr/kernel.h>
#include <zephyr/sys/printk.h>

int main(void)
{
	int ret;
	const struct device *dev = DEVICE_DT_GET(DT_NODELABEL(lptmr0));

	struct counter_top_cfg top_cfg = {
		.ticks = counter_us_to_ticks(dev, 5000000),
		.callback = NULL,
		.user_data = NULL,
		.flags = 0,
	};

	console_init();

	if (!device_is_ready(dev)) {
		printf("Counter device not ready\n");
		return 0;
	}

	ret = counter_set_top_value(dev, &top_cfg);

	ret = counter_start(dev);
	if (ret < 0) {
		printf("Could not start counter (%d)\n", ret);
		return 0;
	}
    printf("srs 1 = %x \n", CMC0->SRS);
    printf("ssrs 1 = %x \n", CMC0->SSRS);
    printf("CPU0LOCKUP = %x \n", SYSCON0->CPUSTAT);
	printf("Will wakeup after 5 seconds\n");
	printf("Press key to power off the system\n");
	uint8_t c = console_getchar();
	printf("Powering off...\n");

	sys_poweroff();

	return 0;
}
```
