## CMakeLists.txt
```
# Copyright 2025 NXP
# SPDX-License-Identifier: Apache-2.0

cmake_minimum_required(VERSION 3.20.0)
find_package(Zephyr REQUIRED HINTS $ENV{ZEPHYR_BASE})
project(psa_crypto_hse)

set(PSA_CRYPTO_HSE_PATH $ENV{PSA_CRYPTO_HSE_PATH})

target_include_directories(app PRIVATE
  ${PSA_CRYPTO_HSE_PATH}/demo/common/application/psa_demo
  ${PSA_CRYPTO_HSE_PATH}/demo/common/inc
)

# Re-use the demo from PSA_wHSE package
target_compile_definitions(app PRIVATE PSA_DEMO)
target_sources(app PRIVATE
  ${PSA_CRYPTO_HSE_PATH}/demo/common/src/global_variables.c
  ${PSA_CRYPTO_HSE_PATH}/demo/common/application/psa_demo/psa_demo.c
  src/main.c
)

# Variables from the demo should be put in non-cacheable region
zephyr_linker_sources(NOCACHE_SECTION nocache.ld)
```

## prj.conf
```kconfig
# Copyright 2025 NXP
# SPDX-License-Identifier: Apache-2.0

CONFIG_MBEDTLS=y
CONFIG_MBEDTLS_PSA_CRYPTO_C=y

CONFIG_MBEDTLS_ENABLE_HEAP=y
CONFIG_MBEDTLS_HEAP_SIZE=50000

CONFIG_MAIN_STACK_SIZE=200000

CONFIG_PSA_WANT_ALG_CBC_NO_PADDING=y
CONFIG_PSA_WANT_ALG_CBC_PKCS7=y
CONFIG_PSA_WANT_ALG_CCM=y
CONFIG_PSA_WANT_ALG_CCM_STAR_NO_TAG=y
CONFIG_PSA_WANT_ALG_CMAC=y
CONFIG_PSA_WANT_ALG_CFB=y
CONFIG_PSA_WANT_ALG_CTR=y
CONFIG_PSA_WANT_ALG_GCM=y
CONFIG_PSA_WANT_ALG_HMAC=y

CONFIG_PSA_WANT_ALG_ECB_NO_PADDING=y
CONFIG_PSA_WANT_ALG_DETERMINISTIC_ECDSA=y
CONFIG_PSA_WANT_ALG_ECDSA=y

CONFIG_PSA_WANT_ALG_SHA_1=y
CONFIG_PSA_WANT_ALG_SHA_224=y
CONFIG_PSA_WANT_ALG_SHA_256=y
CONFIG_PSA_WANT_ALG_SHA_384=y
CONFIG_PSA_WANT_ALG_SHA_512=y

CONFIG_PSA_WANT_ALG_STREAM_CIPHER=y
CONFIG_PSA_WANT_ALG_RSA_OAEP=y

CONFIG_PSA_WANT_ALG_RSA_PKCS1V15_CRYPT=y
CONFIG_PSA_WANT_ALG_RSA_PKCS1V15_SIGN=y
CONFIG_PSA_WANT_ALG_RSA_PSS=y

CONFIG_PSA_WANT_KEY_TYPE_DERIVE=y
CONFIG_PSA_WANT_KEY_TYPE_PASSWORD=y
CONFIG_PSA_WANT_KEY_TYPE_PASSWORD_HASH=y
CONFIG_PSA_WANT_KEY_TYPE_HMAC=y
CONFIG_PSA_WANT_KEY_TYPE_AES=y
CONFIG_PSA_WANT_KEY_TYPE_DES=y
CONFIG_PSA_WANT_KEY_TYPE_ECC_PUBLIC_KEY=y
CONFIG_PSA_WANT_KEY_TYPE_DH_PUBLIC_KEY=y
CONFIG_PSA_WANT_KEY_TYPE_RAW_DATA=y
CONFIG_PSA_WANT_KEY_TYPE_RSA_PUBLIC_KEY=y

CONFIG_PSA_WANT_KEY_TYPE_ECC_KEY_PAIR_IMPORT=y
CONFIG_PSA_WANT_KEY_TYPE_ECC_KEY_PAIR_EXPORT=y
CONFIG_PSA_WANT_KEY_TYPE_ECC_KEY_PAIR_GENERATE=y
CONFIG_PSA_WANT_KEY_TYPE_ECC_KEY_PAIR_DERIVE=y

CONFIG_PSA_WANT_KEY_TYPE_RSA_KEY_PAIR_IMPORT=y
CONFIG_PSA_WANT_KEY_TYPE_RSA_KEY_PAIR_EXPORT=y
CONFIG_PSA_WANT_KEY_TYPE_RSA_KEY_PAIR_GENERATE=y

CONFIG_MBEDTLS_CIPHER=y
CONFIG_MBEDTLS_CIPHER_GCM_ENABLED=y

CONFIG_MBEDTLS_KEY_EXCHANGE_RSA_PSK_ENABLED=y

CONFIG_MBEDTLS_ECP_C=y

CONFIG_MBEDTLS_ECP_DP_SECP192R1_ENABLED=y
CONFIG_MBEDTLS_ECP_DP_SECP224R1_ENABLED=y
CONFIG_MBEDTLS_ECP_DP_SECP256R1_ENABLED=y
CONFIG_MBEDTLS_ECP_DP_SECP192K1_ENABLED=y
CONFIG_MBEDTLS_ECP_DP_SECP256K1_ENABLED=y
CONFIG_MBEDTLS_ECP_DP_BP256R1_ENABLED=y
```

## src/main.c
```c
/*
 * Copyright 2025 NXP
 *
 * SPDX-License-Identifier: Apache-2.0
 */

#include <zephyr/kernel.h>
#include <psa/crypto.h>

#include <Hse_Ip.h>

/* These header files come from PSA_wHSE package */
#include <global_variables.h>
#include <keystore_mgmt.h>
#include <psa_demo.h>

static Hse_Ip_MuStateType hse_mu_state;

psa_status_t psa_crypto_hse_init(void)
{
	hseStatus_t hse_status;
	Hse_Ip_StatusType hse_ip_status;
	KeymgmtErrCodeT err;

	keystore_config_t keystore_cfg = {(hseMuMask_t)(1U << MU0), gRamCatalog, gNvmCatalog};

	/* Wait for HSE to initialize (along with RNG module) by reading the status bits in FSR */
	do {
		hse_status = Hse_Ip_GetHseStatus(MU0);
	} while ((hse_status & (HSE_STATUS_INIT_OK | HSE_STATUS_RNG_INIT_OK)) !=
		 (HSE_STATUS_INIT_OK | HSE_STATUS_RNG_INIT_OK));

	/* HSE and RNG are up - booted correctly and initialized successfully */
	hse_ip_status = Hse_Ip_Init(MU0, &hse_mu_state);
	if (HSE_IP_STATUS_SUCCESS == hse_ip_status) {
		printf("HSE Init success\r\n");
	}

	/*
	 * Key configuration must always be provided to the underlying driver.
	 * The underlying driver will format the key catalogs only if it has
	 * not been done (i.e HSE_STATUS_INSTALL_OK is not set).
	 * The Key configuration will also be stored as internal data to be
	 * used by the driver.
	 */
	err = KeystoreMgmt_Init(&keystore_cfg);
	if (err != KEYMGMT_ERR_SUCCESS) {
		while(1);
	}

	return PSA_SUCCESS;
}

int main(void)
{
	psa_demo_non_os();
}
```
