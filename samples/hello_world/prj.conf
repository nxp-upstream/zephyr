## Kconfig
```
# MCP Parser Configuration

source "Kconfig.zephyr"

menu "MCP Parser Settings"

config MCP_TOOL_NAME_MAX_LEN
    int "Maximum tool name length"
    default 32
    range 16 128
    help
      Maximum length for tool name and title fields.
      This determines the size of the tool_name array in the
      mcp_message structure. Adjust based on your expected
      tool name lengths. Default is 32 characters.

endmenu
```

## prj.conf
```kconfig
# nothing here
CONFIG_PM_DEVICE=y

# I2C
CONFIG_I2C=y

# GPIO
CONFIG_GPIO=y

# Pinctrl
CONFIG_PINCTRL=y

# Regulator
CONFIG_REGULATOR=y

# Video (Camera)
CONFIG_VIDEO=y
CONFIG_VIDEO_BUFFER_POOL_NUM_MAX=4
CONFIG_VIDEO_BUFFER_POOL_HEAP_SIZE=40000000
CONFIG_VIDEO_AP1302=y

# GPIO Expanders
CONFIG_GPIO_PCAL64XXA=y
CONFIG_MFD=y
CONFIG_MFD_ADP5585=y
CONFIG_GPIO_ADP5585=y

#MIPI CSI

#ISI
CONFIG_VIDEO_MCUX_ISI=y

#Shell
CONFIG_SHELL=y
CONFIG_I2C_SHELL=y
CONFIG_DEVICE_SHELL=y
CONFIG_VIDEO_SHELL=y

CONFIG_LOG=y
CONFIG_LOG_DEFAULT_LEVEL=3

CONFIG_VIDEO_AP1302_BUILTIN_FIRMWARE=y
```

## src/main.c
```c
/*
 * Copyright (c) 2012-2014 Wind River Systems, Inc.
 *
 * SPDX-License-Identifier: Apache-2.0
 */

#include <stdio.h>
#include <zephyr/kernel.h>
#include <zephyr/logging/log.h>
#include <zephyr/sys/printk.h>
#include <stdbool.h>

#define THREAD_STACK_SIZE	1024
K_THREAD_STACK_DEFINE(thread_stack, THREAD_STACK_SIZE);
static struct k_thread thread_data;

static void thread_monitor(void *arg1, void *arg2, void *arg3) {
	bool state = true;

	while (1) {
		if (state) {
			GPIO5->PSOR = 1 << 3U; /* set pin high */
		} else {
			GPIO5->PCOR = 1 << 3U; /* set pin low */
		}
		state = !state;
		k_sleep(K_MSEC(1000)); // Expected to run every 1000ms
	}
}

int main(void)
{
	printf("Hello World! %s\n", CONFIG_BOARD_TARGET);

	GPIO5->PDDR |= 1 << 3U;
	GPIO5->PCOR = 1 << 3U;

	/* Create a thread to monitor scheduling */
	k_thread_create(&thread_data, thread_stack, K_THREAD_STACK_SIZEOF(thread_stack),
			thread_monitor, NULL, NULL, NULL, 7, 0, K_NO_WAIT);

	return 0;
}
```
