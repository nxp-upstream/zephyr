## CMakeLists.txt
```
# SPDX-License-Identifier: Apache-2.0

cmake_minimum_required(VERSION 3.28.0)

LIST(APPEND QEMU_EXTRA_FLAGS -serial unix:/tmp/bt-stack-tester)

find_package(Zephyr REQUIRED HINTS $ENV{ZEPHYR_BASE})
project(tester)

zephyr_library_include_directories(${ZEPHYR_BASE}/samples/bluetooth)
zephyr_library_include_directories(${ZEPHYR_BASE}/subsys/bluetooth/mesh)
zephyr_library_include_directories(${ZEPHYR_BASE}/subsys/bluetooth/host)
target_sources(app PRIVATE
    src/main.c
    src/btp.c
    src/btp_core.c
    src/btp_gap.c
    src/btp_gatt.c
    )
if(CONFIG_BT_L2CAP_DYNAMIC_CHANNEL)
target_sources(app PRIVATE src/btp_l2cap.c)
endif()

if(CONFIG_BT_MESH)
target_sources(app PRIVATE src/btp_mesh.c)
endif()

if(CONFIG_BT_IAS OR CONFIG_BT_IAS_CLIENT)
target_sources(app PRIVATE src/btp_ias.c)
endif()

if(CONFIG_BT_OTS)
    target_sources(app PRIVATE src/btp_ots.c)
endif()

if(CONFIG_BT_RFCOMM)
  target_sources(app PRIVATE src/btp_rfcomm.c)
  target_sources(app PRIVATE src/btp_spp.c)
endif()

if(CONFIG_BT_A2DP)
    target_sources(app PRIVATE src/btp_a2dp.c)
endif()

if(CONFIG_BT_AVDTP)
    target_sources(app PRIVATE src/btp_avdtp.c)
endif()

if(CONFIG_BT_AVRCP)
  target_sources(app PRIVATE src/btp_avrcp.c)
endif()

if(CONFIG_BT_AVCTP)
  target_sources(app PRIVATE src/btp_avctp.c)
endif()

if(CONFIG_BT_MAP)
  target_sources(app PRIVATE src/btp_map.c)
endif()

if(CONFIG_BT_HID_DEVICE)
  target_sources(app PRIVATE src/btp_hid_device.c)
endif()

if(CONFIG_BT_HID_HOST)
  target_sources(app PRIVATE src/btp_hid_host.c)
endif()
if(CONFIG_BT_BIP)
  target_sources(app PRIVATE src/btp_bip.c)
endif()

zephyr_library_include_directories(src src/btp src/audio/btp)
add_subdirectory_ifdef(CONFIG_BT_AUDIO src/audio)

if(CONFIG_BT_CLASSIC)
    target_sources(app PRIVATE src/btp_sdp.c)
endif()

if(CONFIG_BT_HFP_HF)
    target_sources(app PRIVATE src/btp_hfp_hf.c)
endif()

if(CONFIG_BT_HFP_AG)
  target_sources(app PRIVATE src/btp_hfp_ag.c)
endif()

if(CONFIG_BT_PBAP)
    target_sources(app PRIVATE src/btp_pbap.c)
endif()

if(CONFIG_BT_OPP)
  target_sources(app PRIVATE src/btp_opp.c)
endif()

if(CONFIG_BT_FTP)
  target_sources(app PRIVATE src/btp_ftp.c)
endif()
```

## prj.conf
```kconfig
CONFIG_TEST=y
CONFIG_UART_PIPE=y
CONFIG_UART_CONSOLE=n
CONFIG_SYSTEM_WORKQUEUE_STACK_SIZE=2048
CONFIG_BTTESTER_LOG_LEVEL_DBG=y

CONFIG_BT=y
CONFIG_BT_CENTRAL=y
CONFIG_BT_PERIPHERAL=y
CONFIG_BT_PRIVACY=n
CONFIG_BT_SMP=y
CONFIG_BT_SMP_SC_PAIR_ONLY=n
CONFIG_BT_SMP_MIN_ENC_KEY_SIZE=7
CONFIG_BT_SMP_ENFORCE_MITM=n
CONFIG_BT_SMP_ALLOW_UNAUTH_OVERWRITE=y
CONFIG_BT_SMP_APP_PAIRING_ACCEPT=y
CONFIG_BT_BONDABLE=y
CONFIG_BT_ATT_PREPARE_COUNT=12
CONFIG_BT_GATT_CLIENT=y
CONFIG_BT_L2CAP_DYNAMIC_CHANNEL=y
CONFIG_BT_L2CAP_TX_MTU=255
CONFIG_BT_L2CAP_SEG_RECV=y
CONFIG_BT_L2CAP_RECONFIGURE_EXPLICIT=y
CONFIG_BT_DEVICE_NAME="Tester"
CONFIG_BT_DEVICE_NAME_MAX=32
CONFIG_BT_DEVICE_NAME_DYNAMIC=y
CONFIG_BT_DEVICE_NAME_GATT_WRITABLE=y
CONFIG_BT_DEVICE_APPEARANCE_DYNAMIC=y
CONFIG_BT_DEVICE_APPEARANCE_GATT_WRITABLE=y
CONFIG_BT_EATT=y
CONFIG_BT_L2CAP_ECRED=y
CONFIG_BT_EATT_MAX=5
CONFIG_BT_FILTER_ACCEPT_LIST=y
CONFIG_BT_EATT_AUTO_CONNECT=n
CONFIG_BT_MAX_CONN=3
CONFIG_BT_MAX_PAIRED=3
CONFIG_BT_GATT_NOTIFY_MULTIPLE=y
CONFIG_BT_ATT_RETRY_ON_SEC_ERR=n
CONFIG_BT_GATT_DYNAMIC_DB=y
CONFIG_BT_EAD=y
CONFIG_BT_EXT_ADV=y
CONFIG_BT_PER_ADV=y
CONFIG_BT_PER_ADV_SYNC=y
CONFIG_BT_PER_ADV_SYNC_TRANSFER_SENDER=y
CONFIG_BT_PER_ADV_SYNC_TRANSFER_RECEIVER=y
CONFIG_BT_ISO_BROADCASTER=y
CONFIG_BT_ISO_SYNC_RECEIVER=y
CONFIG_BT_ISO_CENTRAL=y
CONFIG_BT_ISO_PERIPHERAL=y
CONFIG_BT_ISO_RX_BUF_COUNT=4
CONFIG_BT_ISO_TX_BUF_COUNT=4
CONFIG_BT_RX_STACK_SIZE=4096

CONFIG_BT_TESTING=y
CONFIG_UTF8=y

CONFIG_BT_OTS=y
CONFIG_BT_OTS_DIR_LIST_OBJ=y
CONFIG_BT_OTS_OBJ_NAME_WRITE_SUPPORT=y
CONFIG_BT_OTS_OACP_WRITE_SUPPORT=y
CONFIG_BT_OTS_OACP_PATCH_SUPPORT=y
CONFIG_BT_OTS_OACP_CREATE_SUPPORT=y
CONFIG_BT_OTS_OACP_DELETE_SUPPORT=y
CONFIG_BT_OTS_OACP_CHECKSUM_SUPPORT=y

CONFIG_BT_DIS=y
CONFIG_BT_DIS_PNP=y
CONFIG_BT_DIS_SERIAL_NUMBER=y
CONFIG_BT_DIS_FW_REV=y
CONFIG_BT_DIS_HW_REV=y
CONFIG_BT_DIS_SW_REV=y
CONFIG_BT_DIS_SYSTEM_ID=y
CONFIG_BT_DIS_IEEE_RCDL=y
CONFIG_BT_DIS_UDI=y

CONFIG_BT_BUF_EVT_RX_COUNT=16
CONFIG_BT_BUF_EVT_RX_SIZE=255
CONFIG_BT_BUF_CMD_TX_SIZE=255
CONFIG_BT_BUF_ACL_TX_SIZE=251
CONFIG_BT_BUF_ACL_RX_SIZE=300

# --- TEMP DIAGNOSTIC: route Zephyr LOG to SEGGER RTT ---
CONFIG_USE_SEGGER_RTT=y
CONFIG_LOG=y
CONFIG_LOG_BACKEND_RTT=y
CONFIG_LOG_BACKEND_UART=n
CONFIG_LOG_MODE_IMMEDIATE=y

# auto-pts builtin RTT log collector reads a dedicated up-buffer named "Logger".
# Zephyr only creates this named buffer when CONFIG_LOG_BACKEND_RTT_BUFFER > 0;
# with the default 0 the log goes to the unnamed "Terminal" buffer 0, which
# auto-pts cannot collect. Use buffer 1.
CONFIG_LOG_BACKEND_RTT_BUFFER=1
CONFIG_LOG_BACKEND_RTT_BUFFER_SIZE=4096

# Ensure GOEP/OBEX warning level trace (OBEXDBG uses LOG_WRN) is compiled in.
CONFIG_BT_GOEP_LOG_LEVEL_WRN=y

# Place the RTT control block in normal SRAM (not DTCM) so J-Link RTT Viewer
# can auto-detect it; otherwise the Viewer connects but sees no data.
CONFIG_SEGGER_RTT_SECTION_DTCM=n
CONFIG_SEGGER_RTT_SECTION_NONE=y
# --- END TEMP DIAGNOSTIC ---
```

## prj_br.conf
```kconfig
CONFIG_BT_CLASSIC=y
CONFIG_BT_CENTRAL=y
CONFIG_BT_PERIPHERAL=y
CONFIG_BT_SMP=y
CONFIG_BT_L2CAP_DYNAMIC_CHANNEL=y
CONFIG_BT_PAGE_TIMEOUT=0xFFFF

# L2CAP configurations
CONFIG_BT_L2CAP_RET=y
CONFIG_BT_L2CAP_FC=y
CONFIG_BT_L2CAP_ENH_RET=y
CONFIG_BT_L2CAP_STREAM=y
CONFIG_BT_L2CAP_FCS=y
CONFIG_BT_L2CAP_EXT_WIN_SIZE=y
CONFIG_BT_L2CAP_MAX_WINDOW_SIZE=5

CONFIG_BT_RFCOMM=y

# HFP HF configurations
CONFIG_BT_HFP_HF=y
CONFIG_BT_HFP_HF_3WAY_CALL=y
CONFIG_BT_HFP_HF_MAX_CALLS=2
CONFIG_BT_HFP_HF_VOICE_RECG=y
CONFIG_BT_HFP_HF_ECNR=y
CONFIG_BT_HFP_HF_VOICE_RECG_TEXT=y
CONFIG_BT_HFP_HF_ENH_VOICE_RECG=y
CONFIG_BT_HFP_HF_HF_INDICATORS=y
CONFIG_BT_HFP_HF_CODEC_NEG=y
CONFIG_BT_HFP_HF_CODEC_MSBC=y
CONFIG_BT_HFP_HF_ECS=y
CONFIG_BT_HFP_HF_VOLUME=y
CONFIG_BT_HFP_HF_HF_INDICATOR_ENH_SAFETY=y
CONFIG_BT_HFP_HF_HF_INDICATOR_BATTERY=y

# HFP AG configurations
CONFIG_BT_HFP_AG=y
CONFIG_BT_HFP_AG_3WAY_CALL=y
CONFIG_BT_HFP_AG_MAX_CALLS=2
CONFIG_BT_HFP_AG_VOICE_RECG=y
CONFIG_BT_HFP_AG_ENH_VOICE_RECG=y
CONFIG_BT_HFP_AG_ECNR=y
CONFIG_BT_HFP_AG_VOICE_TAG=y
CONFIG_BT_HFP_AG_VOICE_RECG_TEXT=y
CONFIG_BT_HFP_AG_CODEC_NEG=y
CONFIG_BT_HFP_AG_CODEC_MSBC=y
CONFIG_BT_HFP_AG_HF_INDICATOR_ENH_SAFETY=y
CONFIG_BT_HFP_AG_HF_INDICATOR_BATTERY=y

CONFIG_BT_A2DP=y
CONFIG_BT_A2DP_SOURCE=y
CONFIG_BT_A2DP_SINK=y

CONFIG_BT_AVRCP=y
CONFIG_BT_AVRCP_CONTROLLER=y
CONFIG_BT_AVRCP_TARGET=y
CONFIG_BT_AVRCP_BROWSING=y
CONFIG_BT_AVRCP_VD_RX_SIZE=1024
CONFIG_BT_AVRCP_TG_COVER_ART=y
CONFIG_BT_AVRCP_CT_COVER_ART_GET_IMAGE_PROPERTIES=y
CONFIG_BT_AVRCP_CT_COVER_ART_GET_IMAGE=y
CONFIG_BT_AVRCP_CT_COVER_ART_GET_LINKED_THUMBNAIL=y
CONFIG_BT_L2CAP_TX_MTU=266
CONFIG_BT_L2CAP_MPS=266

CONFIG_BT_PBAP_PSE=y
CONFIG_BT_PBAP_PCE=y

CONFIG_BT_MAP_MCE=y
CONFIG_BT_MAP_MSE=y

CONFIG_BT_OPP_CLIENT=y
CONFIG_BT_OPP_SERVER=y

CONFIG_BT_BIP=y

CONFIG_BT_FTP_CLIENT=y
CONFIG_BT_FTP_SERVER=y

CONFIG_BT_BUF_ACL_RX_SIZE=300
```

## src/btp_a2dp.c
```c
/* btp_a2dp.h - Bluetooth tester headers */

/*
 * Copyright (c) 2025 Intel Corporation
 *
 * SPDX-License-Identifier: Apache-2.0
 */

#include <errno.h>
#include <stddef.h>
#include <stdint.h>
#include <string.h>

#include <zephyr/autoconf.h>
#include <zephyr/bluetooth/addr.h>
#include <zephyr/bluetooth/bluetooth.h>
#include <zephyr/bluetooth/conn.h>
#include <zephyr/bluetooth/l2cap.h>
#include <zephyr/bluetooth/classic/a2dp_codec_sbc.h>
#include <zephyr/bluetooth/classic/a2dp.h>
#include <zephyr/bluetooth/classic/sdp.h>
#include <zephyr/kernel.h>
#include <zephyr/logging/log.h>
#include <zephyr/net_buf.h>
#include <zephyr/sys/byteorder.h>
#include <zephyr/sys/util.h>
#include <sys/types.h>

#include "btp/btp.h"

static uint8_t role;
static struct k_work_delayable send_media;

static struct bt_a2dp *default_a2dp;
static struct bt_a2dp_ep *found_peer_sbc_endpoint;
static struct bt_a2dp_ep *registered_sbc_endpoint;
struct bt_a2dp_codec_ie peer_sbc_capabilities;
static struct bt_a2dp_ep peer_sbc_endpoint = {
	.codec_cap = &peer_sbc_capabilities,
};
static struct bt_a2dp_stream sbc_stream;
static struct bt_a2dp_stream_ops stream_ops;
NET_BUF_POOL_DEFINE(a2dp_tx_pool, CONFIG_BT_MAX_CONN, BT_L2CAP_BUF_SIZE(CONFIG_BT_L2CAP_TX_MTU),
		    CONFIG_BT_CONN_TX_USER_DATA_SIZE, NULL);
BT_A2DP_SBC_EP_CFG(sbc_cfg_default, A2DP_SBC_SAMP_FREQ_48000, A2DP_SBC_CH_MODE_JOINT,
		   A2DP_SBC_BLK_LEN_16 | A2DP_SBC_SUBBAND_8, A2DP_SBC_SUBBAND_8,
		   A2DP_SBC_ALLOC_MTHD_LOUDNESS, 14U, 100U);

#if defined(CONFIG_BT_A2DP_SINK)

BT_A2DP_SBC_SINK_EP(sink_sbc_endpoint,
		    A2DP_SBC_SAMP_FREQ_16000 | A2DP_SBC_SAMP_FREQ_32000 | A2DP_SBC_SAMP_FREQ_44100 |
			    A2DP_SBC_SAMP_FREQ_48000,
		    A2DP_SBC_CH_MODE_MONO | A2DP_SBC_CH_MODE_DUAL | A2DP_SBC_CH_MODE_STREO |
			    A2DP_SBC_CH_MODE_JOINT,
		    A2DP_SBC_BLK_LEN_4 | A2DP_SBC_BLK_LEN_8 | A2DP_SBC_BLK_LEN_12 |
			    A2DP_SBC_BLK_LEN_16,
		    A2DP_SBC_SUBBAND_4 | A2DP_SBC_SUBBAND_8,
		    A2DP_SBC_ALLOC_MTHD_SNR | A2DP_SBC_ALLOC_MTHD_LOUDNESS, 14U, 100U);

static struct bt_sdp_attribute a2dp_sink_attrs[] = {
	BT_SDP_NEW_SERVICE,
	BT_SDP_LIST(
		BT_SDP_ATTR_SVCLASS_ID_LIST,
		BT_SDP_TYPE_SIZE_VAR(BT_SDP_SEQ8, 3), /* 35 03 */
		BT_SDP_DATA_ELEM_LIST(
		{
			BT_SDP_TYPE_SIZE(BT_SDP_UUID16), /* 19 */
			BT_SDP_ARRAY_16(BT_SDP_AUDIO_SINK_SVCLASS) /* 11 0B */
		},
		)
	),
	BT_SDP_LIST(
		BT_SDP_ATTR_PROTO_DESC_LIST,
		BT_SDP_TYPE_SIZE_VAR(BT_SDP_SEQ8, 16),/* 35 10 */
		BT_SDP_DATA_ELEM_LIST(
		{
			BT_SDP_TYPE_SIZE_VAR(BT_SDP_SEQ8, 6),/* 35 06 */
			BT_SDP_DATA_ELEM_LIST(
			{
				BT_SDP_TYPE_SIZE(BT_SDP_UUID16), /* 19 */
				BT_SDP_ARRAY_16(BT_SDP_PROTO_L2CAP) /* 01 00 */
			},
			{
				BT_SDP_TYPE_SIZE(BT_SDP_UINT16), /* 09 */
				BT_SDP_ARRAY_16(BT_UUID_AVDTP_VAL) /* 00 19 */
			},
			)
		},
		{
			BT_SDP_TYPE_SIZE_VAR(BT_SDP_SEQ8, 6),/* 35 06 */
			BT_SDP_DATA_ELEM_LIST(
			{
				BT_SDP_TYPE_SIZE(BT_SDP_UUID16), /* 19 */
				BT_SDP_ARRAY_16(BT_UUID_AVDTP_VAL) /* 00 19 */
			},
			{
				BT_SDP_TYPE_SIZE(BT_SDP_UINT16), /* 09 */
				BT_SDP_ARRAY_16(0x0103U) /* AVDTP version: 01 03 */
			},
			)
		},
		)
	),
	BT_SDP_LIST(
		BT_SDP_ATTR_PROFILE_DESC_LIST,
		BT_SDP_TYPE_SIZE_VAR(BT_SDP_SEQ8, 8), /* 35 08 */
		BT_SDP_DATA_ELEM_LIST(
		{
			BT_SDP_TYPE_SIZE_VAR(BT_SDP_SEQ8, 6), /* 35 06 */
			BT_SDP_DATA_ELEM_LIST(
			{
				BT_SDP_TYPE_SIZE(BT_SDP_UUID16), /* 19 */
				BT_SDP_ARRAY_16(BT_SDP_ADVANCED_AUDIO_SVCLASS) /* 11 0d */
			},
			{
				BT_SDP_TYPE_SIZE(BT_SDP_UINT16), /* 09 */
				BT_SDP_ARRAY_16(0x0104U) /* 01 04 */
			},
			)
		},
		)
	),
	BT_SDP_SERVICE_NAME("A2DPSink"),
	BT_SDP_SUPPORTED_FEATURES(0x0001U),
};
static struct bt_sdp_record a2dp_sink_rec = BT_SDP_RECORD(a2dp_sink_attrs);
#endif /*CONFIG_BT_A2DP_SINK*/

#if defined(CONFIG_BT_A2DP_SOURCE)
BT_A2DP_SBC_SINK_EP(source_sbc_endpoint,
		    A2DP_SBC_SAMP_FREQ_16000 | A2DP_SBC_SAMP_FREQ_32000 | A2DP_SBC_SAMP_FREQ_44100 |
			    A2DP_SBC_SAMP_FREQ_48000,
		    A2DP_SBC_CH_MODE_MONO | A2DP_SBC_CH_MODE_DUAL | A2DP_SBC_CH_MODE_STREO |
			    A2DP_SBC_CH_MODE_JOINT,
		    A2DP_SBC_BLK_LEN_4 | A2DP_SBC_BLK_LEN_8 | A2DP_SBC_BLK_LEN_12 |
			    A2DP_SBC_BLK_LEN_16,
		    A2DP_SBC_SUBBAND_4 | A2DP_SBC_SUBBAND_8,
		    A2DP_SBC_ALLOC_MTHD_SNR | A2DP_SBC_ALLOC_MTHD_LOUDNESS, 14U, 100U);

static struct bt_sdp_attribute a2dp_source_attrs[] = {
	BT_SDP_NEW_SERVICE,
	BT_SDP_LIST(
		BT_SDP_ATTR_SVCLASS_ID_LIST,
		BT_SDP_TYPE_SIZE_VAR(BT_SDP_SEQ8, 3),
		BT_SDP_DATA_ELEM_LIST(
		{
			BT_SDP_TYPE_SIZE(BT_SDP_UUID16),
			BT_SDP_ARRAY_16(BT_SDP_AUDIO_SOURCE_SVCLASS)
		},
		)
	),
	BT_SDP_LIST(
		BT_SDP_ATTR_PROTO_DESC_LIST,
		BT_SDP_TYPE_SIZE_VAR(BT_SDP_SEQ8, 16),
		BT_SDP_DATA_ELEM_LIST(
		{
			BT_SDP_TYPE_SIZE_VAR(BT_SDP_SEQ8, 6),
			BT_SDP_DATA_ELEM_LIST(
			{
				BT_SDP_TYPE_SIZE(BT_SDP_UUID16),
				BT_SDP_ARRAY_16(BT_SDP_PROTO_L2CAP)
			},
			{
				BT_SDP_TYPE_SIZE(BT_SDP_UINT16),
				BT_SDP_ARRAY_16(BT_UUID_AVDTP_VAL)
			},
			)
		},
		{
			BT_SDP_TYPE_SIZE_VAR(BT_SDP_SEQ8, 6),
			BT_SDP_DATA_ELEM_LIST(
			{
				BT_SDP_TYPE_SIZE(BT_SDP_UUID16),
				BT_SDP_ARRAY_16(BT_UUID_AVDTP_VAL)
			},
			{
				BT_SDP_TYPE_SIZE(BT_SDP_UINT16),
				BT_SDP_ARRAY_16(0x0103U)
			},
			)
		},
		)
	),
	BT_SDP_LIST(
		BT_SDP_ATTR_PROFILE_DESC_LIST,
		BT_SDP_TYPE_SIZE_VAR(BT_SDP_SEQ8, 8),
		BT_SDP_DATA_ELEM_LIST(
		{
			BT_SDP_TYPE_SIZE_VAR(BT_SDP_SEQ8, 6),
			BT_SDP_DATA_ELEM_LIST(
			{
				BT_SDP_TYPE_SIZE(BT_SDP_UUID16),
				BT_SDP_ARRAY_16(BT_SDP_ADVANCED_AUDIO_SVCLASS)
			},
			{
				BT_SDP_TYPE_SIZE(BT_SDP_UINT16),
				BT_SDP_ARRAY_16(0x0104U)
			},
			)
		},
		)
	),
	BT_SDP_SERVICE_NAME("A2DPSource"),
	BT_SDP_SUPPORTED_FEATURES(0x0001U),
};

static struct bt_sdp_record a2dp_source_rec = BT_SDP_RECORD(a2dp_source_attrs);

#endif /*CONFIG_BT_A2DP_SOURCE*/

static uint8_t media_data[] = {
	0x01, 0x02, 0x03, 0x04, 0x05, 0x06, 0x07, 0x08, 0x09, 0x0a, 0x0b, 0x0c, 0x0d, 0x0e, 0x0f,
	0x10, 0x01, 0x02, 0x03, 0x04, 0x05, 0x06, 0x07, 0x08, 0x09, 0x0a, 0x0b, 0x0c, 0x0d, 0x0e,
	0x0f, 0x10, 0x01, 0x02, 0x03, 0x04, 0x05, 0x06, 0x07, 0x08, 0x09, 0x0a, 0x0b, 0x0c, 0x0d,
	0x0e, 0x0f, 0x10, 0x01, 0x02, 0x03, 0x04, 0x05, 0x06, 0x07, 0x08, 0x09, 0x0a, 0x0b, 0x0c,
	0x0d, 0x0e, 0x0f, 0x10, 0x01, 0x02, 0x03, 0x04, 0x05, 0x06, 0x07, 0x08, 0x09, 0x0a, 0x0b,
	0x0c, 0x0d, 0x0e, 0x0f, 0x10, 0x01, 0x02, 0x03, 0x04, 0x05, 0x06, 0x07, 0x08, 0x09, 0x0a,
	0x0b, 0x0c, 0x0d, 0x0e, 0x0f, 0x10, 0x01, 0x02, 0x03, 0x04, 0x05, 0x06, 0x07, 0x08, 0x09,
	0x0a, 0x0b, 0x0c, 0x0d, 0x0e, 0x0f, 0x10, 0x01, 0x02, 0x03, 0x04, 0x05, 0x06, 0x07, 0x08,
	0x09, 0x0a, 0x0b, 0x0c, 0x0d, 0x0e, 0x0f, 0x10, 0x01, 0x02, 0x03, 0x04, 0x05, 0x06, 0x07,
	0x08, 0x09, 0x0a, 0x0b, 0x0c, 0x0d, 0x0e, 0x0f, 0x10, 0x01, 0x02, 0x03, 0x04, 0x05, 0x06,
	0x07, 0x08, 0x09, 0x0a, 0x0b, 0x0c, 0x0d, 0x0e, 0x0f, 0x10,
};

static uint8_t supported_commands(const void *cmd, uint16_t cmd_len, void *rsp, uint16_t *rsp_len)
{
	struct btp_a2dp_read_supported_commands_rp *rp = rsp;

	*rsp_len = tester_supported_commands(BTP_SERVICE_ID_A2DP, rp->data);
	*rsp_len += sizeof(*rp);

	return BTP_STATUS_SUCCESS;
}

static void a2dp_send_media_timeout(struct k_work *work)
{
	struct net_buf *buf;
	int ret;

	buf = net_buf_alloc(&a2dp_tx_pool, K_FOREVER);
	net_buf_reserve(buf, BT_A2DP_STREAM_BUF_RESERVE);

	/* num of frames is 1 */
	net_buf_add_u8(buf, (uint8_t)BT_A2DP_SBC_MEDIA_HDR_ENCODE(1, 0, 0, 0));
	net_buf_add_mem(buf, media_data, sizeof(media_data));
	ret = bt_a2dp_stream_send(&sbc_stream, buf, 0U, 0U);
	if (ret < 0) {
		net_buf_unref(buf);
		return;
	}
	k_work_schedule(&send_media, K_MSEC(1000));
}

static void app_connected(struct bt_a2dp *a2dp, int err)
{
	struct btp_a2dp_connected_ev ev;

	(void)memset(&ev, 0, sizeof(ev));
	if (!err) {
		default_a2dp = a2dp;
	}
	ev.errcode = err;
	if (role == BT_AVDTP_SOURCE) {
		k_work_init_delayable(&send_media, a2dp_send_media_timeout);
	}
	tester_event(BTP_SERVICE_ID_A2DP, BTP_A2DP_EV_CONNECTED, &ev, sizeof(ev));
}

static void app_disconnected(struct bt_a2dp *a2dp)
{
	found_peer_sbc_endpoint = NULL;
	if (role == BT_AVDTP_SOURCE) {
		k_work_cancel_delayable(&send_media);
	}
	tester_event(BTP_SERVICE_ID_A2DP, BTP_A2DP_EV_DISCONNECTED, NULL, 0);
}

static int app_config_req(struct bt_a2dp *a2dp, struct bt_a2dp_ep *ep,
			  struct bt_a2dp_codec_cfg *codec_cfg, struct bt_a2dp_stream **stream,
			  uint8_t *rsp_err_code)
{

	bt_a2dp_stream_cb_register(&sbc_stream, NULL);
	*stream = &sbc_stream;
	*rsp_err_code = 0;
	return 0;
}

static void app_config_rsp(struct bt_a2dp_stream *stream, uint8_t rsp_err_code)
{
	struct btp_a2dp_set_config_rsp ev;
	memset(&ev, 0, sizeof(ev));
	ev.errcode = rsp_err_code;
	tester_event(BTP_SERVICE_ID_A2DP, BTP_A2DP_EV_SET_CONFIGURATION_RSP, &ev, sizeof(ev));
}

static void app_establish_rsp(struct bt_a2dp_stream *stream, uint8_t rsp_err_code)
{
	struct btp_a2dp_establish_rsp ev;
	memset(&ev, 0, sizeof(ev));
	ev.errcode = rsp_err_code;
	tester_event(BTP_SERVICE_ID_A2DP, BTP_A2DP_EV_ESTABLISH_RSP, &ev, sizeof(ev));
}

static void app_release_rsp(struct bt_a2dp_stream *stream, uint8_t rsp_err_code)
{
	struct btp_a2dp_release_rsp ev;
	memset(&ev, 0, sizeof(ev));
	ev.errcode = rsp_err_code;
	if (role == BT_AVDTP_SOURCE) {
		k_work_cancel_delayable(&send_media);
	}
	tester_event(BTP_SERVICE_ID_A2DP, BTP_A2DP_EV_RELEASE_RSP, &ev, sizeof(ev));
}

static int app_start_req(struct bt_a2dp_stream *stream, uint8_t *rsp_err_code)
{
	*rsp_err_code = 0;

	if (role == BT_AVDTP_SOURCE) {
		k_work_schedule(&send_media, K_MSEC(1000));
	}

	return 0;
}

static void app_start_rsp(struct bt_a2dp_stream *stream, uint8_t rsp_err_code)
{
	struct btp_a2dp_start_rsp ev;
	memset(&ev, 0, sizeof(ev));
	ev.errcode = rsp_err_code;
	if (role == BT_AVDTP_SOURCE) {
		k_work_schedule(&send_media, K_MSEC(1000));
	}
	tester_event(BTP_SERVICE_ID_A2DP, BTP_A2DP_EV_START_RSP, &ev, sizeof(ev));
}

static int app_suspend_req(struct bt_a2dp_stream *stream, uint8_t *rsp_err_code)
{
	*rsp_err_code = 0;
	if (role == BT_AVDTP_SOURCE) {
		k_work_cancel_delayable(&send_media);
	}
	return 0;
}

static void app_suspend_rsp(struct bt_a2dp_stream *stream, uint8_t rsp_err_code)
{
	struct btp_a2dp_suspend_rsp ev;
	memset(&ev, 0, sizeof(ev));
	ev.errcode = rsp_err_code;
	if (role == BT_AVDTP_SOURCE) {
		k_work_cancel_delayable(&send_media);
	}
	tester_event(BTP_SERVICE_ID_A2DP, BTP_A2DP_EV_SUSPEND_RSP, &ev, sizeof(ev));
}

struct bt_a2dp_cb a2dp_cb = {
	.connected = app_connected,
	.disconnected = app_disconnected,
	.config_req = app_config_req,
	.config_rsp = app_config_rsp,
	.establish_rsp = app_establish_rsp,
	.release_rsp = app_release_rsp,
	.start_req = app_start_req,
	.start_rsp = app_start_rsp,
	.suspend_req = app_suspend_req,
	.suspend_rsp = app_suspend_rsp,
};

static uint8_t register_ep(const void *cmd, uint16_t cmd_len, void *rsp, uint16_t *rsp_len)
{
	int err = -1;
	const struct btp_a2dp_register_ep_cmd *cp = cmd;

	if (cp->codec == BTP_A2DP_REGISTER_EP_CODEC_SBC) {
		if (cp->role == BTP_A2DP_REGISTER_EP_ROLE_SINK) {
#if defined(CONFIG_BT_A2DP_SINK)
			err = bt_a2dp_register_ep(&sink_sbc_endpoint, BT_AVDTP_AUDIO,
						  BT_AVDTP_SINK);
			if (!err) {
				registered_sbc_endpoint = &sink_sbc_endpoint;
				role = BT_AVDTP_SINK;
			}
#endif /*CONFIG_BT_A2DP_SINK*/
		} else if (cp->role == BTP_A2DP_REGISTER_EP_ROLE_SOURCE) {
#if defined(CONFIG_BT_A2DP_SOURCE)
			err = bt_a2dp_register_ep(&source_sbc_endpoint, BT_AVDTP_AUDIO,
						  BT_AVDTP_SOURCE);
			if (!err) {
				registered_sbc_endpoint = &source_sbc_endpoint;
				role = BT_AVDTP_SOURCE;
			}
#endif /*CONFIG_BT_A2DP_SOURCE*/
		} else {
			return BTP_STATUS_FAILED;
		}
	} else {
		return BTP_STATUS_FAILED;
	}

	if (err) {
		return BTP_STATUS_FAILED;
	}
	return BTP_STATUS_SUCCESS;
}

static uint8_t a2dp_connect(const void *cmd, uint16_t cmd_len, void *rsp, uint16_t *rsp_len)
{
	struct bt_conn *acl_conn;
	const struct btp_a2dp_connect_cmd *cp = cmd;

	acl_conn = bt_conn_lookup_addr_br(&cp->address);

	if (acl_conn == NULL) {
		return BTP_STATUS_FAILED;
	}

	default_a2dp = bt_a2dp_connect(acl_conn);
	if (NULL == default_a2dp) {
		return BTP_STATUS_FAILED;
	}

	return BTP_STATUS_SUCCESS;
}

static uint8_t a2dp_configure(const void *cmd, uint16_t cmd_len, void *rsp, uint16_t *rsp_len)
{
	int err;

	if (default_a2dp != NULL) {
		if (registered_sbc_endpoint == NULL) {
			return BTP_STATUS_FAILED;
		}

		if (found_peer_sbc_endpoint == NULL) {
			found_peer_sbc_endpoint = &peer_sbc_endpoint;
		}

		bt_a2dp_stream_cb_register(&sbc_stream, &stream_ops);

		err = bt_a2dp_stream_config(default_a2dp, &sbc_stream, registered_sbc_endpoint,
					    found_peer_sbc_endpoint, &sbc_cfg_default);
		if (err) {
			return BTP_STATUS_FAILED;
		}
	} else {

		return BTP_STATUS_FAILED;
	}
	return BTP_STATUS_SUCCESS;
}

static uint8_t a2dp_establish(const void *cmd, uint16_t cmd_len, void *rsp, uint16_t *rsp_len)
{
	if (bt_a2dp_stream_establish(&sbc_stream) != 0) {
		return BTP_STATUS_FAILED;
	}
	return BTP_STATUS_SUCCESS;
}

static uint8_t a2dp_start(const void *cmd, uint16_t cmd_len, void *rsp, uint16_t *rsp_len)
{
	if (bt_a2dp_stream_start(&sbc_stream) != 0) {
		return BTP_STATUS_FAILED;
	}
	return BTP_STATUS_SUCCESS;
}

static uint8_t a2dp_suspend(const void *cmd, uint16_t cmd_len, void *rsp, uint16_t *rsp_len)
{
	if (bt_a2dp_stream_suspend(&sbc_stream) != 0) {
		return BTP_STATUS_FAILED;
	}
	return BTP_STATUS_SUCCESS;
}

static uint8_t a2dp_release(const void *cmd, uint16_t cmd_len, void *rsp, uint16_t *rsp_len)
{
	if (bt_a2dp_stream_release(&sbc_stream) != 0) {
		return BTP_STATUS_FAILED;
	}
	return BTP_STATUS_SUCCESS;
}

static uint8_t bt_a2dp_discover_peer_endpoint_cb(struct bt_a2dp *a2dp, struct bt_a2dp_ep_info *info,
						 struct bt_a2dp_ep **ep)
{
	if (info != NULL) {
		if ((info->codec_type == BT_A2DP_SBC) && (ep != NULL)) {
			*ep = &peer_sbc_endpoint;
			found_peer_sbc_endpoint = &peer_sbc_endpoint;
			tester_event(BTP_SERVICE_ID_A2DP, BTP_A2DP_EV_GET_CAPABILITIES_RSP, NULL, 0);
		}	
	}
	return BT_A2DP_DISCOVER_EP_CONTINUE;
}
static struct bt_avdtp_sep_info found_seps[5];
struct bt_a2dp_discover_param discover_param = {
	.cb = bt_a2dp_discover_peer_endpoint_cb,
	.seps_info = &found_seps[0],
	.sep_count = 5,
};

static uint8_t a2dp_discover(const void *cmd, uint16_t cmd_len, void *rsp, uint16_t *rsp_len)
{
	if (default_a2dp != NULL) {
		int err = bt_a2dp_discover(default_a2dp, &discover_param);

		if (err) {
			return BTP_STATUS_FAILED;
		}
	} else {
		return BTP_STATUS_FAILED;
	}
	return BTP_STATUS_SUCCESS;
}

static const struct btp_handler handlers[] = {
	{
		.opcode = BTP_A2DP_READ_SUPPORTED_COMMANDS,
		.index = BTP_INDEX_NONE,
		.expect_len = 0,
		.func = supported_commands,
	},
	{
		.opcode = BTP_A2DP_REGISTER_EP,
		.expect_len = sizeof(struct btp_a2dp_register_ep_cmd),
		.func = register_ep,
	},
	{
		.opcode = BTP_A2DP_CONNECT,
		.expect_len = sizeof(struct btp_a2dp_connect_cmd),
		.func = a2dp_connect,
	},
	{
		.opcode = BTP_A2DP_DISCOVER,
		.expect_len = 0,
		.func = a2dp_discover,
	},
	{
		.opcode = BTP_A2DP_CONFIGURE,
		.expect_len = 0,
		.func = a2dp_configure,
	},
	{
		.opcode = BTP_A2DP_ESTABLISH,
		.expect_len = 0,
		.func = a2dp_establish,
	},
	{
		.opcode = BTP_A2DP_START,
		.expect_len = 0,
		.func = a2dp_start,
	},
	{
		.opcode = BTP_A2DP_SUSPEND,
		.expect_len = 0,
		.func = a2dp_suspend,
	},
	{
		.opcode = BTP_A2DP_RELEASE,
		.expect_len = 0,
		.func = a2dp_release,
	},

};

uint8_t tester_init_a2dp(void)
{
	int err;

	bt_a2dp_register_cb(&a2dp_cb);
#if defined(CONFIG_BT_A2DP_SINK)
	err = bt_sdp_register_service(&a2dp_sink_rec);
	if (err) {
		return BTP_STATUS_FAILED;
	}
#endif /*CONFIG_BT_A2DP_SINK*/

#if defined(CONFIG_BT_A2DP_SOURCE)
	err = bt_sdp_register_service(&a2dp_source_rec);
	if (err) {
		return BTP_STATUS_FAILED;
	}
#endif /*CONFIG_BT_A2DP_SOURCE*/

	tester_register_command_handlers(BTP_SERVICE_ID_A2DP, handlers, ARRAY_SIZE(handlers));
	return BTP_STATUS_SUCCESS;
}

uint8_t tester_unregister_a2dp(void)
{
	return BTP_STATUS_SUCCESS;
}
```

## src/btp_core.c
```c
/* btp_core.c - Bluetooth Core service */

/*
 * Copyright (c) 2015-2016 Intel Corporation
 * Copyright (c) 2023 Codecoup
 *
 * SPDX-License-Identifier: Apache-2.0
 */

#include <stdint.h>

#include <zephyr/autoconf.h>
#include <zephyr/bluetooth/bluetooth.h>
#include <zephyr/bluetooth/conn.h>
#include <zephyr/bluetooth/gatt.h>
#include <zephyr/bluetooth/hci.h>
#include <zephyr/logging/log.h>
#include <zephyr/net_buf.h>
#include <zephyr/sys/atomic.h>
#include <zephyr/sys/byteorder.h>
#include <zephyr/sys/util.h>
#include <zephyr/toolchain.h>

#include "btp/btp.h"
#include "hci_core.h"

#define LOG_MODULE_NAME bttester_core
LOG_MODULE_REGISTER(LOG_MODULE_NAME, CONFIG_BTTESTER_LOG_LEVEL);

#if defined(CONFIG_BT_BAP_UNICAST_CLIENT) || defined(CONFIG_BT_BAP_UNICAST_SERVER) ||              \
	defined(CONFIG_BT_BAP_BROADCAST_SOURCE) || defined(CONFIG_BT_BAP_BROADCAST_SINK) ||        \
	defined(CONFIG_BT_BAP_BROADCAST_ASSISTANT) || defined(CONFIG_BT_BAP_SCAN_DELEGATOR)
#define BAP_SUPPORTED 1
#endif

#if defined(CONFIG_BT_CAP_ACCEPTOR) || defined(CONFIG_BT_CAP_INITIATOR) ||                         \
	defined(CONFIG_BT_CAP_COMMANDER)
#define CAP_SUPPORTED 1
#endif

static ATOMIC_DEFINE(registered_services, BTP_SERVICE_ID_COUNT);

static uint8_t supported_commands(const void *cmd, uint16_t cmd_len,
				  void *rsp, uint16_t *rsp_len)
{
	struct btp_core_read_supported_commands_rp *rp = rsp;

	*rsp_len = tester_supported_commands(BTP_SERVICE_ID_CORE, rp->data);
	*rsp_len += sizeof(*rp);

	return BTP_STATUS_SUCCESS;
}

#define SERVICES_BITMAP_BYTES DIV_ROUND_UP(BTP_SERVICE_ID_COUNT, BITS_PER_BYTE)
#define SUPPORTED_SERVICES_RSP_LEN (sizeof(struct btp_core_read_supported_services_rp) + \
		SERVICES_BITMAP_BYTES)

static uint8_t supported_services(const void *cmd, uint16_t cmd_len,
				  void *rsp, uint16_t *rsp_len)
{
	struct btp_core_read_supported_services_rp *rp = rsp;

	/* octet 0 */
	tester_set_bit(rp->data, BTP_SERVICE_ID_CORE);
	tester_set_bit(rp->data, BTP_SERVICE_ID_GAP);
	tester_set_bit(rp->data, BTP_SERVICE_ID_GATT);
#if defined(CONFIG_BT_L2CAP_DYNAMIC_CHANNEL)
	tester_set_bit(rp->data, BTP_SERVICE_ID_L2CAP);
#endif /* CONFIG_BT_L2CAP_DYNAMIC_CHANNEL */
#if defined(CONFIG_BT_MESH)
	tester_set_bit(rp->data, BTP_SERVICE_ID_MESH);
#endif /* CONFIG_BT_MESH */

	/* octet 1 */
#if defined(CONFIG_BT_VCP_VOL_REND)
	tester_set_bit(rp->data, BTP_SERVICE_ID_VCS);
#endif /* CONFIG_BT_VCP_VOL_REND */
#if defined(CONFIG_BT_IAS) || defined(CONFIG_BT_IAS_CLIENT)
	tester_set_bit(rp->data, BTP_SERVICE_ID_IAS);
#endif /* CONFIG_BT_IAS */
#if defined(CONFIG_BT_AICS) || defined(CONFIG_BT_AICS_CLIENT)
	tester_set_bit(rp->data, BTP_SERVICE_ID_AICS);
#endif /*CONFIG_BT_AICS */
#if defined(CONFIG_BT_VOCS) || defined(CONFIG_BT_VOCS_CLIENT)
	tester_set_bit(rp->data, BTP_SERVICE_ID_VOCS);
#endif /* CONFIG_BT_VOCS */
#if defined(CONFIG_BT_PACS)
	tester_set_bit(rp->data, BTP_SERVICE_ID_PACS);
#endif /* CONFIG_BT_PACS */
#if defined(CONFIG_BT_AICS)
	tester_set_bit(rp->data, BTP_SERVICE_ID_AICS);
#endif /* CONFIG_BT_AICS */
#if BAP_SUPPORTED
	tester_set_bit(rp->data, BTP_SERVICE_ID_BAP);
#endif /* BAP_SUPPORTED */
#if defined(CONFIG_BT_HAS) || defined(CONFIG_BT_HAS_CLIENT)
	tester_set_bit(rp->data, BTP_SERVICE_ID_HAS);
#endif /* CONFIG_BT_HAS */

	/* octet 2 */
#if defined(CONFIG_BT_MICP_MIC_DEV) || defined(CONFIG_BT_MICP_MIC_CTLR)
	tester_set_bit(rp->data, BTP_SERVICE_ID_MICP);
#endif /* CONFIG_BT_MICP_MIC_DEV || CONFIG_BT_MICP_MIC_CTLR */
#if defined(CONFIG_BT_CSIP_SET_MEMBER)
	tester_set_bit(rp->data, BTP_SERVICE_ID_CSIS);
#endif /* CONFIG_BT_CSIP_SET_MEMBER */
#if defined(CONFIG_BT_MICP_MIC_DEV)
	tester_set_bit(rp->data, BTP_SERVICE_ID_MICS);
#endif /* CONFIG_BT_MICP_MIC_DEV */
#if defined(CONFIG_BT_TBS_CLIENT)
	tester_set_bit(rp->data, BTP_SERVICE_ID_CCP);
#endif /* CONFIG_BT_TBS_CLIENT */
#if defined(CONFIG_BT_VCP_VOL_CTLR)
	tester_set_bit(rp->data, BTP_SERVICE_ID_VCP);
#endif /* CONFIG_BT_VCP_VOL_CTLR */
#if defined(CONFIG_BT_CAP_ACCEPTOR)
	tester_set_bit(rp->data, BTP_SERVICE_ID_CAS);
#endif /* CONFIG_BT_CAP_ACCEPTOR */
#if defined(CONFIG_BT_MCC)
	tester_set_bit(rp->data, BTP_SERVICE_ID_MCP);
#endif /* CONFIG_BT_MCC */
#if defined(CONFIG_BT_MCS)
	tester_set_bit(rp->data, BTP_SERVICE_ID_GMCS);
#endif /* CONFIG_BT_MCS */

	/* octet 3 */
#if defined(CONFIG_BT_HAS)
	tester_set_bit(rp->data, BTP_SERVICE_ID_HAP);
#endif /* CONFIG_BT_HAS */
#if defined(CONFIG_BT_CSIP_SET_COORDINATOR) || defined(CONFIG_BT_CSIP_SET_MEMBER)
	tester_set_bit(rp->data, BTP_SERVICE_ID_CSIP);
#endif /* CONFIG_BT_CSIP_SET_COORDINATOR || CONFIG_BT_CSIP_SET_MEMBER */
#if CAP_SUPPORTED
	tester_set_bit(rp->data, BTP_SERVICE_ID_CAP);
#endif /* CAP_SUPPORTED */
#if defined(CONFIG_BT_TBS)
	tester_set_bit(rp->data, BTP_SERVICE_ID_TBS);
#endif /*CONFIG_BT_TBS */
#if defined(CONFIG_BT_TMAP)
	tester_set_bit(rp->data, BTP_SERVICE_ID_TMAP);
#endif /* CONFIG_BT_TMAP */
#if defined(CONFIG_BT_OTS)
	tester_set_bit(rp->data, BTP_SERVICE_ID_OTS);
#endif /* CONFIG_BT_OTS */
#if defined(CONFIG_BT_PBP)
	tester_set_bit(rp->data, BTP_SERVICE_ID_PBP);
#endif /* CONFIG_BT_PBP */
#if defined(CONFIG_BT_CLASSIC)
	tester_set_bit(rp->data, BTP_SERVICE_ID_SDP);
#endif /* CONFIG_BT_CLASSIC */

	/* octet 4 */
#if defined(CONFIG_BT_RFCOMM)
	tester_set_bit(rp->data, BTP_SERVICE_ID_RFCOMM);
#endif /* CONFIG_BT_RFCOMM */
#if defined(CONFIG_BT_HFP_HF)
	tester_set_bit(rp->data, BTP_SERVICE_ID_HFP_HF);
#endif /* CONFIG_BT_HFP_HF */
#if defined(CONFIG_BT_HFP_AG)
	tester_set_bit(rp->data, BTP_SERVICE_ID_HFP_AG);
#endif /* CONFIG_BT_HFP_AG */
#if defined(CONFIG_BT_A2DP)
	tester_set_bit(rp->data, BTP_SERVICE_ID_A2DP);
#endif /* CONFIG_BT_A2DP */
#if defined(CONFIG_BT_AVDTP)
	tester_set_bit(rp->data, BTP_SERVICE_ID_AVDTP);
#endif /* CONFIG_BT_AVDTP */
#if defined(CONFIG_BT_AVRCP)
	tester_set_bit(rp->data, BTP_SERVICE_ID_AVRCP);
#endif /* CONFIG_BT_AVRCP */
#if defined(CONFIG_BT_AVCTP)
	tester_set_bit(rp->data, BTP_SERVICE_ID_AVCTP);
#endif /* CONFIG_BT_AVCTP */
#if defined(CONFIG_BT_RFCOMM)
	tester_set_bit(rp->data, BTP_SERVICE_ID_SPP);
#endif /* CONFIG_BT_RFCOMM */
#if defined(CONFIG_BT_HID_DEVICE)
	tester_set_bit(rp->data, BTP_SERVICE_ID_HID_DEVICE);
#endif /* CONFIG_BT_HID_DEVICE */
#if defined(CONFIG_BT_HID_HOST)
	tester_set_bit(rp->data, BTP_SERVICE_ID_HID_HOST);
#endif /* CONFIG_BT_HID_HOST */

	/* octet 5 */
#if defined(CONFIG_BT_PBAP)
	tester_set_bit(rp->data, BTP_SERVICE_ID_PBAP);
#endif /* CONFIG_BT_PBAP */
#if defined(CONFIG_BT_MAP)
	tester_set_bit(rp->data, BTP_SERVICE_ID_MAP);
#endif /* CONFIG_BT_MAP */
#if defined(CONFIG_BT_OPP)
	tester_set_bit(rp->data, BTP_SERVICE_ID_OPP);
#endif /* CONFIG_BT_OPP */

#if defined(CONFIG_BT_BIP)
	tester_set_bit(rp->data, BTP_SERVICE_ID_BIP);
#endif /* CONFIG_BT_BIP */
#if defined(CONFIG_BT_FTP)
	tester_set_bit(rp->data, BTP_SERVICE_ID_FTP);
#endif /* CONFIG_BT_FTP */

	*rsp_len = SUPPORTED_SERVICES_RSP_LEN;

	return BTP_STATUS_SUCCESS;
}

static uint8_t register_service(const void *cmd, uint16_t cmd_len,
				void *rsp, uint16_t *rsp_len)
{
	const struct btp_core_register_service_cmd *cp = cmd;
	uint8_t status;

	/* invalid service */
	if ((cp->id == BTP_SERVICE_ID_CORE) || (cp->id > BTP_SERVICE_ID_MAX)) {
		return BTP_STATUS_FAILED;
	}

	/* already registered */
	if (atomic_test_bit(registered_services, cp->id)) {
		return BTP_STATUS_FAILED;
	}

	switch (cp->id) {
	case BTP_SERVICE_ID_GAP:
		status = tester_init_gap();
		break;
	case BTP_SERVICE_ID_GATT:
		status = tester_init_gatt();
		break;
#if defined(CONFIG_BT_L2CAP_DYNAMIC_CHANNEL)
	case BTP_SERVICE_ID_L2CAP:
		status = tester_init_l2cap();
#endif /* CONFIG_BT_L2CAP_DYNAMIC_CHANNEL */
		break;
#if defined(CONFIG_BT_MESH)
	case BTP_SERVICE_ID_MESH:
		status = tester_init_mesh();
		break;
	case BTP_SERVICE_ID_MESH_MDL:
		status = tester_init_mmdl();
		break;
#endif /* CONFIG_BT_MESH */
#if defined(CONFIG_BT_VCP_VOL_REND) || defined(CONFIG_BT_VCP_VOL_CTLR)
	case BTP_SERVICE_ID_VCS:
		status = tester_init_vcs();
		break;
	case BTP_SERVICE_ID_VOCS:
		status = tester_init_vocs();
		break;
	case BTP_SERVICE_ID_AICS:
		status = tester_init_aics();
		break;
	case BTP_SERVICE_ID_VCP:
		status = tester_init_vcp();
		break;
#endif /* CONFIG_BT_VCP_VOL_REND */
#if defined(CONFIG_BT_IAS)
	case BTP_SERVICE_ID_IAS:
		status = tester_init_ias();
		break;
#endif /* CONFIG_BT_IAS */
#if defined(CONFIG_BT_PACS)
	case BTP_SERVICE_ID_PACS:
		status = tester_init_pacs();
		break;
#endif /* CONFIG_BT_PACS */
#if defined(CONFIG_BT_ASCS)
	case BTP_SERVICE_ID_ASCS:
		status = tester_init_ascs();
		break;
#endif /* CONFIG_BT_ASCS */
#if BAP_SUPPORTED
	case BTP_SERVICE_ID_BAP:
		status = tester_init_bap();
		break;
#endif /* BAP_SUPPORTED */
#if defined(CONFIG_BT_MICP_MIC_DEV) || defined(CONFIG_BT_MICP_MIC_CTLR)
	case BTP_SERVICE_ID_MICP:
		status = tester_init_micp();
		break;
#endif /* CONFIG_BT_MICP_MIC_DEV or CONFIG_BT_MICP_MIC_CTLR */
#if defined(CONFIG_BT_MICP_MIC_DEV)
	case BTP_SERVICE_ID_MICS:
		status = tester_init_mics();
		break;
#endif /* CONFIG_BT_MICP_MIC_DEV */
#if defined(CONFIG_BT_HAS)
	case BTP_SERVICE_ID_HAS:
		status = tester_init_has();
		break;
#endif /* CONFIG_BT_HAS */
#if defined(CONFIG_BT_CSIP_SET_MEMBER)
	case BTP_SERVICE_ID_CSIS:
		status = tester_init_csis();
		break;
#endif /* CONFIG_BT_CSIP_SET_MEMBER */
#if defined(CONFIG_BT_CSIP_SET_COORDINATOR)
	case BTP_SERVICE_ID_CSIP:
		status = tester_init_csip();
		break;
#endif /* CONFIG_BT_CSIP_SET_COORDINATOR */
#if defined(CONFIG_BT_TBS_CLIENT)
	case BTP_SERVICE_ID_CCP:
		status = tester_init_ccp();
		break;
#endif /* CONFIG_BT_TBS_CLIENT */
#if defined(CONFIG_BT_CAP_ACCEPTOR)
	case BTP_SERVICE_ID_CAS:
		status = tester_init_cas();
		break;
#endif /* CONFIG_BT_CAP_ACCEPTOR */
#if CAP_SUPPORTED
	case BTP_SERVICE_ID_CAP:
		status = tester_init_cap();
		break;
#endif /* CAP_SUPPORTED */
#if defined(CONFIG_BT_MCC)
	case BTP_SERVICE_ID_MCP:
		status = tester_init_mcp();
		break;
#endif /* CONFIG_BT_MCC */
#if defined(CONFIG_BT_MCS)
	case BTP_SERVICE_ID_GMCS:
		status = tester_init_mcs();
		break;
#endif /* CONFIG_BT_MCS */
#if defined(CONFIG_BT_HAS)
	case BTP_SERVICE_ID_HAP:
		status = tester_init_hap();
		break;
#endif /* CONFIG_BT_HAS */
#if defined(CONFIG_BT_TBS)
	case BTP_SERVICE_ID_TBS:
		status = tester_init_tbs();
		break;
#endif /* CONFIG_BT_TBS */
#if defined(CONFIG_BT_TMAP)
	case BTP_SERVICE_ID_TMAP:
		status = tester_init_tmap();
		break;
#endif /* CONFIG_BT_TMAP */
#if defined(CONFIG_BT_OTS)
	case BTP_SERVICE_ID_OTS:
		status = tester_init_ots();
		break;
#endif /* CONFIG_BT_OTS */
#if defined(CONFIG_BT_PBP)
	case BTP_SERVICE_ID_PBP:
		status = tester_init_pbp();
		break;
#endif /* CONFIG_BT_PBP */
#if defined(CONFIG_BT_CLASSIC)
	case BTP_SERVICE_ID_SDP:
		status = tester_init_sdp();
		break;
#endif /* CONFIG_BT_CLASSIC */
#if defined(CONFIG_BT_RFCOMM)
	case BTP_SERVICE_ID_RFCOMM:
		status = tester_init_rfcomm();
		break;
	case BTP_SERVICE_ID_SPP:
		status = tester_init_spp();
		break;
#endif /* CONFIG_BT_RFCOMM */
#if defined(CONFIG_BT_HFP_HF)
	case BTP_SERVICE_ID_HFP_HF:
		status = tester_init_hfp_hf();
		break;
#endif /* CONFIG_BT_HFP_HF */
#if defined(CONFIG_BT_HFP_AG)
	case BTP_SERVICE_ID_HFP_AG:
		status = tester_init_hfp_ag();
		break;
#endif /* CONFIG_BT_HFP_AG */
#if defined(CONFIG_BT_A2DP)
	case BTP_SERVICE_ID_A2DP:
		status = tester_init_a2dp();
		break;
#endif /* CONFIG_BT_A2DP */
#if defined(CONFIG_BT_AVDTP)
	case BTP_SERVICE_ID_AVDTP:
		status = tester_init_avdtp();
		break;
#endif /* CONFIG_BT_AVDTP */
#if defined(CONFIG_BT_AVRCP)
	case BTP_SERVICE_ID_AVRCP:
		status = tester_init_avrcp();
		break;
#endif /* CONFIG_BT_AVRCP */
#if defined(CONFIG_BT_AVCTP)
	case BTP_SERVICE_ID_AVCTP:
		status = tester_init_avctp();
		break;
#endif /* CONFIG_BT_AVCTP */
#if defined(CONFIG_BT_PBAP)
	case BTP_SERVICE_ID_PBAP:
		status = tester_init_pbap();
		break;
#endif /* CONFIG_BT_PBAP */
#if defined(CONFIG_BT_MAP)
	case BTP_SERVICE_ID_MAP:
		status = tester_init_map();
		break;
#endif /* CONFIG_BT_MAP */
#if defined(CONFIG_BT_HID_DEVICE)
	case BTP_SERVICE_ID_HID_DEVICE:
		status = tester_init_hid_device();
		break;
#endif /* CONFIG_BT_HID_DEVICE */
#if defined(CONFIG_BT_HID_HOST)
	case BTP_SERVICE_ID_HID_HOST:
		status = tester_init_hid_host();
		break;
#endif /* CONFIG_BT_HID_HOST */
#if defined(CONFIG_BT_OPP)
	case BTP_SERVICE_ID_OPP:
		status = tester_init_opp();
		break;
#endif /* CONFIG_BT_OPP */
#if defined(CONFIG_BT_BIP)
	case BTP_SERVICE_ID_BIP:
		status = tester_init_bip();
		break;
#endif /* CONFIG_BT_BIP */
#if defined(CONFIG_BT_FTP)
	case BTP_SERVICE_ID_FTP:
		status = tester_init_ftp();
		break;
#endif /* CONFIG_BT_FTP */
	default:
		LOG_WRN("unknown id: 0x%02x", cp->id);
		status = BTP_STATUS_FAILED;
		break;
	}

	if (status == BTP_STATUS_SUCCESS) {
		atomic_set_bit(registered_services, cp->id);
	}

	return status;
}

static uint8_t unregister_service(const void *cmd, uint16_t cmd_len,
				  void *rsp, uint16_t *rsp_len)
{
	const struct btp_core_unregister_service_cmd *cp = cmd;
	uint8_t status;

	/* invalid service ID */
	if ((cp->id == BTP_SERVICE_ID_CORE) || (cp->id > BTP_SERVICE_ID_MAX)) {
		return BTP_STATUS_FAILED;
	}

	/* not registered */
	if (!atomic_test_bit(registered_services, cp->id)) {
		return BTP_STATUS_FAILED;
	}

	switch (cp->id) {
	case BTP_SERVICE_ID_GAP:
		status = tester_unregister_gap();
		break;
	case BTP_SERVICE_ID_GATT:
		status = tester_unregister_gatt();
		break;
#if defined(CONFIG_BT_L2CAP_DYNAMIC_CHANNEL)
	case BTP_SERVICE_ID_L2CAP:
		status = tester_unregister_l2cap();
		break;
#endif /* CONFIG_BT_L2CAP_DYNAMIC_CHANNEL */
#if defined(CONFIG_BT_MESH)
	case BTP_SERVICE_ID_MESH:
		status = tester_unregister_mesh();
		break;
	case BTP_SERVICE_ID_MESH_MDL:
		status = tester_unregister_mmdl();
		break;
#endif /* CONFIG_BT_MESH */
#if defined(CONFIG_BT_VCP_VOL_REND)
	case BTP_SERVICE_ID_VCS:
		status = tester_unregister_vcs();
		break;
	case BTP_SERVICE_ID_AICS:
		status = tester_unregister_aics();
		break;
	case BTP_SERVICE_ID_VOCS:
		status = tester_unregister_vocs();
		break;
#endif /* CONFIG_BT_VCP_VOL_REND */
#if defined(CONFIG_BT_IAS)
	case BTP_SERVICE_ID_IAS:
		status = tester_unregister_ias();
		break;
#endif /* CONFIG_BT_IAS */
#if defined(CONFIG_BT_PACS)
	case BTP_SERVICE_ID_PACS:
		status = tester_unregister_pacs();
		break;
#endif /* CONFIG_BT_PACS */
#if defined(CONFIG_BT_ASCS)
	case BTP_SERVICE_ID_ASCS:
		status = tester_unregister_ascs();
		break;
#endif /* CONFIG_BT_ASCS */
#if BAP_SUPPORTED
	case BTP_SERVICE_ID_BAP:
		status = tester_unregister_bap();
		break;
#endif /* BAP_SUPPORTED */
#if defined(CONFIG_BT_MICP_MIC_DEV) || defined(CONFIG_BT_MICP_MIC_CTLR)
	case BTP_SERVICE_ID_MICP:
		status = tester_unregister_micp();
		break;
#endif /* CONFIG_BT_MICP_MIC_DEV or CONFIG_BT_MICP_MIC_CTLR */
#if defined(CONFIG_BT_MICP_MIC_DEV)
	case BTP_SERVICE_ID_MICS:
		status = tester_unregister_mics();
		break;
#endif /* CONFIG_BT_MICP_MIC_DEV  */
#if defined(CONFIG_BT_HAS)
	case BTP_SERVICE_ID_HAS:
		status = tester_unregister_has();
		break;
#endif /* CONFIG_BT_HAS */
#if defined(CONFIG_BT_CSIP_SET_MEMBER)
	case BTP_SERVICE_ID_CSIS:
		status = tester_unregister_csis();
		break;
#endif /* CONFIG_BT_CSIP_SET_MEMBER */
#if defined(CONFIG_BT_CSIP_SET_COORDINATOR)
	case BTP_SERVICE_ID_CSIP:
		status = tester_unregister_csip();
		break;
#endif /* CONFIG_BT_CSIP_SET_COORDINATOR */
#if defined(CONFIG_BT_TBS_CLIENT)
	case BTP_SERVICE_ID_CCP:
		status = tester_unregister_ccp();
		break;
#endif /* CONFIG_BT_TBS_CLIENT */
#if defined(CONFIG_BT_CAP_ACCEPTOR)
	case BTP_SERVICE_ID_CAS:
		status = tester_unregister_cas();
		break;
#endif /* CONFIG_BT_CAP_ACCEPTOR */
#if CAP_SUPPORTED
	case BTP_SERVICE_ID_CAP:
		status = tester_unregister_cap();
		break;
#endif /* CAP_SUPPORTED */
#if defined(CONFIG_BT_MCC)
	case BTP_SERVICE_ID_MCP:
		status = tester_unregister_mcp();
		break;
#endif /* CONFIG_BT_MCC */
#if defined(CONFIG_BT_MCS)
	case BTP_SERVICE_ID_GMCS:
		status = tester_unregister_mcs();
		break;
#endif /* CONFIG_BT_MCS */
#if defined(CONFIG_BT_HAS)
	case BTP_SERVICE_ID_HAP:
		status = tester_unregister_hap();
		break;
#endif /* CONFIG_BT_HAS */
#if defined(CONFIG_BT_TBS)
	case BTP_SERVICE_ID_TBS:
		status = tester_unregister_tbs();
		break;
#endif /* CONFIG_BT_TBS */
#if defined(CONFIG_BT_TMAP)
	case BTP_SERVICE_ID_TMAP:
		status = tester_unregister_tmap();
		break;
#endif /* CONFIG_BT_TMAP */
#if defined(CONFIG_BT_OTS)
	case BTP_SERVICE_ID_OTS:
		status = tester_unregister_ots();
		break;
#endif /* CONFIG_BT_OTS */
#if defined(CONFIG_BT_PBP)
	case BTP_SERVICE_ID_PBP:
		status = tester_unregister_pbp();
		break;
#endif /* CONFIG_BT_PBP */
#if defined(CONFIG_BT_CLASSIC)
	case BTP_SERVICE_ID_SDP:
		status = tester_unregister_sdp();
		break;
#endif /* CONFIG_BT_CLASSIC */
#if defined(CONFIG_BT_RFCOMM)
	case BTP_SERVICE_ID_RFCOMM:
		status = tester_unregister_rfcomm();
		break;
	case BTP_SERVICE_ID_SPP:
		status = tester_unregister_spp();
		break;
#endif /* CONFIG_BT_RFCOMM */
#if defined(CONFIG_BT_HFP_HF)
	case BTP_SERVICE_ID_HFP_HF:
		status = tester_unregister_hfp_hf();
		break;
#endif /* CONFIG_BT_HFP_HF*/
#if defined(CONFIG_BT_HFP_AG)
	case BTP_SERVICE_ID_HFP_AG:
		status = tester_unregister_hfp_ag();
		break;
#endif /* CONFIG_BT_HFP_AG */
#if defined(CONFIG_BT_A2DP)
	case BTP_SERVICE_ID_A2DP:
		status = tester_unregister_a2dp();
		break;
#endif /* CONFIG_BT_A2DP */
#if defined(CONFIG_BT_AVDTP)
	case BTP_SERVICE_ID_AVDTP:
		status = tester_unregister_avdtp();
		break;
#endif /* CONFIG_BT_AVDTP */
#if defined(CONFIG_BT_AVRCP)
	case BTP_SERVICE_ID_AVRCP:
		status = tester_unregister_avrcp();
		break;
#endif /* CONFIG_BT_AVRCP */
#if defined(CONFIG_BT_AVCTP)
	case BTP_SERVICE_ID_AVCTP:
		status = tester_unregister_avctp();
		break;
#endif /* CONFIG_BT_AVCTP */
#if defined(CONFIG_BT_PBAP)
	case BTP_SERVICE_ID_PBAP:
		status = tester_unregister_pbap();
		break;
#endif /* CONFIG_BT_PBAP */
#if defined(CONFIG_BT_MAP)
	case BTP_SERVICE_ID_MAP:
		status = tester_unregister_map();
		break;
#endif /* CONFIG_BT_MAP */

#if defined(CONFIG_BT_HID_DEVICE)
	case BTP_SERVICE_ID_HID_DEVICE:
		status = tester_unregister_hid_device();
		break;
#endif /* CONFIG_BT_HID_DEVICE */
#if defined(CONFIG_BT_HID_HOST)
	case BTP_SERVICE_ID_HID_HOST:
		status = tester_unregister_hid_host();
		break;
#endif /* CONFIG_BT_HID_HOST */
#if defined(CONFIG_BT_OPP)
	case BTP_SERVICE_ID_OPP:
		status = tester_unregister_opp();
		break;
#endif /* CONFIG_BT_OPP */
#if defined(CONFIG_BT_BIP)
	case BTP_SERVICE_ID_BIP:
		status = tester_unregister_bip();
		break;
#endif /* CONFIG_BT_BIP */
#if defined(CONFIG_BT_FTP)
	case BTP_SERVICE_ID_FTP:
		status = tester_unregister_ftp();
		break;
#endif /* CONFIG_BT_FTP */
	default:
		LOG_WRN("unknown id: 0x%x", cp->id);
		status = BTP_STATUS_FAILED;
		break;
	}

	if (status == BTP_STATUS_SUCCESS) {
		atomic_clear_bit(registered_services, cp->id);
	}

	return BTP_STATUS_FAILED;
}

static const struct btp_handler handlers[] = {
	{
		.opcode = BTP_CORE_READ_SUPPORTED_COMMANDS,
		.index = BTP_INDEX_NONE,
		.expect_len = 0,
		.func = supported_commands,
	},
	{
		.opcode = BTP_CORE_READ_SUPPORTED_SERVICES,
		.index = BTP_INDEX_NONE,
		.expect_len = 0,
		.func = supported_services,
	},
	{
		.opcode = BTP_CORE_REGISTER_SERVICE,
		.index = BTP_INDEX_NONE,
		.expect_len = sizeof(struct btp_core_register_service_cmd),
		.func = register_service,
	},
	{
		.opcode = BTP_CORE_UNREGISTER_SERVICE,
		.index = BTP_INDEX_NONE,
		.expect_len = sizeof(struct btp_core_unregister_service_cmd),
		.func = unregister_service,
	},
};

void tester_init_core(void)
{
	tester_register_command_handlers(BTP_SERVICE_ID_CORE, handlers,
					 ARRAY_SIZE(handlers));
	atomic_set_bit(registered_services, BTP_SERVICE_ID_CORE);
}
```
