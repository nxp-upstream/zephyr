## CMakeLists.txt
```
# SPDX-FileCopyrightText: Copyright 2026 NXP
# SPDX-License-Identifier: Apache-2.0

cmake_minimum_required(VERSION 3.20.0)
find_package(Zephyr REQUIRED HINTS $ENV{ZEPHYR_BASE})
project(nxp_vref_pm)

target_include_directories(app PRIVATE
  "${CMAKE_CURRENT_SOURCE_DIR}/include"
  "${ZEPHYR_BASE}/drivers/regulator"
)
target_sources(app PRIVATE
  src/main.c
  src/mcxa.c
  src/factory_trim.c
)
```

## prj.conf
```kconfig
# SPDX-FileCopyrightText: Copyright 2026 NXP
# SPDX-License-Identifier: Apache-2.0

CONFIG_ZTEST=y
CONFIG_REGULATOR=y
CONFIG_REGULATOR_THREAD_SAFE_REFCNT=y
CONFIG_PM_DEVICE=y
CONFIG_PM_DEVICE_RUNTIME=y
CONFIG_LOG=y
CONFIG_LOG_MODE_IMMEDIATE=y
CONFIG_IRQ_OFFLOAD=y
```

## src/main.c
```c
/*
 * SPDX-FileCopyrightText: Copyright 2026 NXP
 * SPDX-License-Identifier: Apache-2.0
 */

#include <zephyr/pm/device_runtime.h>
#include <zephyr/irq_offload.h>
#include <zephyr/ztest.h>

/* Exercise the production implementation with RAM registers and no DT instances. */
#include "regulator_nxp_vref.c"

#define OUTPUT_BITS (VREF_CSR_HCBGEN_MASK | VREF_CSR_LPBGEN_MASK | \
		     VREF_CSR_LPBG_BUF_EN_MASK | VREF_CSR_BUF21EN_MASK)
#define CONFIG_BITS (VREF_CSR_ICOMPEN_MASK | VREF_CSR_CHOPEN_MASK | VREF_CSR_REGEN_MASK)

#define TEST_DEVICE(n)										\
	static VREF_Type registers_##n = {.CSR = VREF_CSR_VREFST_MASK};		\
	static struct regulator_nxp_vref_data data_##n;				\
	static const struct regulator_nxp_vref_config config_##n = {		\
		.common = {								\
			.min_uv = INT32_MIN, .max_uv = INT32_MAX,			\
			.init_uv = INT32_MIN, .init_ua = INT32_MIN,			\
			.initial_mode = NXP_VREF_MODE_HIGH_POWER,			\
			.flags = REGULATOR_ACTIVE_DISCHARGE_SET_BITS(		\
				REGULATOR_ACTIVE_DISCHARGE_DEFAULT),		\
		},									\
		.base = &registers_##n,						\
		.bg_start_time = 1, .buf_start_delay = 1,				\
		.current_compensation_en = true, .chop_oscillator_en = true,	\
		.internal_voltage_regulator_en = true,				\
	};										\
	PM_DEVICE_DEFINE(vref_pm_##n, regulator_nxp_vref_pm_action);		\
	DEVICE_DEFINE(vref_##n, "vref_" #n, regulator_nxp_vref_init,		\
		      PM_DEVICE_GET(vref_pm_##n), &data_##n, &config_##n,		\
		      POST_KERNEL, 80, &api)

TEST_DEVICE(0);
TEST_DEVICE(1);

static const struct device *const dev = DEVICE_GET(vref_0);
static const struct device *const other = DEVICE_GET(vref_1);

static void assert_state(enum pm_device_state expected)
{
	enum pm_device_state state;

	zassert_ok(pm_device_state_get(dev, &state));
	zassert_equal(state, expected);
}

static void power_cycle(void)
{
	zassert_ok(pm_device_action_run(dev, PM_DEVICE_ACTION_SUSPEND));
	zassert_equal(registers_0.CSR & OUTPUT_BITS, 0U, "SUSPEND left the output enabled");
	zassert_ok(pm_device_action_run(dev, PM_DEVICE_ACTION_TURN_OFF));
	registers_0.CSR = VREF_CSR_VREFST_MASK;
	registers_0.UTRIM = 0x2003U;
	zassert_ok(pm_device_action_run(dev, PM_DEVICE_ACTION_TURN_ON));
	zassert_equal(registers_0.CSR & OUTPUT_BITS, 0U, "TURN_ON enabled an output");
	zassert_equal(registers_0.CSR & CONFIG_BITS, CONFIG_BITS);
	zassert_ok(pm_device_action_run(dev, PM_DEVICE_ACTION_RESUME));
}

static void before(void *fixture)
{
	ARG_UNUSED(fixture);

	zassert_true(device_is_ready(dev));
	zassert_true(device_is_ready(other));
	registers_0.CSR |= VREF_CSR_VREFST_MASK;
	zassert_ok(pm_device_runtime_disable(dev));

	enum pm_device_state state;

	zassert_ok(pm_device_state_get(dev, &state));
	if (state == PM_DEVICE_STATE_OFF) {
		zassert_ok(pm_device_action_run(dev, PM_DEVICE_ACTION_TURN_ON));
		state = PM_DEVICE_STATE_SUSPENDED;
	}
	if (state == PM_DEVICE_STATE_SUSPENDED) {
		zassert_ok(pm_device_action_run(dev, PM_DEVICE_ACTION_RESUME));
	}
	while (regulator_is_enabled(dev)) {
		zassert_ok(regulator_disable(dev));
	}
	zassert_ok(regulator_set_mode(dev, NXP_VREF_MODE_HIGH_POWER));
}

ZTEST(vref_pm, test_held_output_and_mode_survive_power_loss)
{
	zassert_ok(regulator_set_voltage(dev, 1600000, 1600000));
	zassert_ok(regulator_set_mode(dev, NXP_VREF_MODE_LOW_POWER));
	zassert_ok(regulator_enable(dev));
	zassert_ok(regulator_enable(dev));

	for (int i = 0; i < 2; i++) {
		power_cycle();
		zassert_equal(registers_0.CSR & OUTPUT_BITS, OUTPUT_BITS);
		zassert_equal(registers_0.CSR & VREF_CSR_HI_PWR_LV_MASK, 0U);
		zassert_equal(registers_0.UTRIM, 0x2006U, "trim or unrelated bits lost");
	}
	zassert_ok(regulator_disable(dev));
	zassert_equal(registers_0.CSR & OUTPUT_BITS, OUTPUT_BITS);
	zassert_ok(regulator_disable(dev));
	zassert_equal(registers_0.CSR & OUTPUT_BITS, 0U);
}

ZTEST(vref_pm, test_disabled_output_is_not_replayed)
{
	power_cycle();
	zassert_false(regulator_is_enabled(dev));
	zassert_equal(registers_0.CSR & OUTPUT_BITS, 0U);
	zassert_ok(regulator_enable(dev));
	zassert_equal(registers_0.CSR & OUTPUT_BITS, OUTPUT_BITS);
	zassert_not_equal(registers_0.CSR & VREF_CSR_HI_PWR_LV_MASK, 0U);
	zassert_ok(regulator_disable(dev));
}

ZTEST(vref_pm, test_runtime_reference_follows_regulator_lifetime)
{
	zassert_ok(pm_device_runtime_enable(dev));
	assert_state(PM_DEVICE_STATE_SUSPENDED);
	zassert_ok(regulator_enable(dev));
	zassert_ok(regulator_enable(dev));
	assert_state(PM_DEVICE_STATE_ACTIVE);
	zassert_equal(pm_device_runtime_usage(dev), 1);
	zassert_ok(regulator_disable(dev));
	assert_state(PM_DEVICE_STATE_ACTIVE);
	zassert_equal(registers_0.CSR & OUTPUT_BITS, OUTPUT_BITS);
	zassert_ok(regulator_disable(dev));
	assert_state(PM_DEVICE_STATE_SUSPENDED);
	zassert_equal(pm_device_runtime_usage(dev), 0);
	zassert_equal(registers_0.CSR & OUTPUT_BITS, 0U);
}

ZTEST(vref_pm, test_runtime_configuration_does_not_enable_output)
{
	int32_t voltage;

	zassert_ok(pm_device_runtime_enable(dev));
	zassert_ok(regulator_set_mode(dev, NXP_VREF_MODE_LOW_POWER));
	zassert_ok(regulator_set_voltage(dev, 1700000, 1700000));
	zassert_ok(regulator_get_voltage(dev, &voltage));
	zassert_equal(voltage, 1700000);
	assert_state(PM_DEVICE_STATE_SUSPENDED);
	zassert_equal(pm_device_runtime_usage(dev), 0);
	zassert_equal(registers_0.CSR & OUTPUT_BITS, 0U);
}

ZTEST(vref_pm, test_manual_suspend_rejects_register_access)
{
	zassert_ok(pm_device_action_run(dev, PM_DEVICE_ACTION_SUSPEND));
	zassert_equal(regulator_set_mode(dev, UINT8_MAX), -EINVAL);
	zassert_equal(regulator_set_voltage(dev, 1, 1), -EINVAL);
	zassert_equal(regulator_set_mode(dev, NXP_VREF_MODE_LOW_POWER), -EBUSY);
	zassert_equal(regulator_enable(dev), -EBUSY);
	zassert_false(regulator_is_enabled(dev));
	zassert_ok(pm_device_action_run(dev, PM_DEVICE_ACTION_RESUME));
}

ZTEST(vref_pm, test_instances_have_independent_replay_state)
{
	uint32_t other_csr = registers_1.CSR;
	uint32_t other_trim = registers_1.UTRIM;

	zassert_ok(regulator_set_voltage(dev, 1500000, 1500000));
	zassert_ok(regulator_enable(dev));
	power_cycle();
	zassert_equal(registers_1.CSR, other_csr);
	zassert_equal(registers_1.UTRIM, other_trim);
	zassert_false(regulator_is_enabled(other));
	zassert_ok(regulator_disable(dev));
}

ZTEST(vref_pm, test_enable_timeout_releases_runtime_reference)
{
	zassert_ok(pm_device_runtime_enable(dev));
	registers_0.CSR &= ~VREF_CSR_VREFST_MASK;
	zassert_equal(regulator_enable(dev), -ETIMEDOUT);
	zassert_false(regulator_is_enabled(dev));
	zassert_equal(registers_0.CSR & OUTPUT_BITS, 0U);
	zassert_equal(pm_device_runtime_usage(dev), 0);
	assert_state(PM_DEVICE_STATE_SUSPENDED);
	registers_0.CSR |= VREF_CSR_VREFST_MASK;
	zassert_ok(regulator_enable(dev));
	zassert_ok(regulator_disable(dev));
}

ZTEST(vref_pm, test_voltage_window_and_invalid_index)
{
	int32_t voltage;

	zassert_ok(regulator_set_voltage(dev, 1650000, 1750000));
	zassert_ok(regulator_get_voltage(dev, &voltage));
	zassert_equal(voltage, 1700000);
	zassert_equal(regulator_set_voltage(dev, 1750000, 1650000), -EINVAL);
	zassert_equal(regulator_set_voltage(dev, 1600001, 1699999), -EINVAL);
	zassert_equal(regulator_list_voltage(dev, UINT_MAX, &voltage), -EINVAL);
	zassert_ok(regulator_get_voltage(dev, &voltage));
	zassert_equal(voltage, 1700000);
}

static void resume_from_isr(const void *arg)
{
	int *result = (int *)arg;

	*result = pm_device_action_run(dev, PM_DEVICE_ACTION_RESUME);
}

ZTEST(vref_pm, test_resume_from_interrupt_context)
{
	int result = -1;

	zassert_ok(regulator_enable(dev));
	zassert_ok(pm_device_action_run(dev, PM_DEVICE_ACTION_SUSPEND));
	irq_offload(resume_from_isr, &result);
	zassert_ok(result);
	zassert_equal(registers_0.CSR & OUTPUT_BITS, OUTPUT_BITS);
	zassert_ok(regulator_disable(dev));
}

ZTEST_SUITE(vref_pm, NULL, NULL, before, NULL, NULL);
```

## include/fsl_device_registers.h
```c
/*
 * SPDX-FileCopyrightText: Copyright 2026 NXP
 * SPDX-License-Identifier: Apache-2.0
 */

#ifndef TEST_FSL_DEVICE_REGISTERS_H_
#define TEST_FSL_DEVICE_REGISTERS_H_

#include <stdint.h>
#include <zephyr/sys/util.h>

typedef struct {
	volatile uint32_t CSR;
	volatile uint32_t UTRIM;
} VREF_Type;

typedef struct {
	volatile uint32_t ACTIVE_CFG1;
} SPC_Type;

#define SPC_ACTIVE_CFG1_SOC_CNTRL(value) (value)

#define VREF_CSR_HCBGEN_MASK BIT(0)
#if defined(FSL_FEATURE_VREF_HAS_LPBGEN) && !FSL_FEATURE_VREF_HAS_LPBGEN
#define VREF_CSR_IBIAS_EN_MASK BIT(1)
#else
#define VREF_CSR_LPBGEN_MASK BIT(1)
#endif
#if !defined(FSL_FEATURE_VREF_HAS_LOWPOWER_BUFFER) || FSL_FEATURE_VREF_HAS_LOWPOWER_BUFFER
#define VREF_CSR_LPBG_BUF_EN_MASK BIT(2)
#endif
#define VREF_CSR_CHOPEN_MASK BIT(3)
#define VREF_CSR_ICOMPEN_MASK BIT(4)
#define VREF_CSR_REGEN_MASK BIT(5)
#define VREF_CSR_HI_PWR_LV_MASK BIT(11)
#define VREF_CSR_BUF21EN_MASK BIT(16)
#define VREF_CSR_VREFST_MASK BIT(31)
#define VREF_UTRIM_TRIM2V1_MASK 0xFU
#define VREF_UTRIM_TRIM2V1_SHIFT 0U
#define VREF_UTRIM_VREFTRIM_MASK 0x3F00U
#define VREF_UTRIM_VREFTRIM_SHIFT 8U

#endif
```

## src/factory_trim.c
```c
/*
 * SPDX-FileCopyrightText: Copyright 2026 NXP
 * SPDX-License-Identifier: Apache-2.0
 */

#include <zephyr/pm/device_runtime.h>
#include <zephyr/ztest.h>

#define FSL_FEATURE_VREF_HAS_TRIM2V1 0
#define FSL_FEATURE_VREF_HAS_LOWPOWER_BUFFER 0
#define nxp_vref nxp_vref_factory
#include "regulator_nxp_vref.c"

static VREF_Type regs = {.CSR = VREF_CSR_VREFST_MASK, .UTRIM = 0x1100U};
static struct regulator_nxp_vref_data data;
static const struct regulator_nxp_vref_config config = {
	.common = {
		.min_uv = INT32_MIN, .max_uv = INT32_MAX,
		.init_uv = INT32_MIN, .init_ua = INT32_MIN,
		.initial_mode = NXP_VREF_MODE_HIGH_POWER,
		.flags = REGULATOR_ACTIVE_DISCHARGE_SET_BITS(REGULATOR_ACTIVE_DISCHARGE_DEFAULT),
	},
	.base = &regs,
	.bg_start_time = 1,
	.buf_start_delay = 1,
};

PM_DEVICE_DEFINE(vref_factory_pm, regulator_nxp_vref_pm_action);
DEVICE_DEFINE(vref_factory, "vref_factory", regulator_nxp_vref_init,
	      PM_DEVICE_GET(vref_factory_pm), &data, &config, POST_KERNEL, 80, &api);

ZTEST(vref_factory, test_factory_trim_and_consumer_override)
{
	const struct device *dev = DEVICE_GET(vref_factory);
	int32_t voltage;

	zassert_true(device_is_ready(dev));
	zassert_equal(regs.UTRIM, 0x1100U, "init overwrote factory trim");
	zassert_ok(pm_device_runtime_disable(dev));
	zassert_ok(pm_device_action_run(dev, PM_DEVICE_ACTION_SUSPEND));
	zassert_ok(pm_device_action_run(dev, PM_DEVICE_ACTION_TURN_OFF));
	regs.UTRIM = 0x1200U;
	zassert_ok(pm_device_action_run(dev, PM_DEVICE_ACTION_TURN_ON));
	zassert_equal(regs.UTRIM, 0x1200U, "TURN_ON overwrote reset-loaded trim");
	zassert_ok(pm_device_action_run(dev, PM_DEVICE_ACTION_RESUME));

	zassert_ok(regulator_list_voltage(dev, 32U, &voltage));
	zassert_ok(regulator_set_voltage(dev, voltage, voltage));
	zassert_ok(pm_device_action_run(dev, PM_DEVICE_ACTION_SUSPEND));
	zassert_ok(pm_device_action_run(dev, PM_DEVICE_ACTION_TURN_OFF));
	regs.UTRIM = 0x1203U;
	zassert_ok(pm_device_action_run(dev, PM_DEVICE_ACTION_TURN_ON));
	zassert_equal(regs.UTRIM, 0x2003U, "consumer trim or unrelated bits lost");
	zassert_ok(pm_device_action_run(dev, PM_DEVICE_ACTION_RESUME));
	zassert_ok(pm_device_runtime_enable(dev));
}

ZTEST_SUITE(vref_factory, NULL, NULL, NULL, NULL, NULL);
```

## src/mcxa.c
```c
/*
 * SPDX-FileCopyrightText: Copyright 2026 NXP
 * SPDX-License-Identifier: Apache-2.0
 */

#include <zephyr/pm/device_runtime.h>
#include <zephyr/ztest.h>

#define FSL_FEATURE_VREF_HAS_LPBGEN 0
#define FSL_FEATURE_VREF_HAS_LOWPOWER_BUFFER 0
#define FSL_FEATURE_VREF_SUPPORT_2V5 1
#define FSL_FEATURE_SOC_SPC_COUNT 1
#define nxp_vref nxp_vref_mcxa
#include "regulator_nxp_vref.c"

static VREF_Type regs = {.CSR = VREF_CSR_VREFST_MASK};
static SPC_Type spc = {.ACTIVE_CFG1 = BIT(7)};
static struct regulator_nxp_vref_data data;
static const struct regulator_nxp_vref_config config = {
	.common = {
		.min_uv = INT32_MIN, .max_uv = INT32_MAX,
		.init_uv = INT32_MIN, .init_ua = INT32_MIN,
		.initial_mode = NXP_VREF_MODE_HIGH_POWER,
		.flags = REGULATOR_ACTIVE_DISCHARGE_SET_BITS(REGULATOR_ACTIVE_DISCHARGE_DEFAULT),
	},
	.base = &regs,
	.bg_start_time = 1,
	.buf_start_delay = 1,
	.spc = &spc,
};

PM_DEVICE_DEFINE(vref_mcxa_pm, regulator_nxp_vref_pm_action);
DEVICE_DEFINE(vref_mcxa, "vref_mcxa", regulator_nxp_vref_init, PM_DEVICE_GET(vref_mcxa_pm),
	      &data, &config, POST_KERNEL, 80, &api);

ZTEST(vref_mcxa, test_discrete_voltage_selections)
{
	const struct device *dev = DEVICE_GET(vref_mcxa);
	const int32_t voltages[] = {1000000, 1250000, 1500000, 1800000, 2048000, 2500000};
	int32_t value;

	zassert_true(device_is_ready(dev));
	zassert_equal(spc.ACTIVE_CFG1, BIT(7) | BIT(0));
	zassert_equal(regulator_count_voltages(dev), ARRAY_SIZE(voltages));
	for (unsigned int i = 0U; i < ARRAY_SIZE(voltages); i++) {
		zassert_ok(regulator_list_voltage(dev, i, &value));
		zassert_equal(value, voltages[i]);
		zassert_ok(regulator_set_voltage(dev, value, value));
		zassert_equal(regs.UTRIM & VREF_UTRIM_TRIM2V1_MASK, i);
		zassert_ok(regulator_get_voltage(dev, &value));
		zassert_equal(value, voltages[i]);
	}
	zassert_ok(regulator_set_voltage(dev, 1700000, 2100000));
	zassert_ok(regulator_get_voltage(dev, &value));
	zassert_equal(value, 1800000);
	zassert_equal(regulator_set_voltage(dev, 1600000, 1700000), -EINVAL);
	zassert_equal(regulator_list_voltage(dev, ARRAY_SIZE(voltages), &value), -EINVAL);
	zassert_equal(pm_device_runtime_usage(dev), 0);
}

ZTEST(vref_mcxa, test_bias_and_cleared_configuration_replay)
{
	const struct device *dev = DEVICE_GET(vref_mcxa);

	zassert_ok(pm_device_runtime_disable(dev));
	zassert_ok(regulator_set_mode(dev, NXP_VREF_MODE_HIGH_POWER));
	zassert_ok(regulator_enable(dev));
	zassert_equal(regs.CSR & NXP_VREF_ENABLE_MASK, NXP_VREF_ENABLE_MASK);
	zassert_ok(pm_device_action_run(dev, PM_DEVICE_ACTION_SUSPEND));
	zassert_equal(regs.CSR & NXP_VREF_ENABLE_MASK, 0U);
	zassert_ok(pm_device_action_run(dev, PM_DEVICE_ACTION_TURN_OFF));
	regs.CSR = VREF_CSR_VREFST_MASK | NXP_VREF_CONFIG_MASK;
	spc.ACTIVE_CFG1 = BIT(7);
	zassert_ok(pm_device_action_run(dev, PM_DEVICE_ACTION_TURN_ON));
	zassert_equal(spc.ACTIVE_CFG1, BIT(7) | BIT(0), "SPC supply was not restored");
	zassert_equal(regs.CSR & NXP_VREF_CONFIG_MASK, 0U, "false DT options were not restored");
	zassert_equal(regs.CSR & NXP_VREF_ENABLE_MASK, 0U);
	zassert_ok(pm_device_action_run(dev, PM_DEVICE_ACTION_RESUME));
	zassert_equal(regs.CSR & NXP_VREF_ENABLE_MASK, NXP_VREF_ENABLE_MASK);
	zassert_ok(regulator_disable(dev));
	zassert_equal(regs.CSR & NXP_VREF_ENABLE_MASK, 0U);
	zassert_ok(pm_device_runtime_enable(dev));
}

ZTEST_SUITE(vref_mcxa, NULL, NULL, NULL, NULL, NULL);
```
