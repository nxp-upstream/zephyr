## prj.conf
```kconfig
CONFIG_ZTEST=y
CONFIG_CLOCK_MGMT=y
```

## src/test_clock_mgmt_hw.c
```c
/*
 * Copyright 2024 NXP
 *
 * SPDX-License-Identifier: Apache-2.0
 */
#include <zephyr/ztest.h>
#include <zephyr/drivers/clock_mgmt.h>
#include <zephyr/logging/log.h>
LOG_MODULE_REGISTER(test);
```
