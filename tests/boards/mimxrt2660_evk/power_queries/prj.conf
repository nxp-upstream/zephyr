## CMakeLists.txt
```
# SPDX-FileCopyrightText: Copyright 2026 NXP
# SPDX-License-Identifier: Apache-2.0

cmake_minimum_required(VERSION 3.28.0)
find_package(Zephyr REQUIRED HINTS $ENV{ZEPHYR_BASE})
project(power_queries)

if(CONFIG_PM)
  target_sources(app PRIVATE
    src/memory.c
    src/power_domains.c
    src/power_states.c
    src/regulators.c
    src/stay_awake.c
  )
  target_sources_ifdef(CONFIG_CPU_FREQ app PRIVATE src/run_modes.c)
else()
  # With CONFIG_PM the kernel arms vbat_lptmr as the system timer's low-power companion.
  target_sources(app PRIVATE src/vbat_lptmr_alarm.c)
endif()
```

## prj.conf
```kconfig
# SPDX-FileCopyrightText: Copyright 2026 NXP
# SPDX-License-Identifier: Apache-2.0

CONFIG_ZTEST=y
CONFIG_PM=y
CONFIG_PM_DEVICE=y
CONFIG_PM_DEVICE_RUNTIME=y
CONFIG_POWER_DOMAIN=y
CONFIG_REGULATOR=y
```

## src/memory.c
```c
/*
 * SPDX-FileCopyrightText: Copyright 2026 NXP
 *
 * SPDX-License-Identifier: Apache-2.0
 */

#include <stdint.h>

#include <zephyr/devicetree.h>
#include <zephyr/sys/util.h>
#include <zephyr/toolchain.h>
#include <zephyr/ztest.h>

#include <fsl_memcon.h>
#include <fsl_power.h>
#include <soc_memory.h>

#include "stay_awake.h"

/*
 * SRAMCTL_1 Mem 0, the first 144 KB of sram1. The image places nothing there: it
 * runs from the XIP flash with its RAM in the PSRAM and the TCMs. Its MEMCON slice
 * is the COMPUTE one, which stays powered while the NPU, COMM and MEDIA domains
 * are off; the slices inside those domains must not be touched while they are.
 */
#define UNUSED_BLOCK kPOWER_Mem_ComputeSram6

BUILD_ASSERT(!DT_SAME_NODE(DT_CHOSEN(zephyr_sram), DT_NODELABEL(sram1)),
	     "The memory block under test is in the system RAM");

/* power_memory_t encodes (slice << 8) | block. */
#define POWER_MEMORY_SLICE_SHIFT 8U
#define POWER_MEMORY_BLOCK_MASK  0xFFU

static MEMCON_SLICE_Type *const memcon_slices[] = MEMCON_SLICE_BASE_PTRS;

static memcon_power_mode_t active_block_mode(uint32_t mem_id)
{
	MEMCON_SLICE_Type *slice = memcon_slices[mem_id >> POWER_MEMORY_SLICE_SHIFT];

	return MEMCON_SLICE_GetActiveBlockMode(slice, (uint8_t)(mem_id & POWER_MEMORY_BLOCK_MASK));
}

static void assert_block_mode(memcon_power_mode_t expected, const char *when)
{
	memcon_power_mode_t mode = active_block_mode(UNUSED_BLOCK);

	zassert_equal(mode, expected, "Block mode is %d %s, expected %d", mode, when, expected);
}

ZTEST(soc_memory, test_retention_reads_back_and_returns_to_active)
{
	assert_block_mode(kMEMCON_PowerModeActive, "before the test");

	zassert_ok(soc_memory_set_mode(UNUSED_BLOCK, SOC_MEMORY_MODE_RETENTION),
		   "Cannot set the block to retention");
	assert_block_mode(kMEMCON_PowerModeRetention, "after setting retention");

	zassert_ok(soc_memory_set_mode(UNUSED_BLOCK, SOC_MEMORY_MODE_ACTIVE),
		   "Cannot set the block back to active");
	assert_block_mode(kMEMCON_PowerModeActive, "after setting active");
}

/* POWER_Init() leaves every block active: a failed test must not leave it otherwise. */
static void soc_memory_after(void *fixture)
{
	ARG_UNUSED(fixture);

	zassert_ok(soc_memory_set_mode(UNUSED_BLOCK, SOC_MEMORY_MODE_ACTIVE),
		   "Cannot restore the block to active");
}

ZTEST_SUITE(soc_memory, NULL, stay_awake_setup, NULL, soc_memory_after, stay_awake_teardown);
```

## src/power_domains.c
```c
/*
 * SPDX-FileCopyrightText: Copyright 2026 NXP
 *
 * SPDX-License-Identifier: Apache-2.0
 */

#include <stdbool.h>
#include <stdint.h>

#include <zephyr/device.h>
#include <zephyr/devicetree.h>
#include <zephyr/pm/device.h>
#include <zephyr/pm/device_runtime.h>
#include <zephyr/sys/util.h>
#include <zephyr/ztest.h>

#include <fsl_clock.h>
#include <fsl_pdcon.h>
#include <fsl_power.h>

#include "stay_awake.h"

/* PDCON numbers its domains from 0 to 5, as power_domain_t does. */
#define PDCON_DOMAIN_COUNT 6U

struct pdcon_domain {
	const struct device *dev;
	power_domain_t id;
};

enum {
	NPU_DOMAIN,
	COMM_DOMAIN,
	MEDIA_DOMAIN,
	TESTED_DOMAIN_COUNT,
};

#define PDCON_DOMAIN(node_label, domain_id)                                                        \
	{                                                                                          \
		.dev = DEVICE_DT_GET(DT_NODELABEL(node_label)),                                    \
		.id = (domain_id),                                                                 \
	}

static const struct pdcon_domain domains[TESTED_DOMAIN_COUNT] = {
	[NPU_DOMAIN] = PDCON_DOMAIN(pd_npu, kPOWER_DomainNpu),
	[COMM_DOMAIN] = PDCON_DOMAIN(pd_comm, kPOWER_DomainComm),
	[MEDIA_DOMAIN] = PDCON_DOMAIN(pd_media, kPOWER_DomainMedia),
};

/* A root soc_clock_init() programs in the CCM inside a domain. */
struct domain_root {
	const char *name;
	clock_root_t root;
	uint32_t boot_mux;
	CCM_Type *ccm;
	/* clock_root_t of the first root of that CCM */
	clock_root_t ccm_first_root;
};

/* The divider soc_clock_init() gives every domain-base root. */
#define DOMAIN_ROOT_BOOT_DIV 1U

/* domain is the HAL's name of the subsystem: COMM for COMM__CCM and kCLOCK_Root_COMM_*. */
#define DOMAIN_ROOT(domain, root_name, mux)                                                        \
	{                                                                                          \
		.name = STRINGIFY(root_name),                                                      \
		.root = kCLOCK_Root_##domain##_##root_name,                                        \
		.boot_mux = (mux),                                                                 \
		.ccm = domain##__CCM,                                                              \
		.ccm_first_root = kCLOCK_Root_##domain##_START,                                    \
	}

/* soc_clock.c, ConfigCGUDig_COMM() */
static const struct domain_root comm_roots[] = {
	DOMAIN_ROOT(COMM, comm_clk, kCLOCK_COMM_ClockRoot_COMMBUS),
	DOMAIN_ROOT(COMM, comm_ulp32k, kCLOCK_COMM_ULP32K_ClockRoot_ULP32K),
};

/* soc_clock.c, ConfigCGUDig_MEDIA() */
static const struct domain_root media_roots[] = {
	DOMAIN_ROOT(MEDIA, media_clk, kCLOCK_MEDIA_ClockRoot_MEDIABUS),
	DOMAIN_ROOT(MEDIA, mediapll_clk, kCLOCK_MEDIAPLL_ClockRoot_MAINPLLDIV10),
};

struct domain_boot_state {
	int ret;
	enum pm_device_state device_state;
	pdcon_event_t pdcon_state;
};

/* Read by the suite setup, before a test switches a domain and hides the boot state. */
static struct domain_boot_state boot_states[TESTED_DOMAIN_COUNT];

static bool domain_held[TESTED_DOMAIN_COUNT];

static pdcon_event_t pdcon_state(power_domain_t id)
{
	return PDCON_GetDomainState(SYSCON__PDCON, (uint8_t)id);
}

static void pdcon_states_read(pdcon_event_t states[PDCON_DOMAIN_COUNT])
{
	for (uint32_t id = 0U; id < PDCON_DOMAIN_COUNT; id++) {
		states[id] = pdcon_state((power_domain_t)id);
	}
}

static void hold_domain(size_t index)
{
	const struct pdcon_domain *domain = &domains[index];

	zassert_ok(pm_device_runtime_get(domain->dev), "Cannot power %s on", domain->dev->name);
	domain_held[index] = true;
}

static void release_domain(size_t index)
{
	const struct pdcon_domain *domain = &domains[index];
	int ret = pm_device_runtime_put(domain->dev);

	domain_held[index] = false;
	zassert_ok(ret, "Cannot power %s off", domain->dev->name);
}

static void assert_device_state(const struct pdcon_domain *domain, enum pm_device_state expected)
{
	enum pm_device_state state;

	zassert_ok(pm_device_state_get(domain->dev, &state), "No PM state for %s",
		   domain->dev->name);
	zassert_equal(state, expected, "%s is %s, expected %s", domain->dev->name,
		      pm_device_state_str(state), pm_device_state_str(expected));
}

static void assert_domain_on(const struct pdcon_domain *domain)
{
	assert_device_state(domain, PM_DEVICE_STATE_ACTIVE);
	zassert_equal(pdcon_state(domain->id), kPDCON_EventNoneOrActive,
		      "PDCON reports %s powered off", domain->dev->name);
}

static void assert_domain_off(const struct pdcon_domain *domain)
{
	assert_device_state(domain, PM_DEVICE_STATE_SUSPENDED);
	zassert_equal(pdcon_state(domain->id), kPDCON_EventPowerOff, "PDCON reports %s powered",
		      domain->dev->name);
}

static void assert_only_domain_switched(const pdcon_event_t before[PDCON_DOMAIN_COUNT],
					const pdcon_event_t after[PDCON_DOMAIN_COUNT],
					const struct pdcon_domain *switched)
{
	for (uint32_t id = 0U; id < PDCON_DOMAIN_COUNT; id++) {
		if (id == (uint32_t)switched->id) {
			continue;
		}

		zassert_equal(after[id], before[id],
			      "Switching %s moved PDCON domain %u from state %d to %d",
			      switched->dev->name, id, before[id], after[id]);
	}
}

static bool root_is_running(const struct domain_root *root)
{
	uint32_t status = root->ccm->CLOCK_ROOT[root->root - root->ccm_first_root].STATUS0;

	return (status & CCM_STATUS0_OFF_MASK) == 0U;
}

static void assert_roots_at_boot_setting(const struct domain_root *roots, size_t count)
{
	for (size_t i = 0; i < count; i++) {
		const struct domain_root *root = &roots[i];

		zassert_equal(CLOCK_GetRootClockMux(root->root), root->boot_mux,
			      "%s mux is %u, soc_clock_init() sets %u", root->name,
			      CLOCK_GetRootClockMux(root->root), root->boot_mux);
		zassert_equal(CLOCK_GetRootClockDiv(root->root), DOMAIN_ROOT_BOOT_DIV,
			      "%s divider is %u, soc_clock_init() sets %u", root->name,
			      CLOCK_GetRootClockDiv(root->root), DOMAIN_ROOT_BOOT_DIV);
		zassert_true(root_is_running(root), "%s is shut down", root->name);
	}
}

/* The CCM of the domain is only accessible while the domain is held. */
static void assert_resume_restores_roots(size_t index, const struct domain_root *roots,
					 size_t count)
{
	hold_domain(index);
	assert_roots_at_boot_setting(roots, count);
	release_domain(index);
}

ZTEST(power_domains, test_unused_domains_are_off_after_boot)
{
	ARRAY_FOR_EACH(domains, i) {
		const char *name = domains[i].dev->name;

		zassert_ok(boot_states[i].ret, "No PM state for %s", name);
		zassert_equal(boot_states[i].device_state, PM_DEVICE_STATE_SUSPENDED,
			      "%s is %s after boot", name,
			      pm_device_state_str(boot_states[i].device_state));
		zassert_equal(boot_states[i].pdcon_state, kPDCON_EventPowerOff,
			      "PDCON reports %s powered after boot", name);
	}
}

ZTEST(power_domains, test_runtime_get_and_put_switch_the_domain)
{
	ARRAY_FOR_EACH(domains, i) {
		hold_domain(i);
		assert_domain_on(&domains[i]);

		release_domain(i);
		assert_domain_off(&domains[i]);
	}
}

/* The domains are powered on one at a time, each next to the ones already on. */
ZTEST(power_domains, test_resume_switches_only_its_own_domain)
{
	pdcon_event_t before[PDCON_DOMAIN_COUNT];
	pdcon_event_t after[PDCON_DOMAIN_COUNT];

	ARRAY_FOR_EACH(domains, i) {
		pdcon_states_read(before);
		hold_domain(i);
		pdcon_states_read(after);

		assert_only_domain_switched(before, after, &domains[i]);
	}
}

/* The domains are powered off one at a time, each next to the ones still on. */
ZTEST(power_domains, test_suspend_switches_only_its_own_domain)
{
	pdcon_event_t before[PDCON_DOMAIN_COUNT];
	pdcon_event_t after[PDCON_DOMAIN_COUNT];

	ARRAY_FOR_EACH(domains, i) {
		hold_domain(i);
	}

	ARRAY_FOR_EACH(domains, i) {
		pdcon_states_read(before);
		release_domain(i);
		pdcon_states_read(after);

		assert_only_domain_switched(before, after, &domains[i]);
	}
}

ZTEST(power_domains, test_resume_restores_domain_clock_roots)
{
	assert_resume_restores_roots(COMM_DOMAIN, comm_roots, ARRAY_SIZE(comm_roots));
	assert_resume_restores_roots(MEDIA_DOMAIN, media_roots, ARRAY_SIZE(media_roots));
}

static void *power_domains_setup(void)
{
	ARRAY_FOR_EACH(domains, i) {
		boot_states[i].ret =
			pm_device_state_get(domains[i].dev, &boot_states[i].device_state);
		boot_states[i].pdcon_state = pdcon_state(domains[i].id);
	}

	return stay_awake_setup();
}

/* A failed test leaves the domains it still holds powered: release them. */
static void power_domains_after(void *fixture)
{
	ARG_UNUSED(fixture);

	ARRAY_FOR_EACH(domains, i) {
		if (domain_held[i]) {
			release_domain(i);
		}
	}
}

ZTEST_SUITE(power_domains, NULL, power_domains_setup, NULL, power_domains_after,
	    stay_awake_teardown);
```

## src/power_states.c
```c
/*
 * SPDX-FileCopyrightText: Copyright 2026 NXP
 *
 * SPDX-License-Identifier: Apache-2.0
 */

#include <stdint.h>

#include <zephyr/devicetree.h>
#include <zephyr/pm/state.h>
#include <zephyr/sys/util.h>
#include <zephyr/toolchain.h>
#include <zephyr/ztest.h>

#include "stay_awake.h"

#define CPU0_NODE DT_NODELABEL(cpu0)

/* 1 if entry idx of the CPU node's cpu-power-states is state_node. */
#define CPU_POWER_STATE_IS(cpu_node, prop, idx, state_node)                                        \
	DT_SAME_NODE(DT_PHANDLE_BY_IDX(cpu_node, prop, idx), state_node)

/* How many entries of cpu0's cpu-power-states are the node. */
#define CPU0_LISTINGS(node_id)                                                                     \
	(DT_FOREACH_PROP_ELEM_SEP_VARGS(CPU0_NODE, cpu_power_states, CPU_POWER_STATE_IS, (+),      \
					node_id))

#define POLICY_MAY_SELECT(node_label)                                                              \
	(DT_NODE_HAS_STATUS_OKAY(DT_NODELABEL(node_label)) &&                                      \
	 (CPU0_LISTINGS(DT_NODELABEL(node_label)) == 1))

/*
 * Deep Sleep 3, Power Down and Deep Power Down 1 wake through a system reset. If
 * the policy could pick one, an idle application would reboot without having
 * asked to, so they are entered through pm_state_force() only.
 */
BUILD_ASSERT((DT_NUM_CPU_POWER_STATES(CPU0_NODE) == 3) && POLICY_MAY_SELECT(sleep) &&
		     POLICY_MAY_SELECT(deep_sleep1) && POLICY_MAY_SELECT(deep_sleep2),
	     "The PM policy may only select Sleep, Deep Sleep 1 and Deep Sleep 2");

#define TEST_CPU 0U

/* The substates under which the SoC power code enters the states that wake through a reset. */
#define DEEP_SLEEP3_SUBSTATE_ID      0U
#define POWER_DOWN_SUBSTATE_ID       1U
#define DEEP_POWER_DOWN1_SUBSTATE_ID 0U

struct reset_on_wake_state {
	const char *name;
	enum pm_state state;
	uint8_t substate_id;
};

static const struct reset_on_wake_state reset_on_wake_states[] = {
	{"Deep Sleep 3", PM_STATE_SUSPEND_TO_RAM, DEEP_SLEEP3_SUBSTATE_ID},
	{"Power Down", PM_STATE_SUSPEND_TO_RAM, POWER_DOWN_SUBSTATE_ID},
	{"Deep Power Down 1", PM_STATE_SUSPEND_TO_DISK, DEEP_POWER_DOWN1_SUBSTATE_ID},
};

/* The states are only looked up: forcing one would reset the board under test. */
ZTEST(power_states, test_reset_on_wake_states_can_be_forced)
{
	ARRAY_FOR_EACH_PTR(reset_on_wake_states, expected) {
		zassert_not_null(pm_state_get(TEST_CPU, expected->state, expected->substate_id),
				 "pm_state_force() cannot find %s (state %d, substate %u)",
				 expected->name, expected->state, expected->substate_id);
	}
}

ZTEST_SUITE(power_states, NULL, stay_awake_setup, NULL, NULL, stay_awake_teardown);
```

## src/regulators.c
```c
/*
 * SPDX-FileCopyrightText: Copyright 2026 NXP
 *
 * SPDX-License-Identifier: Apache-2.0
 */

#include <errno.h>
#include <stdbool.h>
#include <stdint.h>

#include <zephyr/device.h>
#include <zephyr/devicetree.h>
#include <zephyr/drivers/regulator.h>
#include <zephyr/sys/util.h>
#include <zephyr/ztest.h>

#include <fsl_pmu.h>
#include <fsl_power.h>
#include <fsl_powercon.h>

#include "stay_awake.h"

/*
 * Every value written to a rail is the one it already has or its nominal setting,
 * and the settings found before a test are written back after it: the tests run on
 * the board they supply. No test switches an LDO off.
 */

/* Outputs at the kPMU_LdoVoltSelNom trim */
#define LDO_0V8_NOMINAL_UV 800000
#define LDO_1V8_NOMINAL_UV 1800000

/* The LDO mode out of reset */
#define LDO_NOMINAL_MODE kPMU_LdoModeHP

/* LDOA_0V8 and LDOQ_0V8 are 0.8 V supplies; they have no voltage setting to request. */
#define REDUCED_TIER_REQUEST_UV LDO_0V8_NOMINAL_UV

static const struct device *const dcdc = DEVICE_DT_GET(DT_NODELABEL(dcdc));
static const struct device *const ldo1v8 = DEVICE_DT_GET(DT_NODELABEL(ldo1v8));

static const struct device *const reduced_tier_rails[] = {
	DEVICE_DT_GET(DT_NODELABEL(ldoa0v8)),
	DEVICE_DT_GET(DT_NODELABEL(ldoq0v8)),
};

struct full_tier_ldo {
	const struct device *dev;
	int32_t nominal_uv;
	/* PMUCFG_ACTIVE field holding the mode */
	uint32_t active_mode_mask;
	/* PMU_LDO_CTRL_REG trims of the HP and the LP regulator; VDDA_1V8 has no LP trim. */
	uint32_t hp_trim_mask;
	uint32_t lp_trim_mask;
};

static const struct full_tier_ldo full_tier_ldos[] = {
	{
		.dev = DEVICE_DT_GET(DT_NODELABEL(ldo0v8)),
		.nominal_uv = LDO_0V8_NOMINAL_UV,
		.active_mode_mask = POWERCON_SOC_CTRL_PMUCFG_ACTIVE_LDO_VDD_0V8_MASK,
		.hp_trim_mask = PMU_PMU_LDO_CTRL_REG_PMU_VDD_0V8_SEL_MASK,
		.lp_trim_mask = PMU_PMU_LDO_CTRL_REG_PMU_LPVDDREG_0V8_SEL_MASK,
	},
	{
		.dev = DEVICE_DT_GET(DT_NODELABEL(ldo1v8)),
		.nominal_uv = LDO_1V8_NOMINAL_UV,
		.active_mode_mask = POWERCON_SOC_CTRL_PMUCFG_ACTIVE_LDO_VDD_1V8_MASK,
		.hp_trim_mask = PMU_PMU_LDO_CTRL_REG_PMU_VDD_1V8_SEL_MASK,
		.lp_trim_mask = PMU_PMU_LDO_CTRL_REG_PMU_LPVDDREG_1V8_SEL_MASK,
	},
	{
		.dev = DEVICE_DT_GET(DT_NODELABEL(ldovdda)),
		.nominal_uv = LDO_1V8_NOMINAL_UV,
		.active_mode_mask = POWERCON_SOC_CTRL_PMUCFG_ACTIVE_LDO_VDDA_1V8_MASK,
		.hp_trim_mask = PMU_PMU_LDO_CTRL_REG_PMU_VDDA_1V8_SEL_MASK,
		.lp_trim_mask = 0U,
	},
};

/* The registers the regulator driver shares between the rails */
struct pmu_registers {
	uint32_t ldo_ctrl;
	uint32_t sensor_ctrl0;
	uint32_t sensor_ctrl1;
	uint32_t irq_enable;
	uint32_t warm_reset;
	uint32_t cold_reset;
	uint32_t pmucfg_active;
};

/* The LDO settings found before a test */
struct ldo_settings {
	pmu_ldo_vdd0v8_config_t ldo0v8;
	pmu_ldo_vdd1v8_config_t ldo1v8;
	pmu_ldo_vdda1v8_config_t ldovdda;
	regulator_mode_t ldo1v8_mode;
};

static struct ldo_settings saved_settings;

static uint32_t pmucfg_active_read(void)
{
	return POWERCON_GetPmucfgActive(SYSCON__POWERCON_SOC_CTRL);
}

static void pmu_registers_read(struct pmu_registers *regs)
{
	regs->ldo_ctrl = SYSCON__PMU->PMU_LDO_CTRL_REG;
	regs->sensor_ctrl0 = SYSCON__PMU->PMU_SENSOR_CTRL0_REG;
	regs->sensor_ctrl1 = SYSCON__PMU->PMU_SENSOR_CTRL1_REG;
	regs->irq_enable = SYSCON__PMU->PMU_DIG_IRQ_EN_REG;
	regs->warm_reset = SYSCON__PMU->PMU_RESETCON_WARM_CTRL;
	regs->cold_reset = SYSCON__PMU->PMU_RESETCON_COLD_CTRL;
	regs->pmucfg_active = pmucfg_active_read();
}

/* The bits that differ between two reads */
static struct pmu_registers pmu_registers_diff(const struct pmu_registers *before,
					       const struct pmu_registers *after)
{
	return (struct pmu_registers){
		.ldo_ctrl = before->ldo_ctrl ^ after->ldo_ctrl,
		.sensor_ctrl0 = before->sensor_ctrl0 ^ after->sensor_ctrl0,
		.sensor_ctrl1 = before->sensor_ctrl1 ^ after->sensor_ctrl1,
		.irq_enable = before->irq_enable ^ after->irq_enable,
		.warm_reset = before->warm_reset ^ after->warm_reset,
		.cold_reset = before->cold_reset ^ after->cold_reset,
		.pmucfg_active = before->pmucfg_active ^ after->pmucfg_active,
	};
}

static void assert_only_allowed_bits_changed(const char *operation,
					     const struct pmu_registers *changed,
					     const struct pmu_registers *allowed)
{
	zassert_equal(changed->ldo_ctrl & ~allowed->ldo_ctrl, 0U,
		      "%s changed PMU_LDO_CTRL_REG bits 0x%08x", operation,
		      changed->ldo_ctrl & ~allowed->ldo_ctrl);
	zassert_equal(changed->sensor_ctrl0 & ~allowed->sensor_ctrl0, 0U,
		      "%s changed PMU_SENSOR_CTRL0_REG bits 0x%08x", operation,
		      changed->sensor_ctrl0 & ~allowed->sensor_ctrl0);
	zassert_equal(changed->sensor_ctrl1 & ~allowed->sensor_ctrl1, 0U,
		      "%s changed PMU_SENSOR_CTRL1_REG bits 0x%08x", operation,
		      changed->sensor_ctrl1 & ~allowed->sensor_ctrl1);
	zassert_equal(changed->irq_enable & ~allowed->irq_enable, 0U,
		      "%s changed PMU_DIG_IRQ_EN_REG bits 0x%08x", operation,
		      changed->irq_enable & ~allowed->irq_enable);
	zassert_equal(changed->warm_reset & ~allowed->warm_reset, 0U,
		      "%s changed PMU_RESETCON_WARM_CTRL bits 0x%08x", operation,
		      changed->warm_reset & ~allowed->warm_reset);
	zassert_equal(changed->cold_reset & ~allowed->cold_reset, 0U,
		      "%s changed PMU_RESETCON_COLD_CTRL bits 0x%08x", operation,
		      changed->cold_reset & ~allowed->cold_reset);
	zassert_equal(changed->pmucfg_active & ~allowed->pmucfg_active, 0U,
		      "%s changed PMUCFG_ACTIVE bits 0x%08x", operation,
		      changed->pmucfg_active & ~allowed->pmucfg_active);
}

static bool ldo_is_on_in_hardware(const struct full_tier_ldo *ldo)
{
	return FIELD_GET(ldo->active_mode_mask, pmucfg_active_read()) != kPMU_LdoModeOff;
}

static void assert_trim_is_nominal(const struct full_tier_ldo *ldo, uint32_t trim_mask,
				   uint32_t ldo_ctrl)
{
	zassert_equal(FIELD_GET(trim_mask, ldo_ctrl), kPMU_LdoVoltSelNom,
		      "%s: trim field 0x%08x of PMU_LDO_CTRL_REG is not nominal", ldo->dev->name,
		      trim_mask);
}

static void assert_nominal_voltage_write_is_isolated(const struct full_tier_ldo *ldo)
{
	const struct pmu_registers allowed = {
		.ldo_ctrl = ldo->hp_trim_mask | ldo->lp_trim_mask,
	};
	struct pmu_registers before;
	struct pmu_registers after;
	struct pmu_registers changed;
	int32_t volt_uv;

	pmu_registers_read(&before);
	zassert_ok(regulator_set_voltage(ldo->dev, ldo->nominal_uv, ldo->nominal_uv),
		   "%s rejects its nominal %d uV", ldo->dev->name, ldo->nominal_uv);
	pmu_registers_read(&after);

	assert_trim_is_nominal(ldo, ldo->hp_trim_mask, after.ldo_ctrl);
	if (ldo->lp_trim_mask != 0U) {
		assert_trim_is_nominal(ldo, ldo->lp_trim_mask, after.ldo_ctrl);
	}

	zassert_ok(regulator_get_voltage(ldo->dev, &volt_uv), "%s has no voltage", ldo->dev->name);
	zassert_equal(volt_uv, ldo->nominal_uv, "%s reads %d uV after %d uV was set",
		      ldo->dev->name, volt_uv, ldo->nominal_uv);

	changed = pmu_registers_diff(&before, &after);
	assert_only_allowed_bits_changed(ldo->dev->name, &changed, &allowed);
}

static void assert_enable_is_only_counted(const struct device *rail)
{
	const struct pmu_registers no_change = {0};
	struct pmu_registers before;
	struct pmu_registers after;
	struct pmu_registers changed;

	zassert_false(regulator_is_enabled(rail), "%s is requested before the test", rail->name);

	pmu_registers_read(&before);
	zassert_ok(regulator_enable(rail), "Cannot enable %s", rail->name);
	zassert_true(regulator_is_enabled(rail), "%s does not count its enable", rail->name);
	zassert_ok(regulator_disable(rail), "Cannot disable %s", rail->name);
	zassert_false(regulator_is_enabled(rail), "%s does not count its disable", rail->name);
	pmu_registers_read(&after);

	changed = pmu_registers_diff(&before, &after);
	assert_only_allowed_bits_changed(rail->name, &changed, &no_change);
}

static void assert_voltage_and_mode_unsupported(const struct device *rail)
{
	const struct pmu_registers no_change = {0};
	struct pmu_registers before;
	struct pmu_registers after;
	struct pmu_registers changed;
	int32_t volt_uv;
	regulator_mode_t mode;

	pmu_registers_read(&before);
	zassert_equal(regulator_set_voltage(rail, REDUCED_TIER_REQUEST_UV, REDUCED_TIER_REQUEST_UV),
		      -ENOTSUP, "%s accepts a voltage", rail->name);
	zassert_equal(regulator_get_voltage(rail, &volt_uv), -ENOTSUP, "%s reports a voltage",
		      rail->name);
	zassert_equal(regulator_set_mode(rail, LDO_NOMINAL_MODE), -ENOTSUP, "%s accepts a mode",
		      rail->name);
	zassert_equal(regulator_get_mode(rail, &mode), -ENOTSUP, "%s reports a mode", rail->name);
	pmu_registers_read(&after);

	changed = pmu_registers_diff(&before, &after);
	assert_only_allowed_bits_changed(rail->name, &changed, &no_change);
}

/*
 * Writes back the configuration the getter reads, then reads it again, so the
 * rail keeps its setting. Both copies start zeroed: the fields the PMU does not
 * hold, and the padding, compare equal.
 */
#define ASSERT_PMU_CONFIG_ROUND_TRIP(config_type, get_config, set_config)                          \
	do {                                                                                       \
		config_type written = {0};                                                         \
		config_type read_back = {0};                                                       \
                                                                                                   \
		get_config(SYSCON__PMU, &written);                                                 \
		set_config(SYSCON__PMU, &written);                                                 \
		get_config(SYSCON__PMU, &read_back);                                               \
                                                                                                   \
		zassert_mem_equal(&read_back, &written, sizeof(written),                           \
				  "%s() differs from what %s() wrote",                             \
				  STRINGIFY(get_config), STRINGIFY(set_config));                   \
	} while (false)

ZTEST(regulators, test_full_tier_reports_the_hardware_state)
{
	zassert_true(regulator_is_enabled(dcdc), "dcdc supplies the core but reads as disabled");

	ARRAY_FOR_EACH_PTR(full_tier_ldos, ldo) {
		zassert_equal(regulator_is_enabled(ldo->dev), ldo_is_on_in_hardware(ldo),
			      "%s refcount disagrees with PMUCFG_ACTIVE", ldo->dev->name);
	}
}

ZTEST(regulators, test_hal_getters_read_back_the_config_write)
{
	ASSERT_PMU_CONFIG_ROUND_TRIP(pmu_dcdc_config_t, PMU_GetDcdcConfig, PMU_ConfigDcdc);
	ASSERT_PMU_CONFIG_ROUND_TRIP(pmu_ldo_vdd0v8_config_t, PMU_GetLdoVdd0V8Config,
				     PMU_ConfigLdoVdd0V8);
	ASSERT_PMU_CONFIG_ROUND_TRIP(pmu_ldo_vdd1v8_config_t, PMU_GetLdoVdd1V8Config,
				     PMU_ConfigLdoVdd1V8);
	ASSERT_PMU_CONFIG_ROUND_TRIP(pmu_ldo_vdda1v8_config_t, PMU_GetLdoVdda1V8Config,
				     PMU_ConfigLdoVdda1V8);
}

ZTEST(regulators, test_ldo_voltage_write_keeps_the_other_fields)
{
	ARRAY_FOR_EACH_PTR(full_tier_ldos, ldo) {
		assert_nominal_voltage_write_is_isolated(ldo);
	}
}

ZTEST(regulators, test_ldo1v8_mode_write_changes_only_its_field)
{
	const struct pmu_registers allowed = {
		.pmucfg_active = POWERCON_SOC_CTRL_PMUCFG_ACTIVE_LDO_VDD_1V8_MASK,
	};
	struct pmu_registers before;
	struct pmu_registers after;
	struct pmu_registers changed;

	pmu_registers_read(&before);
	zassert_ok(regulator_set_mode(ldo1v8, LDO_NOMINAL_MODE), "ldo1v8 rejects its nominal mode");
	pmu_registers_read(&after);

	zassert_equal(
		FIELD_GET(POWERCON_SOC_CTRL_PMUCFG_ACTIVE_LDO_VDD_1V8_MASK, after.pmucfg_active),
		LDO_NOMINAL_MODE, "PMUCFG_ACTIVE does not hold the ldo1v8 mode written");

	changed = pmu_registers_diff(&before, &after);
	assert_only_allowed_bits_changed(ldo1v8->name, &changed, &allowed);
}

ZTEST(regulators, test_reduced_tier_enable_is_counted)
{
	ARRAY_FOR_EACH(reduced_tier_rails, i) {
		assert_enable_is_only_counted(reduced_tier_rails[i]);
	}
}

ZTEST(regulators, test_reduced_tier_has_no_voltage_or_mode)
{
	ARRAY_FOR_EACH(reduced_tier_rails, i) {
		assert_voltage_and_mode_unsupported(reduced_tier_rails[i]);
	}
}

static void regulators_before(void *fixture)
{
	ARG_UNUSED(fixture);

	PMU_GetLdoVdd0V8Config(SYSCON__PMU, &saved_settings.ldo0v8);
	PMU_GetLdoVdd1V8Config(SYSCON__PMU, &saved_settings.ldo1v8);
	PMU_GetLdoVdda1V8Config(SYSCON__PMU, &saved_settings.ldovdda);
	zassert_ok(regulator_get_mode(ldo1v8, &saved_settings.ldo1v8_mode), "ldo1v8 has no mode");
}

/*
 * The trims go back through the HAL: regulator_set_voltage() gives the LP trim
 * the HP one, which would not restore an LP trim of its own.
 */
static void regulators_after(void *fixture)
{
	ARG_UNUSED(fixture);

	PMU_ConfigLdoVdd0V8(SYSCON__PMU, &saved_settings.ldo0v8);
	PMU_ConfigLdoVdd1V8(SYSCON__PMU, &saved_settings.ldo1v8);
	PMU_ConfigLdoVdda1V8(SYSCON__PMU, &saved_settings.ldovdda);
	zassert_ok(regulator_set_mode(ldo1v8, saved_settings.ldo1v8_mode),
		   "Cannot restore the ldo1v8 mode");

	ARRAY_FOR_EACH(reduced_tier_rails, i) {
		if (regulator_is_enabled(reduced_tier_rails[i])) {
			zassert_ok(regulator_disable(reduced_tier_rails[i]), "Cannot release %s",
				   reduced_tier_rails[i]->name);
		}
	}
}

ZTEST_SUITE(regulators, NULL, stay_awake_setup, regulators_before, regulators_after,
	    stay_awake_teardown);
```

## src/run_modes.c
```c
/*
 * SPDX-FileCopyrightText: Copyright 2026 NXP
 *
 * SPDX-License-Identifier: Apache-2.0
 */

#include <stdint.h>

#include <zephyr/cpu_freq/cpu_freq.h>
#include <zephyr/cpu_freq/pstate.h>
#include <zephyr/device.h>
#include <zephyr/devicetree.h>
#include <zephyr/drivers/regulator.h>
#include <zephyr/sys/util.h>
#include <zephyr/ztest.h>

#include <fsl_power.h>
#include <fsl_powercon.h>

#include "stay_awake.h"

/* VDD_CORE the HAL programs into the DCDC for each run mode */
#define HP_RUN_VDD_CORE_UV     900000
#define NORMAL_RUN_VDD_CORE_UV 800000

static const struct pstate *const hp_run = PSTATE_DT_GET(DT_NODELABEL(pstate_od_run));
static const struct pstate *const normal_run = PSTATE_DT_GET(DT_NODELABEL(pstate_normal_run));

static const struct device *const dcdc = DEVICE_DT_GET(DT_NODELABEL(dcdc));
static const struct device *const ldo1v8 = DEVICE_DT_GET(DT_NODELABEL(ldo1v8));

static void enter_run_mode(const struct pstate *run_mode, const char *name)
{
	zassert_ok(cpu_freq_pstate_set(run_mode), "Cannot enter %s", name);
}

static uint32_t active_core_level(void)
{
	return FIELD_GET(POWERCON_SOC_CTRL_PMUCFG_ACTIVE_CORE_LVL_MASK,
			 POWERCON_GetPmucfgActive(SYSCON__POWERCON_SOC_CTRL));
}

static void assert_dcdc_voltage(int32_t expected_uv, const char *run_mode_name)
{
	int32_t volt_uv;

	zassert_ok(regulator_get_voltage(dcdc, &volt_uv), "dcdc has no voltage");
	zassert_equal(volt_uv, expected_uv, "dcdc reads %d uV in %s, expected %d uV", volt_uv,
		      run_mode_name, expected_uv);
}

ZTEST(run_modes, test_ldo1v8_mode_write_keeps_the_hp_run_core_level)
{
	regulator_mode_t mode;

	enter_run_mode(hp_run, "HP Run");
	zassert_equal(active_core_level(), POWER_PMUCFG_CORELEVEL_090V,
		      "HP Run left CORE_LVL at 0x%02x", active_core_level());

	/* The mode the rail already has: the write goes through without changing the rail. */
	zassert_ok(regulator_get_mode(ldo1v8, &mode), "ldo1v8 has no mode");
	zassert_ok(regulator_set_mode(ldo1v8, mode), "ldo1v8 rejects its own mode");

	zassert_equal(active_core_level(), POWER_PMUCFG_CORELEVEL_090V,
		      "The ldo1v8 mode write moved CORE_LVL to 0x%02x", active_core_level());
}

ZTEST(run_modes, test_dcdc_voltage_follows_the_run_mode)
{
	enter_run_mode(hp_run, "HP Run");
	assert_dcdc_voltage(HP_RUN_VDD_CORE_UV, "HP Run");

	enter_run_mode(normal_run, "Normal Run");
	assert_dcdc_voltage(NORMAL_RUN_VDD_CORE_UV, "Normal Run");

	enter_run_mode(hp_run, "HP Run");
	assert_dcdc_voltage(HP_RUN_VDD_CORE_UV, "HP Run");
}

/* soc_clock_init() boots into HP Run. */
static void run_modes_after(void *fixture)
{
	ARG_UNUSED(fixture);

	enter_run_mode(hp_run, "HP Run");
}

ZTEST_SUITE(run_modes, NULL, stay_awake_setup, NULL, run_modes_after, stay_awake_teardown);
```

## src/stay_awake.c
```c
/*
 * SPDX-FileCopyrightText: Copyright 2026 NXP
 *
 * SPDX-License-Identifier: Apache-2.0
 */

#include <zephyr/pm/policy.h>
#include <zephyr/sys/util.h>

#include "stay_awake.h"

/*
 * Every suite of the CONFIG_PM build holds this lock for its whole run. The tests
 * read back PMU, PDCON and MEMCON settings that a power state rewrites on entry
 * and exit, so the idle thread must not enter one while a test or the framework
 * waits. The lock covers all states, including those that wake through a reset.
 */
void *stay_awake_setup(void)
{
	pm_policy_state_all_lock_get();

	return NULL;
}

void stay_awake_teardown(void *fixture)
{
	ARG_UNUSED(fixture);

	pm_policy_state_all_lock_put();
}
```

## src/stay_awake.h
```c
/*
 * SPDX-FileCopyrightText: Copyright 2026 NXP
 *
 * SPDX-License-Identifier: Apache-2.0
 */

#ifndef POWER_QUERIES_STAY_AWAKE_H_
#define POWER_QUERIES_STAY_AWAKE_H_

/* ZTEST_SUITE() setup: keeps the CPU out of every power state until the teardown. */
void *stay_awake_setup(void);

/* ZTEST_SUITE() teardown: lets the policy select power states again. */
void stay_awake_teardown(void *fixture);

#endif /* POWER_QUERIES_STAY_AWAKE_H_ */
```

## src/vbat_lptmr_alarm.c
```c
/*
 * SPDX-FileCopyrightText: Copyright 2026 NXP
 *
 * SPDX-License-Identifier: Apache-2.0
 */

#include <stdint.h>

#include <zephyr/device.h>
#include <zephyr/devicetree.h>
#include <zephyr/drivers/counter.h>
#include <zephyr/kernel.h>
#include <zephyr/sys/util.h>
#include <zephyr/ztest.h>

#define ALARM_CHANNEL      0U
#define CONSECUTIVE_ALARMS 2U
#define ALARM_DELAY_MS     1000

/*
 * The VBAT LPTMR counts FRO32K, which is not a crystal, while the uptime it is
 * compared against comes from SysTick. The bound only has to tell an alarm on time
 * from one that fires at once or not at all.
 */
#define ALARM_TOLERANCE_MS 100

/* The devicetree rate of the timer, which soc.c sets up from FRO32K */
#define VBAT_LPTMR_HZ 32768U

static const struct device *const vbat_lptmr = DEVICE_DT_GET(DT_NODELABEL(vbat_lptmr));

struct alarm_record {
	struct k_sem expired;
	int64_t expired_at_ms;
};

static struct alarm_record record;

static void alarm_expired(const struct device *dev, uint8_t chan_id, uint32_t ticks,
			  void *user_data)
{
	struct alarm_record *expiry = user_data;

	ARG_UNUSED(dev);
	ARG_UNUSED(chan_id);
	ARG_UNUSED(ticks);

	expiry->expired_at_ms = k_uptime_get();
	k_sem_give(&expiry->expired);
}

static void assert_alarm_expires_on_time(uint32_t alarm_number)
{
	const struct counter_alarm_cfg alarm = {
		.callback = alarm_expired,
		.ticks = counter_us_to_ticks(vbat_lptmr, ALARM_DELAY_MS * USEC_PER_MSEC),
		.user_data = &record,
		.flags = 0U,
	};
	int64_t armed_at_ms = k_uptime_get();
	int32_t elapsed_ms;

	zassert_ok(counter_set_channel_alarm(vbat_lptmr, ALARM_CHANNEL, &alarm),
		   "Cannot set alarm %u", alarm_number);
	zassert_ok(k_sem_take(&record.expired, K_MSEC(ALARM_DELAY_MS + ALARM_TOLERANCE_MS)),
		   "Alarm %u did not expire", alarm_number);

	elapsed_ms = (int32_t)(record.expired_at_ms - armed_at_ms);
	zassert_between_inclusive(elapsed_ms, ALARM_DELAY_MS - ALARM_TOLERANCE_MS,
				  ALARM_DELAY_MS + ALARM_TOLERANCE_MS,
				  "Alarm %u expired after %d ms, set for %d ms", alarm_number,
				  elapsed_ms, ALARM_DELAY_MS);
}

ZTEST(vbat_lptmr_alarm, test_counts_at_the_devicetree_rate)
{
	zassert_equal(counter_get_frequency(vbat_lptmr), VBAT_LPTMR_HZ, "vbat_lptmr reports %u Hz",
		      counter_get_frequency(vbat_lptmr));
}

/* The second alarm starts the timer again after the first one stopped it. */
ZTEST(vbat_lptmr_alarm, test_consecutive_alarms_expire_on_time)
{
	for (uint32_t alarm_number = 1U; alarm_number <= CONSECUTIVE_ALARMS; alarm_number++) {
		assert_alarm_expires_on_time(alarm_number);
	}
}

static void *vbat_lptmr_alarm_setup(void)
{
	zassert_true(device_is_ready(vbat_lptmr), "vbat_lptmr is not ready");
	k_sem_init(&record.expired, 0, 1);

	return NULL;
}

/* A failed test can leave its alarm armed. */
static void vbat_lptmr_alarm_after(void *fixture)
{
	ARG_UNUSED(fixture);

	zassert_ok(counter_cancel_channel_alarm(vbat_lptmr, ALARM_CHANNEL),
		   "Cannot cancel the alarm");
	k_sem_reset(&record.expired);
}

ZTEST_SUITE(vbat_lptmr_alarm, NULL, vbat_lptmr_alarm_setup, NULL, vbat_lptmr_alarm_after, NULL);
```
