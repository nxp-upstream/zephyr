## CMakeLists.txt
```
# SPDX-License-Identifier: Apache-2.0

cmake_minimum_required(VERSION 3.20.0)
find_package(Zephyr REQUIRED HINTS $ENV{ZEPHYR_BASE})
project(mp_unit_test)

file(GLOB app_sources src/*.c)
target_sources(app PRIVATE ${app_sources})
```

## prj.conf
```kconfig
CONFIG_ZTEST=y
CONFIG_MP=y
```

## src/mp_test_helpers.h
```c
/*
 * Copyright 2026 NXP
 *
 * SPDX-License-Identifier: Apache-2.0
 */

#ifndef TESTS_SUBSYS_MP_CORE_UNIT_SRC_MP_TEST_HELPERS_H_
#define TESTS_SUBSYS_MP_CORE_UNIT_SRC_MP_TEST_HELPERS_H_

#include <zephyr/mp/mp_value.h>
#include <zephyr/ztest.h>

#define validate_boolean_value(value, expected)                                                    \
	({                                                                                         \
		zassert_not_null(value);                                                           \
		zassert_equal((value)->type, MP_TYPE_BOOLEAN);                                     \
		zassert_equal(mp_value_get_boolean(value), expected);                              \
	})

#define validate_int_value(value, expected)                                                        \
	({                                                                                         \
		zassert_not_null(value);                                                           \
		zassert_equal((value)->type, MP_TYPE_INT);                                         \
		zassert_equal(mp_value_get_int(value), expected);                                  \
	})

#define validate_uint_value(value, expected)                                                       \
	({                                                                                         \
		zassert_not_null(value);                                                           \
		zassert_equal((value)->type, MP_TYPE_UINT);                                        \
		zassert_equal(mp_value_get_uint(value), expected);                                 \
	})

#define validate_string_value(value, expected)                                                     \
	({                                                                                         \
		zassert_not_null(value);                                                           \
		zassert_equal((value)->type, MP_TYPE_STRING);                                      \
		zassert_str_equal(mp_value_get_string(value), expected);                           \
	})

#define validate_int_range_value(value, min, max, step)                                            \
	({                                                                                         \
		zassert_not_null(value);                                                           \
		zassert_equal((value)->type, MP_TYPE_INT_RANGE);                                   \
		zassert_equal(mp_value_get_int_range_min(value), min);                             \
		zassert_equal(mp_value_get_int_range_max(value), max);                             \
		zassert_equal(mp_value_get_int_range_step(value), step);                           \
	})

#define validate_uint_range_value(value, min, max, step)                                           \
	({                                                                                         \
		zassert_not_null(value);                                                           \
		zassert_equal((value)->type, MP_TYPE_UINT_RANGE);                                  \
		zassert_equal(mp_value_get_uint_range_min(value), min);                            \
		zassert_equal(mp_value_get_uint_range_max(value), max);                            \
		zassert_equal(mp_value_get_uint_range_step(value), step);                          \
	})

#define validate_list_value_type_and_size(value, expected_size)                                    \
	({                                                                                         \
		zassert_not_null(value);                                                           \
		zassert_equal((value)->type, MP_TYPE_LIST);                                        \
		zassert_equal(mp_value_list_get_size(value), expected_size);                       \
	})

#endif /* TESTS_SUBSYS_MP_CORE_UNIT_SRC_MP_TEST_HELPERS_H_ */
```

## src/test_buffer.c
```c
/*
 * Copyright 2026 NXP
 *
 * SPDX-License-Identifier: Apache-2.0
 */

#include <zephyr/kernel.h>
#include <zephyr/ztest.h>

#include <zephyr/mp/mp_buffer.h>
#include <zephyr/mp/mp_structure.h>

ZTEST_SUITE(mp_buffer_api, NULL, NULL, NULL, NULL, NULL);

static struct mp_buffer_pool pool;

ZTEST(mp_buffer_api, test_sanity)
{
	struct mp_structure config;

	zassert_ok(mp_structure_init(&config, MP_MEDIA_AUDIO_PCM), "config init failed");

	mp_buffer_pool_init(&pool);
	zassert_false(pool.started, "pool.started != false after init");

	zassert_true(mp_buffer_pool_configure(NULL, &config) < 0,
		     "configure NULL pool did not fail");

	zassert_true(mp_buffer_pool_configure(&pool, &config) < 0,
		     "configure(no callback) did not fail");

	zassert_true(mp_buffer_pool_start(NULL) < 0, "start NULL pool did not fail");

	pool.start = NULL;
	zassert_true(mp_buffer_pool_start(&pool) < 0, "start no callback did not fail");

	zassert_true(mp_buffer_pool_stop(NULL) < 0, "stop NULL pool did not fail");

	pool.stop = NULL;
	zassert_true(mp_buffer_pool_stop(&pool) < 0, "stop no callback did not fail");
}
```

## src/test_bus.c
```c
/*
 * Copyright 2026 NXP
 *
 * SPDX-License-Identifier: Apache-2.0
 */

#include <zephyr/kernel.h>
#include <zephyr/ztest.h>

#include <zephyr/mp/mp_bus.h>
#include <zephyr/mp/mp_element.h>
#include <zephyr/mp/mp_message.h>


struct mp_bus_api_fixture {
	struct mp_bus bus;
	struct mp_element elem;
};

static void *bus_suite_setup(void)
{
	static struct mp_bus_api_fixture fixture;

	return &fixture;
}

static void bus_before(void *f)
{
	struct mp_bus_api_fixture *fix = f;
	struct mp_message out;

	mp_bus_init(&fix->bus);
	memset(&fix->elem, 0, sizeof(fix->elem));
	mp_element_init(&fix->elem, 42);

	zassert_equal(mp_bus_peek(&fix->bus, &out), -ENOMSG, "bus not empty after init");
}

ZTEST_SUITE(mp_bus_api, NULL, bus_suite_setup, bus_before, NULL, NULL);

static int handler_call_count;
static enum mp_message_type handler_last_type;
static struct mp_element *handler_last_src;

/* Sync handler that records what it saw and drops every message it is given. */
static enum mp_bus_sync_reply test_drop_handler(struct mp_bus *bus, struct mp_message *message,
						void *user_data)
{
	ARG_UNUSED(bus);
	ARG_UNUSED(user_data);

	handler_call_count++;
	handler_last_type = message->type;
	handler_last_src = message->origin;

	return MP_BUS_DROP;
}

/* Sync handler that records what it saw and passes every message through. */
static enum mp_bus_sync_reply test_pass_handler(struct mp_bus *bus, struct mp_message *message,
						void *user_data)
{
	ARG_UNUSED(bus);
	ARG_UNUSED(user_data);

	handler_call_count++;
	handler_last_type = message->type;
	handler_last_src = message->origin;

	return MP_BUS_PASS;
}

ZTEST_F(mp_bus_api, test_post_peek_pop)
{
	struct mp_element *src = &fixture->elem;
	struct mp_message msg = {.origin = src, .type = MP_MESSAGE_EOS};
	struct mp_message peeked;
	struct mp_message popped;

	zassert_ok(mp_bus_post(&fixture->bus, &msg), "mp_bus_post failed");

	zassert_ok(mp_bus_peek(&fixture->bus, &peeked), "mp_bus_peek failed");
	zassert_equal(peeked.type, MP_MESSAGE_EOS, "peeked type != EOS");
	zassert_equal(peeked.origin, src, "peeked src mismatch");

	zassert_ok(mp_bus_pop(&fixture->bus, &popped), "mp_bus_pop failed");
	zassert_equal(popped.type, peeked.type, "peek and pop type mismatch");
	zassert_equal(popped.origin, peeked.origin, "peek and pop src mismatch");

	zassert_equal(mp_bus_peek(&fixture->bus, &peeked), -ENOMSG, "bus not empty after pop");
}

ZTEST_F(mp_bus_api, test_post_multiple_fifo_order)
{
	struct mp_element *src = &fixture->elem;
	struct mp_message msg1 = {.origin = src, .type = MP_MESSAGE_EOS};
	struct mp_message msg2 = {.type = MP_MESSAGE_ERROR};
	struct mp_message first;
	struct mp_message second;

	mp_bus_post(&fixture->bus, &msg1);
	mp_bus_post(&fixture->bus, &msg2);

	zassert_ok(mp_bus_pop(&fixture->bus, &first));
	zassert_ok(mp_bus_pop(&fixture->bus, &second));

	zassert_equal(first.type, MP_MESSAGE_EOS, "first type != EOS");
	zassert_equal(first.origin, src, "first src mismatch");
	zassert_equal(second.type, MP_MESSAGE_ERROR, "second type != ERROR");
	zassert_is_null(second.origin, "second src != NULL");
}

ZTEST_F(mp_bus_api, test_sanity)
{
	struct mp_message msg = {.type = MP_MESSAGE_EOS};
	struct mp_message out;

	zassert_true(mp_bus_post(NULL, &msg) < 0, "post to NULL bus did not fail");
	zassert_true(mp_bus_post(&fixture->bus, NULL) < 0, "post NULL msg did not fail");
	zassert_true(mp_bus_peek(NULL, &out) < 0, "peek on NULL bus did not fail");
	zassert_true(mp_bus_peek(&fixture->bus, NULL) < 0, "peek with NULL out did not fail");
	zassert_true(mp_bus_pop(NULL, &out) < 0, "pop on NULL bus did not fail");
	zassert_true(mp_bus_pop(&fixture->bus, NULL) < 0, "pop with NULL out did not fail");
}

ZTEST_F(mp_bus_api, test_pop_msg_filters_by_type)
{
	struct mp_element *src = &fixture->elem;
	struct mp_message eos = {.origin = src, .type = MP_MESSAGE_EOS};
	struct mp_message err = {.origin = src, .type = MP_MESSAGE_ERROR};
	struct mp_message found;

	mp_bus_post(&fixture->bus, &eos);
	mp_bus_post(&fixture->bus, &err);

	zassert_ok(mp_bus_pop_msg(&fixture->bus, MP_MESSAGE_ERROR, &found));
	zassert_equal(found.type, MP_MESSAGE_ERROR, "found type != ERROR");
	zassert_equal(found.origin, src, "found src mismatch");
}

ZTEST_F(mp_bus_api, test_flush_clears_all)
{
	struct mp_message msg1 = {.type = MP_MESSAGE_EOS};
	struct mp_message msg2 = {.type = MP_MESSAGE_ERROR};
	struct mp_message out;

	mp_bus_post(&fixture->bus, &msg1);
	mp_bus_post(&fixture->bus, &msg2);

	mp_bus_flush(&fixture->bus);

	zassert_equal(mp_bus_peek(&fixture->bus, &out), -ENOMSG, "bus not empty after flush");
}

ZTEST_F(mp_bus_api, test_sync_handler_pass_enqueues)
{
	struct mp_element *src = &fixture->elem;
	struct mp_message msg = {.origin = src, .type = MP_MESSAGE_EOS};
	struct mp_message out;

	handler_call_count = 0;
	handler_last_type = MP_MESSAGE_UNKNOWN;
	handler_last_src = NULL;

	zassert_ok(mp_bus_set_sync_handler(&fixture->bus, test_pass_handler, NULL),
		   "installing sync handler failed");

	mp_bus_post(&fixture->bus, &msg);

	/* Handler ran once and saw the message. */
	zassert_equal(handler_call_count, 1, "handler call count != 1");
	zassert_equal(handler_last_type, MP_MESSAGE_EOS, "handler type != EOS");
	zassert_equal(handler_last_src, src, "handler src mismatch");

	/* MP_BUS_PASS means the message must be enqueued for the consumer. */
	zassert_ok(mp_bus_peek(&fixture->bus, &out), "PASS did not enqueue the message");
	zassert_equal(out.type, MP_MESSAGE_EOS, "enqueued type != EOS");
}

ZTEST_F(mp_bus_api, test_sync_handler_drop_discards)
{
	struct mp_element *src = &fixture->elem;
	struct mp_message msg = {.origin = src, .type = MP_MESSAGE_EOS};
	struct mp_message out;

	handler_call_count = 0;

	zassert_ok(mp_bus_set_sync_handler(&fixture->bus, test_drop_handler, NULL),
		   "installing sync handler failed");

	zassert_ok(mp_bus_post(&fixture->bus, &msg), "post with dropping handler failed");

	/* Handler ran, but MP_BUS_DROP means nothing is enqueued. */
	zassert_equal(handler_call_count, 1, "handler call count != 1");
	zassert_equal(mp_bus_peek(&fixture->bus, &out), -ENOMSG, "DROP still enqueued the message");
}

ZTEST_F(mp_bus_api, test_sync_handler_clear)
{
	struct mp_element *src = &fixture->elem;
	struct mp_message msg = {.origin = src, .type = MP_MESSAGE_EOS};
	struct mp_message out;

	handler_call_count = 0;

	/* Install then clear: posting must no longer invoke the handler and the
	 * message must be enqueued (default PASS behavior).
	 */
	zassert_ok(mp_bus_set_sync_handler(&fixture->bus, test_drop_handler, NULL));
	zassert_ok(mp_bus_set_sync_handler(&fixture->bus, NULL, NULL), "clearing handler failed");

	mp_bus_post(&fixture->bus, &msg);

	zassert_equal(handler_call_count, 0, "cleared handler was still called");
	zassert_ok(mp_bus_peek(&fixture->bus, &out), "message not enqueued after clearing handler");
}
```

## src/test_element.c
```c
/*
 * Copyright 2026 NXP
 *
 * SPDX-License-Identifier: Apache-2.0
 */

#include <zephyr/kernel.h>
#include <zephyr/ztest.h>
#include <zephyr/ztest_assert.h>

#include <zephyr/mp/mp_bin.h>
#include <zephyr/mp/mp_element.h>
#include <zephyr/mp/mp_pad.h>
#include <zephyr/mp/mp_pipeline.h>
#include <zephyr/mp/mp_sink.h>
#include <zephyr/mp/mp_src.h>

struct mp_element_api_fixture {
	struct mp_pipeline pipeline;
	struct mp_element src;
	struct mp_element sink;
	struct mp_pad src_pad;
	struct mp_pad sink_pad;
};

static void *element_suite_setup(void)
{
	static struct mp_element_api_fixture fixture;

	return &fixture;
}

static void element_before(void *f)
{
	struct mp_element_api_fixture *fix = f;

	memset(fix, 0, sizeof(*fix));
	mp_element_init(&fix->src, 1);
	mp_element_init(&fix->sink, 2);
	mp_pad_init(&fix->src_pad, 0, MP_PAD_SRC, MP_PAD_ALWAYS);
	mp_pad_init(&fix->sink_pad, 1, MP_PAD_SINK, MP_PAD_ALWAYS);

	mp_structure_init_any(&fix->src_pad.caps);
	mp_structure_init_any(&fix->sink_pad.caps);

	zassert_equal(fix->src.object.id, 1, "Element ID shall be set by init");
	zassert_equal(fix->src.current_state, MP_STATE_READY,
		      "Element shall start in READY state after init");
	zassert_equal(fix->src.pending_state, MP_STATE_READY,
		      "pending_state shall be READY after init");
	zassert_true(sys_dlist_is_empty(&fix->src.srcpads),
		     "srcpads list shall be empty after init");
	zassert_true(sys_dlist_is_empty(&fix->sink.sinkpads),
		     "sinkpads list shall be empty after init");
}

ZTEST_SUITE(mp_element_api, NULL, element_suite_setup, element_before, NULL, NULL);

ZTEST_F(mp_element_api, test_link_two_elements)
{

	/* Add both pads and verify they are registered on the element */
	mp_element_add_pad(&fixture->src, &fixture->src_pad);
	zassert_false(sys_dlist_is_empty(&fixture->src.srcpads),
		      "srcpads shall not be empty after adding src pad");
	zassert_equal(fixture->src_pad.object.container, (struct mp_object *)&fixture->src,
		      "Pad container shall reference the owning element");

	mp_element_add_pad(&fixture->sink, &fixture->sink_pad);
	zassert_false(sys_dlist_is_empty(&fixture->sink.sinkpads),
		      "sinkpads shall not be empty after adding sink pad");
	zassert_equal(fixture->sink_pad.object.container, (struct mp_object *)&fixture->sink,
		      "Pad container shall reference the owning element");

	/* src/sink are already initialised by element_before via MP_ELEMENT_INIT */
	zassert_ok(mp_element_link(&fixture->src, &fixture->sink, NULL),
		   "Linking src and sink elements shall succeed");
	zassert_true(fixture->sink_pad.peer == &fixture->src_pad,
		     "sink pad peer must be linked to src pad");
	zassert_true(fixture->src_pad.peer == &fixture->sink_pad,
		     "src pad peer must be linked to sink pad");
}

/*
 * A bus lives on a bin, so a bin answers with its own and anything else with
 * the bin holding it. A nested bin is what makes "nearest" observable: its
 * children get its bus and stop there, rather than reaching the pipeline.
 */
ZTEST_F(mp_element_api, test_get_bus_finds_the_nearest_bin)
{
	struct mp_bin nested;
	struct mp_element child;
	struct mp_element orphan;

	memset(&nested, 0, sizeof(nested));
	memset(&child, 0, sizeof(child));
	memset(&orphan, 0, sizeof(orphan));

	MP_ELEMENT_INIT((struct mp_element *)&fixture->pipeline, mp_pipeline_init, 0);
	MP_ELEMENT_INIT((struct mp_element *)&nested, mp_bin_init, 1);
	mp_element_init(&child, 2);
	mp_element_init(&orphan, 3);

	/* Held by no bin, so there is nothing to hand out */
	zassert_is_null(mp_element_get_bus(&orphan), "An element outside any bin shall have no bus");

	/* A pipeline has no container, and answers with its own bus */
	zassert_equal(mp_element_get_bus((struct mp_element *)&fixture->pipeline),
		      &fixture->pipeline.bin.bus, "A pipeline shall answer with its own bus");

	zassert_ok(mp_bin_add((struct mp_bin *)&fixture->pipeline, (struct mp_element *)&nested,
			      NULL),
		   "mp_bin_add shall succeed");
	zassert_ok(mp_bin_add(&nested, &child, NULL), "mp_bin_add shall succeed");

	/* A bin answers with its own bus whether or not another bin holds it */
	zassert_equal(mp_element_get_bus((struct mp_element *)&nested), &nested.bus,
		      "A nested bin shall answer with its own bus, not its parent's");

	/* The whole point of "nearest": the walk stops at the bin holding it */
	zassert_equal(mp_element_get_bus(&child), &nested.bus,
		      "A child shall get the bus of the bin holding it");
	zassert_not_equal(mp_element_get_bus(&child), &fixture->pipeline.bin.bus,
			  "A child shall not reach past its bin to the pipeline");
}

ZTEST_F(mp_element_api, test_sanity)
{
	/* Unknown direction pad shall not appear in either list */
	struct mp_element elem;
	struct mp_pad pad;

	memset(&elem, 0, sizeof(elem));
	memset(&pad, 0, sizeof(pad));
	mp_element_init(&elem, 1);

	mp_pad_init(&pad, 0, MP_PAD_UNKNOWN, MP_PAD_ALWAYS);
	mp_element_add_pad(&elem, &pad);

	zassert_true(sys_dlist_is_empty(&elem.srcpads),
		     "srcpads shall remain empty for UNKNOWN direction pad");
	zassert_true(sys_dlist_is_empty(&elem.sinkpads),
		     "sinkpads shall remain empty for UNKNOWN direction pad");

	/* Linking elements without pads shall fail */
	struct mp_element src, sink;

	memset(&src, 0, sizeof(src));
	memset(&sink, 0, sizeof(sink));
	mp_element_init(&src, 1);
	mp_element_init(&sink, 2);

	zassert_true(mp_element_link(&src, &sink, NULL) < 0,
		     "Linking elements without pads shall fail");
}
```

## src/test_pad.c
```c
/*
 * Copyright 2026 NXP
 *
 * SPDX-License-Identifier: Apache-2.0
 */

#include <zephyr/kernel.h>
#include <zephyr/ztest.h>

#include <zephyr/mp/mp_dispatch.h>
#include <zephyr/mp/mp_element.h>
#include <zephyr/mp/mp_pad.h>
#include <zephyr/mp/mp_structure.h>
#include <zephyr/mp/mp_value.h>

struct mp_pad_api_fixture {
	struct mp_pad src_pad;
	struct mp_pad sink_pad;
};

static void *pad_suite_setup(void)
{
	static struct mp_pad_api_fixture fixture;

	return &fixture;
}

static void pad_before(void *f)
{
	struct mp_pad_api_fixture *fix = f;

	memset(&fix->src_pad, 0, sizeof(fix->src_pad));
	memset(&fix->sink_pad, 0, sizeof(fix->sink_pad));

	mp_pad_init(&fix->src_pad, 0, MP_PAD_SRC, MP_PAD_ALWAYS);
	mp_pad_init(&fix->sink_pad, 1, MP_PAD_SINK, MP_PAD_ALWAYS);

	zassert_equal(fix->src_pad.object.id, 0, "id != 0 after init");
	zassert_equal(fix->src_pad.direction, MP_PAD_SRC, "direction != SRC");
	zassert_equal(fix->sink_pad.direction, MP_PAD_SINK, "direction != SINK");
	zassert_equal(fix->src_pad.presence, MP_PAD_ALWAYS, "presence != ALWAYS");
	zassert_true(mp_structure_is_any(&fix->src_pad.caps), "caps not ANY after init");
	zassert_is_null(fix->src_pad.peer, "peer != NULL after init");
	zassert_equal(fix->src_pad.mode, MP_PAD_MODE_NONE, "mode != NONE after init");
}

static void pad_after(void *f)
{
	struct mp_pad_api_fixture *fix = f;

	mp_structure_clear(&fix->src_pad.caps);
	mp_structure_clear(&fix->sink_pad.caps);
}

ZTEST_SUITE(mp_pad_api, NULL, pad_suite_setup, pad_before, pad_after, NULL);

ZTEST_F(mp_pad_api, test_link_sets_peers)
{
	zassert_ok(mp_pad_link(&fixture->src_pad, &fixture->sink_pad), "mp_pad_link failed");
	zassert_equal(fixture->src_pad.peer, &fixture->sink_pad, "src_pad peer != sink_pad");
	zassert_equal(fixture->sink_pad.peer, &fixture->src_pad, "sink_pad peer != src_pad");
}

ZTEST_F(mp_pad_api, test_sanity)
{
	zassert_true(mp_pad_link(NULL, &fixture->sink_pad) < 0, "link(NULL, sink) did not fail");
	zassert_true(mp_pad_link(&fixture->src_pad, NULL) < 0, "link(src, NULL) did not fail");
	zassert_true(mp_pad_link(NULL, NULL) < 0, "link(NULL, NULL) did not fail");

	struct mp_dispatch evt;

	mp_dispatch_eos_init(&evt);

	zassert_true(mp_pad_send_event(NULL, &evt) < 0, "send_event(NULL, evt) did not fail");
	zassert_true(mp_pad_send_event(&fixture->src_pad, NULL) < 0,
		     "send_event(pad, NULL) did not fail");

	mp_dispatch_clear(&evt);

	struct mp_dispatch q;

	mp_dispatch_caps_init(&q, NULL);

	zassert_true(mp_pad_query(NULL, &q) < 0, "query(NULL, q) did not fail");
	zassert_true(mp_pad_query(&fixture->src_pad, NULL) < 0, "query(pad, NULL) did not fail");

	fixture->src_pad.queryfn = NULL;
	zassert_true(mp_pad_query(&fixture->src_pad, &q) < 0, "query(no queryfn) did not fail");

	mp_dispatch_clear(&q);
}

/* Reports two capabilities, distinguished by their bit width */
static int fake_enum_caps(struct mp_pad *pad, uint32_t index, const struct mp_structure *filter,
			  struct mp_structure *out)
{
	static const uint32_t widths[] = {16U, 24U};
	struct mp_structure candidate;
	struct mp_value value;
	int ret;

	ARG_UNUSED(pad);

	if (index >= ARRAY_SIZE(widths)) {
		return -ENOENT;
	}

	mp_structure_init(&candidate, MP_MEDIA_AUDIO_PCM);
	value.type = MP_TYPE_UINT;
	value.v_uint = widths[index];
	zassert_ok(mp_structure_append_value(&candidate, MP_CAPS_BITWIDTH, &value),
		   "append failed");

	if (filter == NULL) {
		*out = candidate;
		return 0;
	}

	ret = mp_structure_intersect(&candidate, filter, out);

	return (ret != 0) ? -EAGAIN : 0;
}

ZTEST_F(mp_pad_api, test_enum_caps)
{
	struct mp_structure out;
	struct mp_structure filter;
	struct mp_value bitwidth = {.type = MP_TYPE_UINT};

	/* The default produces the pad's own capability, which is ANY here */
	zassert_ok(mp_pad_enum_caps(&fixture->src_pad, 0, NULL, &out), "default enum failed");
	zassert_true(mp_structure_is_any(&out), "ANY caps did not enumerate an ANY structure");
	zassert_equal(mp_pad_enum_caps(&fixture->src_pad, 1, NULL, &out), -ENOENT,
		      "ANY caps enumerated more than once");

	zassert_equal(mp_pad_enum_caps(NULL, 0, NULL, &out), -EINVAL, "enum(NULL pad) != -EINVAL");

	fixture->src_pad.enum_capsfn = fake_enum_caps;

	zassert_ok(mp_pad_enum_caps(&fixture->src_pad, 1, NULL, &out), "enum 1 failed");
	zassert_equal(mp_value_get_uint(mp_structure_get_value(&out, MP_CAPS_BITWIDTH)), 24U,
		      "wrong capability at index 1");

	/* A filter only the second capability satisfies */
	zassert_ok(mp_structure_init(&filter, MP_MEDIA_AUDIO_PCM), "filter init failed");
	bitwidth.v_uint = 24U;
	zassert_ok(mp_structure_append_value(&filter, MP_CAPS_BITWIDTH, &bitwidth),
		   "filter append failed");

	zassert_equal(mp_pad_enum_caps(&fixture->src_pad, 0, &filter, &out), -EAGAIN,
		      "unmatched index != -EAGAIN");
	zassert_ok(mp_pad_enum_caps(&fixture->src_pad, 1, &filter, &out), "matching 1 failed");

	/* The search skips what does not match and stops at what does */
	zassert_ok(mp_pad_enum_first(&fixture->src_pad, &filter, &out), "enum_first failed");
	zassert_equal(mp_value_get_uint(mp_structure_get_value(&out, MP_CAPS_BITWIDTH)), 24U,
		      "enum_first picked the wrong capability");

	/* No filter means the first capability wins */
	zassert_ok(mp_pad_enum_first(&fixture->src_pad, NULL, &out), "enum_first(NULL) failed");
	zassert_equal(mp_value_get_uint(mp_structure_get_value(&out, MP_CAPS_BITWIDTH)), 16U,
		      "enum_first(NULL) did not pick index 0");

	/* A filter nothing satisfies exhausts the enumeration */
	zassert_ok(mp_structure_init(&filter, MP_MEDIA_AUDIO_PCM), "filter re-init failed");
	bitwidth.v_uint = 32U;
	zassert_ok(mp_structure_append_value(&filter, MP_CAPS_BITWIDTH, &bitwidth),
		   "filter re-append failed");
	zassert_equal(mp_pad_enum_first(&fixture->src_pad, &filter, &out), -ENODATA,
		      "unsatisfiable filter != -ENODATA");

	fixture->src_pad.enum_capsfn = NULL;
	zassert_equal(mp_pad_enum_caps(&fixture->src_pad, 0, NULL, &out), -EINVAL,
		      "enum without a hook != -EINVAL");
}
```

## src/test_structure.c
```c
/*
 * Copyright 2026 NXP
 *
 * SPDX-License-Identifier: Apache-2.0
 */

#include <zephyr/kernel.h>
#include <zephyr/sys/sys_heap.h>
#include <zephyr/ztest.h>

#include <zephyr/mp/mp_caps.h>
#include <zephyr/mp/mp_structure.h>
#include <zephyr/mp/mp_value.h>

#include "mp_test_helpers.h"

extern struct k_heap _system_heap;

struct mp_structure_api_fixture {
	struct sys_memory_stats mem_before;
};

static void *structure_suite_setup(void)
{
	static struct mp_structure_api_fixture fixture;

	return &fixture;
}

static void structure_before(void *f)
{
	struct mp_structure_api_fixture *fix = f;

	sys_heap_runtime_stats_get(&_system_heap.heap, &fix->mem_before);
}

static void structure_after(void *f)
{
	struct mp_structure_api_fixture *fix = f;
	struct sys_memory_stats mem_after;

	sys_heap_runtime_stats_get(&_system_heap.heap, &mem_after);
	zassert_equal(fix->mem_before.allocated_bytes, mem_after.allocated_bytes,
		      "Memory leak detected: before=%zu after=%zu", fix->mem_before.allocated_bytes,
		      mem_after.allocated_bytes);
}

ZTEST_SUITE(mp_structure_api, NULL, structure_suite_setup, structure_before, structure_after, NULL);

/* Field IDs used by intersection tests */
enum test_field {
	TEST_BOOL = 0,
	TEST_INT,
	TEST_UINT,
	TEST_STRING,
	TEST_RANGE_INT,
	TEST_RANGE_UINT,
	TEST_LIST,
};

ZTEST(mp_structure_api, test_new)
{
	struct mp_structure *s =
		mp_structure_new(MP_MEDIA_AUDIO_PCM, MP_CAPS_SAMPLE_RATE, MP_TYPE_INT, 48000,
				 MP_CAPS_BITWIDTH, MP_TYPE_INT, 16, MP_STRUCTURE_END);

	zassert_not_null(s, "mp_structure_new returned NULL");
	zassert_equal(s->media_type_id, MP_MEDIA_AUDIO_PCM, "media_type_id mismatch");

	zassert_ok(mp_structure_remove_field(s, MP_CAPS_SAMPLE_RATE), "remove_field failed");
	zassert_is_null(mp_structure_get_value(s, MP_CAPS_SAMPLE_RATE),
			"removed field still found");
	zassert_not_null(mp_structure_get_value(s, MP_CAPS_BITWIDTH), "non-removed field missing");

	mp_structure_clear(s);
	zassert_is_null(mp_structure_get_value(s, MP_CAPS_BITWIDTH), "field found after clear");
	mp_structure_destroy(s);

	struct mp_structure si;

	zassert_ok(mp_structure_init(&si, MP_MEDIA_AUDIO_PCM));

	struct mp_value *appended = mp_value_new(MP_TYPE_INT, 44100);

	zassert_ok(mp_structure_append(&si, MP_CAPS_SAMPLE_RATE, appended), "append failed");

	struct mp_value *retrieved = mp_structure_get_value(&si, MP_CAPS_SAMPLE_RATE);

	zassert_not_null(retrieved, "appended field not found");
	zassert_equal(mp_value_get_int(retrieved), 44100, "retrieved value != 44100");

	struct mp_value *dup_val = mp_value_new(MP_TYPE_INT, 0);

	/* On -EEXIST the value is consumed by mp_structure_append(), do not destroy it here */
	zassert_equal(mp_structure_append(&si, MP_CAPS_SAMPLE_RATE, dup_val), -EEXIST,
		      "duplicate field != -EEXIST");

	zassert_equal(mp_structure_init(NULL, MP_MEDIA_AUDIO_PCM), -EINVAL,
		      "init(NULL) != -EINVAL");
	zassert_equal(mp_structure_append(NULL, MP_CAPS_SAMPLE_RATE, appended), -EINVAL,
		      "append(NULL struct) != -EINVAL");
	zassert_equal(mp_structure_append(&si, MP_CAPS_BITWIDTH, NULL), -EINVAL,
		      "append(NULL value) != -EINVAL");
	mp_structure_clear(&si);
}

ZTEST(mp_structure_api, test_is_fixed_fixate_duplicate)
{
	struct mp_structure *fixed_s =
		mp_structure_new(MP_MEDIA_AUDIO_PCM, MP_CAPS_SAMPLE_RATE, MP_TYPE_INT, 48000,
				 MP_CAPS_BITWIDTH, MP_TYPE_INT, 16, MP_STRUCTURE_END);

	zassert_true(mp_structure_is_fixed(fixed_s), "structure not fixed");

	struct mp_structure *dup = mp_structure_duplicate(fixed_s);

	zassert_not_null(dup, "duplicate returned NULL");
	zassert_true(dup != fixed_s, "duplicate == original");
	zassert_equal(dup->media_type_id, fixed_s->media_type_id, "media_type_id mismatch");
	zassert_equal(mp_value_get_int(mp_structure_get_value(dup, MP_CAPS_SAMPLE_RATE)), 48000,
		      "duplicated value != 48000");
	mp_structure_destroy(dup);
	mp_structure_destroy(fixed_s);

	struct mp_structure *range_s =
		mp_structure_new(MP_MEDIA_AUDIO_PCM, MP_CAPS_SAMPLE_RATE, MP_TYPE_INT_RANGE, 8000,
				 48000, 8000, MP_STRUCTURE_END);

	zassert_false(mp_structure_is_fixed(range_s), "range structure is fixed");

	struct mp_structure *fixated = mp_structure_fixate(range_s);

	zassert_not_null(fixated, "fixate returned NULL");
	zassert_true(mp_structure_is_fixed(fixated), "fixated structure not fixed");
	mp_structure_destroy(range_s);
	mp_structure_destroy(fixated);
}

/* Intersect two structures where all fields are primitive (fixed) values. */
ZTEST(mp_structure_api, test_intersect_primitive)
{
	struct mp_structure *s1 =
		mp_structure_new(MP_MEDIA_AUDIO_PCM, TEST_BOOL, MP_TYPE_BOOLEAN, true, TEST_INT,
				 MP_TYPE_INT, -123, TEST_UINT, MP_TYPE_UINT, 123, TEST_STRING,
				 MP_TYPE_STRING, "xRGB", MP_STRUCTURE_END);
	struct mp_structure *s2 =
		mp_structure_new(MP_MEDIA_AUDIO_PCM, TEST_BOOL, MP_TYPE_BOOLEAN, true, TEST_INT,
				 MP_TYPE_INT, -123, TEST_UINT, MP_TYPE_UINT, 123, TEST_STRING,
				 MP_TYPE_STRING, "xRGB", MP_STRUCTURE_END);

	zassert_true(mp_structure_can_intersect(s1, s2), "identical structures cannot intersect");

	struct mp_structure *result = mp_structure_intersect(s1, s2);

	zassert_not_null(result, "intersection returned NULL");

	struct mp_value *v = mp_structure_get_value(result, TEST_BOOL);

	validate_boolean_value(v, true);

	v = mp_structure_get_value(result, TEST_INT);
	validate_int_value(v, -123);

	v = mp_structure_get_value(result, TEST_UINT);
	validate_uint_value(v, 123);

	v = mp_structure_get_value(result, TEST_STRING);
	validate_string_value(v, "xRGB");

	mp_structure_destroy(s1);
	mp_structure_destroy(s2);
	mp_structure_destroy(result);
}

/* Intersect a structure with an INT_RANGE field against a structure with a fixed INT value. */
ZTEST(mp_structure_api, test_intersect_int_range)
{
	struct {
		int value;
		int expected;
	} test_cases[] = {
		{INT_MIN, INT_MIN},
		{INT_MAX, INT_MAX},
		{(INT_MIN + INT_MAX) / 2, (INT_MIN + INT_MAX) / 2},
	};

	struct mp_structure *s_range =
		mp_structure_new(MP_MEDIA_AUDIO_PCM, TEST_RANGE_INT, MP_TYPE_INT_RANGE, INT_MIN,
				 INT_MAX, 1, MP_STRUCTURE_END);

	zassert_not_null(s_range, "range structure alloc failed");

	for (int i = 0; i < ARRAY_SIZE(test_cases); i++) {
		struct mp_structure *s_val =
			mp_structure_new(MP_MEDIA_AUDIO_PCM, TEST_RANGE_INT, MP_TYPE_INT,
					 test_cases[i].value, MP_STRUCTURE_END);
		zassert_not_null(s_val, "value structure alloc failed");

		struct mp_structure *result = mp_structure_intersect(s_range, s_val);

		zassert_not_null(result, "intersection returned NULL");

		struct mp_value *v = mp_structure_get_value(result, TEST_RANGE_INT);

		validate_int_value(v, test_cases[i].expected);

		mp_structure_destroy(s_val);
		mp_structure_destroy(result);
	}

	mp_structure_destroy(s_range);
}

/* Intersect a structure with a UINT_RANGE field against a structure with a fixed UINT value. */
ZTEST(mp_structure_api, test_intersect_uint_range)
{
	struct {
		unsigned int expected;
		const char *description;
	} test_cases[] = {
		{0, "Zero value"},
		{UINT32_MAX, "Maximum value"},
		{UINT32_MAX / 2, "Mid-range value"},
	};

	struct mp_structure *s_range =
		mp_structure_new(MP_MEDIA_AUDIO_PCM, TEST_RANGE_UINT, MP_TYPE_UINT_RANGE, 0,
				 UINT32_MAX, 1, MP_STRUCTURE_END);

	zassert_not_null(s_range, "range structure alloc failed");

	for (int i = 0; i < ARRAY_SIZE(test_cases); i++) {
		struct mp_structure *s_val =
			mp_structure_new(MP_MEDIA_AUDIO_PCM, TEST_RANGE_UINT, MP_TYPE_UINT,
					 test_cases[i].expected, MP_STRUCTURE_END);
		zassert_not_null(s_val, "value structure alloc failed for: %s",
				 test_cases[i].description);

		struct mp_structure *result = mp_structure_intersect(s_range, s_val);

		zassert_not_null(result, "intersection returned NULL for: %s",
				 test_cases[i].description);

		struct mp_value *v = mp_structure_get_value(result, TEST_RANGE_UINT);

		validate_uint_value(v, test_cases[i].expected);

		mp_structure_destroy(s_val);
		mp_structure_destroy(result);
	}

	mp_structure_destroy(s_range);
}

/* Intersect structures with LIST fields. */
ZTEST(mp_structure_api, test_intersect_list)
{
	struct mp_structure *s1 = mp_structure_new(
		MP_MEDIA_AUDIO_PCM, TEST_LIST, MP_TYPE_LIST,
		mp_value_new(MP_TYPE_LIST, mp_value_new(MP_TYPE_INT, 15),
			     mp_value_new(MP_TYPE_UINT, 30),
			     mp_value_new(MP_TYPE_INT_RANGE, 1, 100, 1),
			     mp_value_new(MP_TYPE_STRING, "RGB"),
			     mp_value_new(MP_TYPE_LIST, mp_value_new(MP_TYPE_INT, 15), NULL), NULL),
		MP_STRUCTURE_END);
	struct mp_structure *s2 = mp_structure_new(
		MP_MEDIA_AUDIO_PCM, TEST_LIST, MP_TYPE_LIST,
		mp_value_new(MP_TYPE_LIST, mp_value_new(MP_TYPE_STRING, "RGB"),
			     mp_value_new(MP_TYPE_UINT, 30),
			     mp_value_new(MP_TYPE_LIST, mp_value_new(MP_TYPE_INT, 15), NULL),
			     mp_value_new(MP_TYPE_INT_RANGE, 1, 100, 1),
			     mp_value_new(MP_TYPE_INT, 15), NULL),
		MP_STRUCTURE_END);

	struct mp_structure *result = mp_structure_intersect(s1, s2);

	zassert_not_null(result, "list intersection returned NULL");

	struct mp_value *list = mp_structure_get_value(result, TEST_LIST);

	validate_list_value_type_and_size(list, 5);

	struct mp_value *item = mp_value_list_get(list, 0);

	validate_int_value(item, 15);

	item = mp_value_list_get(list, 1);
	validate_uint_value(item, 30);

	item = mp_value_list_get(list, 2);
	validate_int_range_value(item, 1, 100, 1);

	item = mp_value_list_get(list, 3);
	validate_string_value(item, "RGB");

	item = mp_value_list_get(list, 4);
	validate_list_value_type_and_size(item, 1);
	validate_int_value(mp_value_list_get(item, 0), 15);

	mp_structure_destroy(s1);
	mp_structure_destroy(s2);
	mp_structure_destroy(result);
}

ZTEST(mp_structure_api, test_intersect_asymmetric_fields)
{
	struct mp_structure *s1 = mp_structure_new(MP_MEDIA_AUDIO_PCM, TEST_INT, MP_TYPE_INT, -42,
						   TEST_UINT, MP_TYPE_UINT, 100U, MP_STRUCTURE_END);
	struct mp_structure *s2 =
		mp_structure_new(MP_MEDIA_AUDIO_PCM, TEST_UINT, MP_TYPE_UINT, 100U, TEST_STRING,
				 MP_TYPE_STRING, "hello", MP_STRUCTURE_END);

	zassert_true(mp_structure_can_intersect(s1, s2), "asymmetric structures cannot intersect");

	struct mp_structure *result = mp_structure_intersect(s1, s2);

	zassert_not_null(result, "intersection returned NULL");

	zassert_equal(mp_structure_len(result), 3, "result field count != 3");

	struct mp_value *v = mp_structure_get_value(result, TEST_INT);

	validate_int_value(v, -42);

	v = mp_structure_get_value(result, TEST_UINT);
	validate_uint_value(v, 100U);

	v = mp_structure_get_value(result, TEST_STRING);
	validate_string_value(v, "hello");

	mp_structure_destroy(s1);
	mp_structure_destroy(s2);
	mp_structure_destroy(result);
}

ZTEST(mp_structure_api, test_cannot_intersect)
{
	struct mp_structure *s_sample_int = mp_structure_new(
		MP_MEDIA_AUDIO_PCM, MP_CAPS_SAMPLE_RATE, MP_TYPE_INT, 48000, MP_STRUCTURE_END);
	struct mp_structure *s_bw = mp_structure_new(MP_MEDIA_AUDIO_PCM, MP_CAPS_BITWIDTH,
						     MP_TYPE_INT, 16, MP_STRUCTURE_END);
	struct mp_structure *s_low =
		mp_structure_new(MP_MEDIA_AUDIO_PCM, MP_CAPS_SAMPLE_RATE, MP_TYPE_INT_RANGE, 8000,
				 16000, 8000, MP_STRUCTURE_END);

	zassert_false(mp_structure_can_intersect(s_sample_int, NULL),
		      "can_intersect(s, NULL) should return false");
	zassert_false(mp_structure_can_intersect(NULL, NULL),
		      "can_intersect(NULL, NULL) should return false");
	zassert_is_null(mp_structure_intersect(s_sample_int, NULL),
			"intersect(s, NULL) should return NULL");
	zassert_is_null(mp_structure_intersect(NULL, NULL),
			"intersect(NULL, NULL) should return NULL");

	zassert_false(mp_structure_can_intersect(s_sample_int, s_bw),
		      "structures with no common field should not intersect");
	zassert_is_null(mp_structure_intersect(s_sample_int, s_bw),
			"intersect with no common field should return NULL");

	zassert_false(mp_structure_can_intersect(s_low, s_sample_int),
		      "out-of-range value should not intersect");
	zassert_is_null(mp_structure_intersect(s_low, s_sample_int),
			"intersect with incompatible field value should return NULL");

	mp_structure_destroy(s_sample_int);
	mp_structure_destroy(s_bw);
	mp_structure_destroy(s_low);
}

ZTEST(mp_structure_api, test_sanity)
{
	struct mp_structure *s = mp_structure_new(MP_MEDIA_AUDIO_PCM, MP_CAPS_SAMPLE_RATE,
						  MP_TYPE_INT, 48000, MP_STRUCTURE_END);

	zassert_is_null(mp_structure_get_value(s, MP_CAPS_IMAGE_WIDTH),
			"non-existent field != NULL");
	zassert_true(mp_structure_remove_field(s, MP_CAPS_IMAGE_WIDTH) < 0,
		     "remove non-existent field did not fail");

	mp_structure_destroy(s);
}
```

## src/test_thread.c
```c
/*
 * Copyright 2025-2026 NXP
 *
 * SPDX-License-Identifier: Apache-2.0
 */

#include <zephyr/kernel.h>
#include <zephyr/ztest.h>
#include <zephyr/ztest_assert.h>

#include <zephyr/mp/mp_thread.h>

static struct k_sem thread_ran_sem;
static atomic_t thread_run_count;

static void simple_thread_func(void *p1, void *p2, void *p3)
{
	ARG_UNUSED(p2);
	ARG_UNUSED(p3);

	atomic_inc(&thread_run_count);
	k_sem_give((struct k_sem *)p1);
}


struct mp_thread_api_fixture {
	struct mp_thread thread;
};

static void *thread_suite_setup(void)
{
	static struct mp_thread_api_fixture fixture;

	return &fixture;
}

static void thread_before(void *f)
{
	struct mp_thread_api_fixture *fix = f;

	memset(&fix->thread, 0, sizeof(fix->thread));
	fix->thread.stack_id = -1;

	k_sem_init(&thread_ran_sem, 0, 1);
	atomic_set(&thread_run_count, 0);
}

ZTEST_SUITE(mp_thread_api, NULL, thread_suite_setup, thread_before, NULL, NULL);

ZTEST_F(mp_thread_api, test_create)
{
	k_tid_t tid = mp_thread_create(&fixture->thread, simple_thread_func, &thread_ran_sem, NULL,
				       NULL, CONFIG_MP_THREAD_DEFAULT_PRIORITY, K_NO_WAIT);

	zassert_not_null(tid, "mp_thread_create returned NULL");
	zassert_true(fixture->thread.stack_id >= 0 &&
			     fixture->thread.stack_id < CONFIG_MP_THREADS_NUM,
		     "stack_id %d out of range [0, %d)", fixture->thread.stack_id,
		     CONFIG_MP_THREADS_NUM);

	int ret = k_sem_take(&thread_ran_sem, K_MSEC(1000));

	zassert_equal(ret, 0, "entry function not called within 1s");
	zassert_equal(atomic_get(&thread_run_count), 1, "entry function call count != 1");
}
```

## src/test_value.c
```c
/*
 * Copyright 2026 NXP
 *
 * SPDX-License-Identifier: Apache-2.0
 */

#include <zephyr/kernel.h>
#include <zephyr/ztest.h>

#include <zephyr/mp/mp_value.h>

ZTEST_SUITE(mp_value_api, NULL, NULL, NULL, NULL, NULL);

ZTEST(mp_value_api, test_new_values)
{
	struct mp_value bt;

	mp_value_set(&bt, MP_TYPE_BOOLEAN, true);

	zassert_equal(bt.type, MP_TYPE_BOOLEAN, "type != BOOLEAN");
	zassert_true(mp_value_get_boolean(&bt), "value != true");

	struct mp_value bf;

	mp_value_set(&bf, MP_TYPE_BOOLEAN, false);

	zassert_false(mp_value_get_boolean(&bf), "value != false");

	struct mp_value iv;

	mp_value_set(&iv, MP_TYPE_INT, -42);

	zassert_equal(iv.type, MP_TYPE_INT, "type != INT");
	zassert_equal(mp_value_get_int(&iv), -42, "value != -42");

	struct mp_value uv;

	mp_value_set(&uv, MP_TYPE_UINT, 123U);

	zassert_equal(uv.type, MP_TYPE_UINT, "type != UINT");
	zassert_equal(mp_value_get_uint(&uv), 123U, "value != 123");

	struct mp_value rv;

	mp_value_set(&rv, MP_TYPE_INT_RANGE, 8000, 48000, 8000);

	zassert_equal(rv.type, MP_TYPE_INT_RANGE, "type != INT_RANGE");
	zassert_equal(mp_value_get_int_range_min(&rv), 8000, "min != 8000");
	zassert_equal(mp_value_get_int_range_max(&rv), 48000, "max != 48000");
	zassert_equal(mp_value_get_int_range_step(&rv), 8000, "step != 8000");

	struct mp_value ez;

	mp_value_set(&ez, MP_TYPE_INT, 0);

	zassert_equal(mp_value_get_int(&ez), 0, "value != 0");
}

/* Two primitive values intersect when they are the same value, and not otherwise */
ZTEST(mp_value_api, test_primitive_equality)
{
	struct mp_value a;
	struct mp_value b;
	struct mp_value result;

	mp_value_set(&a, MP_TYPE_INT, -42);
	mp_value_set(&b, MP_TYPE_INT, -42);
	zassert_ok(mp_value_intersect(&a, &b, &result), "equal INT values did not intersect");
	zassert_equal(mp_value_get_int(&result), -42, "INT result != -42");

	mp_value_set(&b, MP_TYPE_INT, 42);
	zassert_equal(mp_value_intersect(&a, &b, &result), -ENOENT,
		      "different INT values intersected");

	mp_value_set(&a, MP_TYPE_UINT, 100U);
	mp_value_set(&b, MP_TYPE_UINT, 100U);
	zassert_ok(mp_value_intersect(&a, &b, &result), "equal UINT values did not intersect");
	zassert_equal(mp_value_get_uint(&result), 100U, "UINT result != 100");

	mp_value_set(&b, MP_TYPE_UINT, 200U);
	zassert_equal(mp_value_intersect(&a, &b, &result), -ENOENT,
		      "different UINT values intersected");

	mp_value_set(&a, MP_TYPE_BOOLEAN, true);
	mp_value_set(&b, MP_TYPE_BOOLEAN, true);
	zassert_ok(mp_value_intersect(&a, &b, &result), "equal BOOLEAN values did not intersect");
	zassert_true(mp_value_get_boolean(&result), "BOOLEAN result != true");

	mp_value_set(&b, MP_TYPE_BOOLEAN, false);
	zassert_equal(mp_value_intersect(&a, &b, &result), -ENOENT,
		      "different BOOLEAN values intersected");
}

ZTEST(mp_value_api, test_intersect)
{
	struct mp_value a;

	mp_value_set(&a, MP_TYPE_INT, 48000);
	struct mp_value b;

	mp_value_set(&b, MP_TYPE_INT, 48000);
	struct mp_value result;

	zassert_ok(mp_value_intersect(&a, &b, &result), "intersect(equal values) failed");
	zassert_equal(mp_value_get_int(&result), 48000, "result != 48000");

	struct mp_value range;

	mp_value_set(&range, MP_TYPE_INT_RANGE, 8000, 48000, 8000);
	struct mp_value val;

	mp_value_set(&val, MP_TYPE_INT, 16000);

	zassert_ok(mp_value_intersect(&range, &val, &result), "intersect(value in &range) failed");
	zassert_equal(mp_value_get_int(&result), 16000, "result != 16000");
}

ZTEST(mp_value_api, test_copy_and_is_primitive)
{
	struct mp_value original;

	struct mp_value copy;

	/* A value owns nothing, so copying one is a plain assignment */
	mp_value_set(&original, MP_TYPE_INT, 999);
	copy = original;
	zassert_equal(mp_value_get_int(&copy), 999, "copied value != 999");

	struct mp_value rorig;
	struct mp_value rcopy;

	mp_value_set(&rorig, MP_TYPE_INT_RANGE, 1, 100, 1);
	rcopy = rorig;
	zassert_equal(mp_value_get_int_range_min(&rcopy), 1, "min != 1");
	zassert_equal(mp_value_get_int_range_max(&rcopy), 100, "max != 100");
	zassert_equal(mp_value_get_int_range_step(&rcopy), 1, "step != 1");

	struct mp_value iv;

	mp_value_set(&iv, MP_TYPE_INT, 1);

	zassert_true(mp_value_is_primitive(&iv), "INT not primitive");

	struct mp_value bv;

	mp_value_set(&bv, MP_TYPE_BOOLEAN, true);

	zassert_true(mp_value_is_primitive(&bv), "BOOLEAN not primitive");

	struct mp_value rv;

	mp_value_set(&rv, MP_TYPE_INT_RANGE, 0, 10, 1);

	zassert_false(mp_value_is_primitive(&rv), "INT_RANGE is primitive");

	struct mp_value ci_a;

	mp_value_set(&ci_a, MP_TYPE_INT, 10);
	struct mp_value ci_b;

	mp_value_set(&ci_b, MP_TYPE_INT, 10);

	zassert_true(mp_value_can_intersect(&ci_a, &ci_b), "same-type values cannot intersect");

	struct mp_value ci_range;

	mp_value_set(&ci_range, MP_TYPE_INT_RANGE, 0, 100, 1);
	struct mp_value ci_val;

	mp_value_set(&ci_val, MP_TYPE_INT, 50);

	zassert_true(mp_value_can_intersect(&ci_range, &ci_val),
		     "&range and value cannot intersect");
}

ZTEST(mp_value_api, test_set_updates_value)
{
	struct mp_value val;

	mp_value_set(&val, MP_TYPE_INT, 10);

	mp_value_set(&val, MP_TYPE_INT, 99);
	zassert_equal(mp_value_get_int(&val), 99, "value != 99 after set");
}

ZTEST(mp_value_api, test_sanity)
{
	struct mp_value int_val;

	mp_value_set(&int_val, MP_TYPE_INT, 42);
	struct mp_value uint_val;

	mp_value_set(&uint_val, MP_TYPE_UINT, 42U);

	struct mp_value result;

	/* The same number under two types is not a common value */
	zassert_equal(mp_value_intersect(&int_val, &uint_val, &result), -ENOENT,
		      "values of different types intersect != -ENOENT");

	struct mp_value a;

	mp_value_set(&a, MP_TYPE_INT, 100);
	struct mp_value b;

	mp_value_set(&b, MP_TYPE_INT, 200);

	zassert_equal(mp_value_intersect(&a, &b, &result), -ENOENT,
		      "disjoint values intersect != -ENOENT");
}
```
