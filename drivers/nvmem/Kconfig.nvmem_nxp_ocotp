## dts/bindings/clock/nxp,imxrt-arm-pll.yaml
```yaml
# Copyright 2026 NXP
# SPDX-License-Identifier: Apache-2.0

description: |
  i.MX RT ARM PLL clock provider.

  New devicetree users should configure the ARM PLL using ``loop-div`` and
  ``post-div``. The legacy ``clock-mult`` and ``clock-div`` properties are
  still supported for RT11xx compatibility, but are deprecated.

compatible: "nxp,imxrt-arm-pll"

include: clock-controller.yaml

properties:
  "#clock-cells":
    const: 0

  clock-div:
    type: int
    deprecated: true
    description: |
      Deprecated. Use post-div instead.

  clock-mult:
    type: int
    deprecated: true
    description: |
      Deprecated. Use loop-div instead. The legacy property represented half
      of the hardware loop divider, so loop-div = clock-mult * 2.

  loop-div:
    type: int
    required: true
    enum: [104, 105, 106, 107, 108, 109, 110, 111, 112, 113, 114, 115,
           116, 117, 118, 119, 120, 121, 122, 123, 124, 125, 126, 127,
           128, 129, 130, 131, 132, 133, 134, 135, 136, 137, 138, 139,
           140, 141, 142, 143, 144, 145, 146, 147, 148, 149, 150, 151,
           152, 153, 154, 155, 156, 157, 158, 159, 160, 161, 162, 163,
           164, 165, 166, 167, 168, 169, 170, 171, 172, 173, 174, 175,
           176, 177, 178, 179, 180, 181, 182, 183, 184, 185, 186, 187,
           188, 189, 190, 191, 192, 193, 194, 195, 196, 197, 198, 199,
           200, 201, 202, 203, 204, 205, 206, 207, 208]
    description: ARM PLL loop divider

  post-div:
    type: int
    required: true
    enum: [1, 2, 4, 8]
    description: ARM PLL post divider
```

## dts/bindings/clock/nxp,kinetis-sim.yaml
```yaml
# Copyright (c) 2017, NXP
# SPDX-License-Identifier: Apache-2.0

description: Kinetis System Integration Module (SIM) IP node

compatible: "nxp,kinetis-sim"

include: base.yaml

properties:
  reg:
    required: true

  pllfll-select:
    type: int
    required: true
    description: pll/fll selection for clock system

  er32k-select:
    type: int
    required: true
    description: er32k selection for clock system

  clkout-source:
    type: int
    description: clkout clock source

  clkout-divider:
    type: int
    description: clkout divider

  "#clock-cells":
    type: int
    const: 3

# Notes:
# - Some consumers historically pass only the `name` clock-cell to the
#   clock_control API.
# - Devicetrees encode gate+rate information into the `name` cell using
#   helpers from <zephyr/dt-bindings/clock/kinetis_sim.h> (for example
#   `KINETIS_SIM_SUBSYS_ENCODE`/`KINETIS_SIM_CLOCK_SPEC`), while still
#   providing the required `offset` and `bits` cells.
clock-cells:
  - name
  - offset
  - bits
```

## dts/bindings/counter/nxp,irtc-wake-timer.yaml
```yaml
# Copyright 2026 NXP
# SPDX-License-Identifier: Apache-2.0

description: |
  NXP IRTC wake timer exposed through the counter API.

  The tick rate is selected by the "osc-div" property: 1024 Hz with the
  divide-by-32 prescaler enabled, 32768 Hz without.

compatible: "nxp,irtc-wake-timer"

include: base.yaml

properties:
  osc-div:
    type: boolean
    description: |
      Enable the wake timer's divide-by-32 prescaler (OSC_DIV_ENA), producing a
      1024 Hz tick from the 32.768 kHz oscillator. When omitted the wake timer
      runs directly at 32768 Hz.
```

## dts/bindings/display/nxp,imx-lcdifv3.yaml
```yaml
# Copyright (c) 2022, NXP
# SPDX-License-Identifier: Apache-2.0

description: NXP i.MX LCDIFV3 (LCD Interface v3) controller

compatible: "nxp,imx-lcdifv3"

include: [base.yaml, display-controller.yaml]

properties:
  reg:
    required: true

  interrupts:
    required: true

  hsync:
    type: int
    required: true
    description: HSYNC pulse width in display clock cycles

  hfp:
    type: int
    required: true
    description: Horizontal front porch in display clock cycles

  hbp:
    type: int
    required: true
    description: Horizontal back porch in display clock cycles

  vsync:
    type: int
    required: true
    description: VSYNC pulse width in display clock cycles

  vfp:
    type: int
    required: true
    description: Vertical front porch in display clock cycles

  vbp:
    type: int
    required: true
    description: Vertical back porch in display clock cycles

  polarity:
    type: int
    required: true
    enum:
      - 0
      - 1
      - 2
      - 3
      - 4
      - 5
      - 6
      - 7
      - 8
      - 9
      - 10
      - 11
      - 12
      - 13
      - 14
      - 15
    description:
      OR'ed value of elcdif_polarity_flags, used to control the signal polarity.
      0000 Drive data on falling edge, DE active high, VSYNC active high, HSYNC active high.
      0001 Drive data on falling edge, DE active high, VSYNC active high, HSYNC active low.
      0010 Drive data on falling edge, DE active high, VSYNC active low, HSYNC active high.
      0011 Drive data on falling edge, DE active high, VSYNC active low, HSYNC active low.
      0100 Drive data on falling edge, DE active low, VSYNC active high, HSYNC active high.
      0101 Drive data on falling edge, DE active low, VSYNC active high, HSYNC active low.
      0110 Drive data on falling edge, DE active low, VSYNC active low, HSYNC active high.
      0111 Drive data on falling edge, DE active low, VSYNC active low, HSYNC active low.
      1000 Drive data on rising edge, DE active high, VSYNC active high, HSYNC active high.
      1001 Drive data on rising edge, DE active high, VSYNC active high, HSYNC active low.
      1010 Drive data on rising edge, DE active high, VSYNC active low, HSYNC active high.
      1011 Drive data on rising edge, DE active high, VSYNC active low, HSYNC active low.
      1100 Drive data on rising edge, DE active low, VSYNC active high, HSYNC active high.
      1101 Drive data on rising edge, DE active low, VSYNC active high, HSYNC active low.
      1110 Drive data on rising edge, DE active low, VSYNC active low, HSYNC active high.
      1111 Drive data on rising edge, DE active low, VSYNC active low, HSYNC active low.

  pixel-format:
    type: string
    required: true
    enum:
      - "rgb-565"
      - "rgb-888"
      - "argb-8888"
    description:
      Display pixel format.
```

## dts/bindings/display/nxp,imx-ldb.yaml
```yaml
# Copyright 2026 NXP
# SPDX-License-Identifier: Apache-2.0

description: NXP i.MX LDB (LVDS Display Bridge)

compatible: "nxp,imx-ldb"

include: [base.yaml]

properties:
  reg:
    required: true

  display-index:
    type: int
    required: true
    enum: [0, 1]
    description: |
      Input selection index (typically 0 or 1). This maps to ldb_link_cfg input.

  dual-panel:
    type: boolean
    description: |
      Enable dual-panel / split mode. Driver maps this to LDB_MODE_DUAL_PANEL flag.

  bit-mapping:
    type: string
    required: true
    enum: ["spwg", "jeida"]
    description: |
      LVDS bit mapping selection. Maps to enum ldb_bit_mapping.

  enable-on-boot:
    type: boolean
    description: |
      If present, driver will configure and enable the bridge during init.
```

## dts/bindings/display/nxp,imx93-ldb.yaml
```yaml
# Copyright (c) 2022, NXP
# SPDX-License-Identifier: Apache-2.0

description: NXP i.MX93 LDB and LVDS

compatible: "nxp,imx93-ldb"

include: [base.yaml, pinctrl-device.yaml]

properties:
  bus-format:
    required: true
    type: string
    enum:
      - "RGB666_1X7X3_SPWG"
      - "RGB888_1X7X4_SPWG"
      - "RGB888_1X7X4_JEIDA"
    description:
      Select bus format
```

## dts/bindings/display/nxp,imx93_parallel_disp.yaml
```yaml
# Copyright (c) 2022, NXP
# SPDX-License-Identifier: Apache-2.0

description: NXP i.MX93 Parallel Display

compatible: "nxp,imx93-pdi"

include: [base.yaml, pinctrl-device.yaml]

properties:
  interface-pix-fmt:
    required: true
    type: string
    enum:
      - "rgb565"
      - "rgb666"
      - "rgb888"
    description:
      Select bus format

  enable-gpios:
    required: true
    type: phandle-array
    description:
      Enable control gpio. Driver will initialize this GPIO to active high
```

## dts/bindings/display/nxp,lvds-connector.yaml
```yaml
# SPDX-License-Identifier: Apache-2.0

description: LVDS connector wrapper display device (sequences panel GPIOs and enables LDB)

compatible: "nxp,lvds-connector"

include: [base.yaml]

properties:
  display:
    type: phandle
    required: true
    description: Upstream display device (DPU/LCDIF/etc) implementing Zephyr display API.

  ldb:
    type: phandle
    required: true
    description: LDB bridge device implementing Zephyr LDB API.

  enable-gpios:
    type: phandle-array
    required: false
    description: Panel enable GPIO (set active in blanking_off).

  reset-gpios:
    type: phandle-array
    required: false
    description: Panel reset GPIO (assert/deassert in blanking_off).

  prepare-delay-ms:
    type: int
    default: 0
    description: Delay after enabling panel (before reset sequence).

  reset-assert-us:
    type: int
    default: 0
    description: Reset assert pulse width in microseconds.

  reset-deassert-ms:
    type: int
    default: 0
    description: Delay after reset deassert in milliseconds.

  disable-on-blanking-on:
    type: boolean
    description: If present, disable enable-gpios when blanking_on is called.
```

## dts/bindings/display/nxp,lvds-panel-sequencer.yaml
```yaml
# SPDX-License-Identifier: Apache-2.0

description: LVDS panel sequencer for LDB setups (enable/reset sequencing during boot)

compatible: "nxp,lvds-panel-sequencer"

include: [base.yaml]

properties:
  enable-gpios:
    type: phandle-array
    required: false
    description: Panel enable GPIO.

  reset-gpios:
    type: phandle-array
    required: false
    description: Panel reset GPIO.

  prepare-delay-ms:
    type: int
    default: 0
    description: Delay after enabling panel (before reset sequence).

  reset-assert-us:
    type: int
    default: 0
    description: Reset assert pulse width in microseconds.

  reset-deassert-ms:
    type: int
    default: 0
    description: Delay after reset deassert in milliseconds.

  ldb:
    type: phandle
    required: false
    description: Optional LDB bridge device to enable after GPIO sequencing.
```
