## drivers/nvmem/Kconfig.nvmem_nxp_ocotp
```kconfig
# Copyright 2025 NXP
# SPDX-License-Identifier: Apache-2.0

config NVMEM_NXP_OCOTP
	bool "NXP On-Chip OTP controller driver"
	default y
	depends on DT_HAS_NXP_OCOTP_ENABLED
	help
	  NXP On-Chip OTP controller as a FUSE provider.
```

## drivers/otp/Kconfig.nxp_rt7xx_ocotp
```kconfig
# Copyright (c) 2025 NXP
# SPDX-License-Identifier: Apache-2.0

config OTP_NXP_RT7XX_OCOTP
	bool "NXP RT7xx native OCOTP driver"
	default y
	depends on DT_HAS_NXP_RT7XX_OCOTP_ENABLED
	help
	  Enable the native OTP driver for the NXP RT7xx OCOTP controller.
	  This driver accesses the on-chip OTP shadow registers directly
	  without using the NXP HAL library.
```

## drivers/rtc/Kconfig.nxp_imx_rtc
```kconfig
# Copyright 2024 NXP
# SPDX-License-Identifier: Apache-2.0

config RTC_NXP_IMX_RTC
	bool "NXP Real Time Clock driver"
	default y
	depends on DT_HAS_NXP_IMX_RTC_ENABLED
```

## drivers/sensor/nxp/p3t1755/Kconfig
```kconfig
# P3T1755 digital temperature sensor

# Copyright 2024 NXP
# SPDX-License-Identifier: Apache-2.0

menuconfig P3T1755
	bool "P3T1755 digital temperature sensor driver"
	default y
	depends on DT_HAS_NXP_P3T1755_ENABLED
	select I2C if $(dt_compat_on_bus,$(DT_COMPAT_NXP_P3T1755),i2c)
	select I3C if $(dt_compat_on_bus,$(DT_COMPAT_NXP_P3T1755),i3c)
	help
	  Enable driver for the P3T1755 digital temperature sensor.

if P3T1755

choice P3T1755_TRIGGER_MODE
	prompt "Trigger mode"
	default P3T1755_TRIGGER_GLOBAL_THREAD
	help
	  Specify the type of triggering to be used by the driver.

config P3T1755_TRIGGER_NONE
	bool "No trigger"

config P3T1755_TRIGGER_GLOBAL_THREAD
	bool "Use global thread"
	depends on GPIO
	select P3T1755_TRIGGER

config P3T1755_TRIGGER_OWN_THREAD
	bool "Use own thread"
	depends on GPIO
	select P3T1755_TRIGGER

endchoice # P3T1755_TRIGGER_MODE

config P3T1755_TRIGGER
	bool

endif # P3T1755
```

## drivers/timer/Kconfig.mcux_lptmr
```kconfig
# Copyright (c) 2014-2015 Wind River Systems, Inc.
# Copyright (c) 2016 Cadence Design Systems, Inc.
# Copyright (c) 2019 Intel Corp.
# Copyright (c) 2026 NXP
# SPDX-License-Identifier: Apache-2.0

config MCUX_LPTMR_TIMER
	bool "MCUX LPTMR timer"
	depends on DT_HAS_NXP_LPTMR_TIMER_ENABLED
	select TICKLESS_CAPABLE
	help
	  This module implements a kernel device driver for the NXP MCUX Low
	  Power Timer (LPTMR) and provides the standard "system clock driver"
	  interfaces. The driver binds to devicetree nodes with
	  compatible = "nxp,lptmr-timer" and is independent of the LPTMR
	  counter driver (COUNTER_MCUX_LPTMR). Both drivers can be enabled
	  simultaneously when the SoC provides separate LPTMR instances for
	  each role.
```

## drivers/video/Kconfig.imx_mipi_csi
```kconfig
# Copyright 2026 NXP
# SPDX-License-Identifier: Apache-2.0

config VIDEO_IMX_MIPI_CSI
	bool "NXP i.MX95 MIPI CSI-2 RX (with integrated DPHY control)"
	default y
	depends on DT_HAS_NXP_IMX_MIPI_CSI_ENABLED
	help
	  Enable driver for i.MX95 CSI-2 receiver.
	  The CSI-2 receiver controls the associated DPHY as an implementation detail
	  (DPHY is still represented as a separate devicetree node for clarity).

# Compatibility alias for older symbol names used in downstream branches/PRs
config VIDEO_NXP_IMX95_MIPI_CSI
	def_bool VIDEO_IMX_MIPI_CSI

if VIDEO_IMX_MIPI_CSI

config VIDEO_IMX_MIPI_CSI_INIT_PRIORITY
	int "i.MX MIPI CSI initialization priority"
	default 80
	help
	  Initialization priority for IMX MIPI CSI driver.

endif # VIDEO_IMX_MIPI_CSI
```

## drivers/video/Kconfig.mcux_isi
```kconfig
# NXP ISI driver configuration options

# Copyright (c) 2023, NXP
# SPDX-License-Identifier: Apache-2.0

config VIDEO_MCUX_ISI
    bool "NXP MCUX Image Sensing Interface (ISI) driver"
    default y
    depends on HAS_MCUX_ISI
    depends on DT_HAS_NXP_IMX_ISI_ENABLED
    help
      Enable driver for Image Sensing Interface (ISI).

if VIDEO_MCUX_ISI

config VIDEO_MCUX_ISI_INIT_PRIORITY
    int "ISI initialization priority"
    default 80

config VIDEO_MCUX_ISI_PREVIEW_WORKAROUND
    bool "Enable specia handling for camera_displey_preview demo"
    default n
    depends on HAS_MCUX_ISI
    depends on DT_HAS_NXP_IMX_ISI_ENABLED
    help
      Enable specia handling for camera_displey_preview demo.
      It expands video buffer to 1280x800 to fit the frame
      buffer size of LVDS display on i.MX 93.

config VIDEO_MCUX_ISI_BARCODE_WORKAROUND
    bool "Enable specia handling for barcode_scanner demo"
    default n
    depends on HAS_MCUX_ISI
    depends on DT_HAS_NXP_IMX_ISI_ENABLED
    help
      Enable specia handling for barcode_scanner demo. This
      includes image crop, horizontal flip and alpha
      insertion. It also fixes blank frame issue when using
      parallel csi camera and CSC on i.MX 93.

endif # VIDEO_MCUX_ISI
```

## drivers/video/Kconfig.mcux_parallel_csi
```kconfig
# NXP MCUX Parallel CSI driver configuration options

# Copyright (c) 2023, NXP
# SPDX-License-Identifier: Apache-2.0

config VIDEO_MCUX_PARALLEL_CSI
	bool "NXP MCUX i.MX93 Parallel CSI driver"
	default y
	depends on HAS_MCUX_MEDIAMIX
	depends on DT_HAS_NXP_IMX93_PARALLEL_CSI_ENABLED

if VIDEO_MCUX_PARALLEL_CSI

config VIDEO_PARALLEL_CSI_INIT_PRIORITY
	int "Parallel CSI initialization priority"
	default 80

endif # VIDEO_MCUX_PARALLEL_CSI
```

## drivers/video/Kconfig.mt9m114
```kconfig
# MT9m114

# Copyright (c) 2016 Linaro Limited
# SPDX-License-Identifier: Apache-2.0

config VIDEO_MT9M114
	bool "MT9M114 Aptina CMOS digital image sensor"
	select I2C
	depends on REGULATOR
	depends on DT_HAS_APTINA_MT9M114_ENABLED
	default y
	help
	  Enable driver for MT9M114 CMOS digital image sensor device.

if VIDEO_MT9M114

config VIDEO_MT9M114_INIT_PRIORITY
	int "MT9M114 initialization priority"
	default 70

endif # VIDEO_MT9M114
```

## dts/bindings/audio/nxp,mcux-pdm.yaml
```yaml
# Copyright 2025 NXP
# SPDX-License-Identifier: Apache-2.0

description: |
  NXP MCUX PDM (Pulse Density Modulation) peripheral

  The PDM peripheral allows to capture audio data from PDM digital microphones
  and convert it into PCM audio data. 32-bit PCM sample depth is supported.
  
  The channels are internally grouped into pairs, using a single data line for
  each pair. A DDR clock then differentiates those channels within each pair. 8
  channels in total are supported.

  This driver uses a single DMA channel for transferring audio data into
  locations given by the Zephyr dmic API. Samples in written blocks are
  reordered based on a given channel map.

  As part of the PDM to PCM conversion, this peripheral allows a DC cutoff
  frequency and a gain value to be configured.

  Example devicetree configuration:

  pdm: pdm@400b4000 {
    #address-cells = <1>;
    #size-cells = <0>;
    
    compatible = "nxp,mcux-pdm";
    reg = <0x400b4000 0x1000>;

    interrupts = <202 0>;
    clocks = <&ccm IMX_CCM_PDM_CLK 0x2204 0>;
    dmas = <&edma0 0 68>;

    pinctrl-0 = <&pinmux_pdm>;
    pinctrl-names = "default";
    
    fifo-depth = <8>;

    /* PDM Channel configurations */
    pdmc0: dmic-channel@0 {
      reg = <0>;
      gain = <7>;
      dc-cutoff = <83>;
      status = "okay";
    };

    pdmc0: dmic-channel@1 {
      reg = <1>;
      gain = <7>;
      dc-cutoff = <83>;
      status = "okay";
    };

    /* ... */
  };

compatible: "nxp,mcux-pdm"

include: [base.yaml, pinctrl-device.yaml, reset-device.yaml]

properties:
  reg:
    required: true

  interrupts:
    required: true

  clocks:
    required: true

  dmas:
    required: true

  fifo-depth:
    type: int
    default: 8
    description: PDM FIFO depth in words

child-binding:
  description: PDM channel configuration
  include:
    - name: base.yaml
      property-allowlist:
        - reg
  properties:
    gain:
      type: int
      required: true
      description: Digital filter output gain
      enum:
        - 0
        - 1
        - 2
        - 3
        - 4
        - 5
        - 6
        - 7
        - 8
        - 9
        - 10
        - 11
        - 12
        - 13
        - 14
        - 15

    dc-cutoff:
      type: int
      default: 0
      description: DC remover cutoff frequency in Hz
      enum:
        - 0
        - 21
        - 83
        - 152
```

## dts/bindings/audio/nxp,mcux-spdif.yaml
```yaml
# Copyright (c) 2026 NXP
# SPDX-License-Identifier: Apache-2.0

description: NXP MCUX SPDIF controller

compatible: "nxp,mcux-spdif"

include:
  - base.yaml
  - dma-controller.yaml
  - pinctrl-device.yaml

properties:
  reg:
    required: true

  interrupts:
    required: true

  clocks:
    required: true

  dmas:
    required: true

  dma-names:
    required: true
    type: string-array
    description: DMA channels for the SPDIF transmitter and receiver.
    enum:
      - tx
      - rx

  clock-mux:
    type: int
    description: Root clock source selector used for the SPDIF root clock.

  pre-div:
    type: int
    description: Root clock pre-divider passed to the SoC audio clock helper.

  podf:
    type: int
    description: Root clock post-divider passed to the SoC audio clock helper.

  pll-clocks:
    type: phandle-array
    description: Optional audio PLL settings.
    specifier-space: pll-clock

  pll-clock-names:
    type: string-array
    description: Names for pll-clock specifiers.
```

## dts/bindings/cache_device/zephyr,cache-device.yaml
```yaml
# Copyright 2025 NXP
# SPDX-License-Identifier: Apache-2.0

description: |
  Device-specific cache controller binding.

  This binding defines cache controllers that can be managed as individual
  device instances, providing fine-grained control over cache operations
  for different memory regions or purposes.

compatible: "zephyr,cache-device"

include:
  - base.yaml
  - cacheinfo.yaml

properties:
  reg:
    required: true
    description: |
      Cache controller register base address and size.

  cache-windows:
    type: array
    description: >
      Base/size pairs describing external memory windows covered by this cache.
      The list must contain an even number of 32-bit values.

  dma-coherent:
    type: boolean
    required: false
    description: |
      Hint that memory served by this cache is coherent for DMA/data paths
      and does not require explicit device-cache maintenance. When present,
      the corresponding cache_device driver may choose to return -ENOTSUP
      from its range/all maintenance ops so that only CPU/sys cache is
      maintained while the device cache remains part of the generic model
      for topology and cache_info.
```

## dts/bindings/cacheinfo.yaml
```yaml
# Copyright 2025 NXP
# SPDX-License-Identifier: Apache-2.0

description: |
  Shared cache information properties.

  This schema defines common cache information properties which can be
  included by cache controller bindings. It captures cache attributes
  similar to Linux cacheinfo and is intended for device-specific cache
  controllers and other cache bindings to avoid duplication.

include: base.yaml

properties:
  cache-type:
    type: string
    required: false
    description: |
      Type of cache controller.
    enum:
      - instruction
      - data
      - unified

  cache-level:
    type: int
    required: false
    description: |
      Cache hierarchy level (1 for L1, 2 for L2, ...).

  cache-line-size:
    type: int
    required: false
    description: |
      Cache line size in bytes (coherency line size).

  cache-ways:
    type: int
    required: false
    description: |
      Number of ways in set-associative cache.

  cache-sets:
    type: int
    required: false
    description: |
      Number of sets in the cache.

  cache-size:
    type: int
    required: false
    description: |
      Total cache size in bytes.

  cache-attributes:
    type: string-array
    required: false
    enum:
      - write-through
      - write-back
      - read-allocate
      - write-allocate
    description: |
      Supported capability attributes of the cache controller.
      Maps to CACHE_INFO_ATTR_* flags in the shared cache_info.h.
```

## dts/bindings/clock-mgmt/nxp-syscon/nxp,syscon-rtcclk.yaml
```yaml
# Copyright 2024 NXP
# SPDX-License-Identifier: Apache-2.0

description: |
  LPC SYSCON RTC clock divider node. This node accepts one specifier, which
  sets the integer divider value for the RTC clock. The range of values
  supported is specific to each clock node.

compatible: "nxp,syscon-rtcclk"

include: [clock-node.yaml]

properties:
  reg:
    required: true
    description: |
      Tuple containing address of register, offset, and width of the bitfield
      to set to configure the RTC divider

  add-factor:
    type: int
    required: true
    description: |
      Integer factor to subtract when calculating register value for
      a given divisor request

  "#clock-cells":
    const: 1

clock-cells:
  - divider
```

## dts/bindings/clock-monitor/nxp,freqme.yaml
```yaml
# SPDX-FileCopyrightText: 2026 NXP
# SPDX-License-Identifier: Apache-2.0

description: |
  NXP Frequency Measurement (FREQME) module.

  Measures a target clock against a reference clock and returns the result
  in Hz. The reference and target inputs are routed through the INPUTMUX
  peripheral (see inputmux-connections). Exposed through the Zephyr
  clock_monitor API: MEASURE (one-shot) and WINDOW (continuous MIN/MAX
  threshold) modes are both supported, built on the FREQME frequency
  measurement operate mode.

compatible: "nxp,freqme"

include: [base.yaml]

properties:
  reg:
    required: true

  interrupts:
    required: true
    description: |
      NVIC interrupt for measurement-ready, over-range, and under-range events.

  clocks:
    required: true

  clock-names:
    required: true
    min-len: 2
    max-len: 3
    description: |
      In order:
        - "ipg"        : FREQME peripheral gate clock, enabled by the driver
                         via clock_control_on().
        - "reference"  : the reference timebase clock, queried by the driver
                         to size the measurement window (REF_SCALE) and to
                         convert the raw result into Hz.
        - "monitored"  : optional. The measured clock; only used in WINDOW
                         mode to auto-derive the expected frequency when
                         expected_hz is 0.

  inputmux-connections:
    type: phandle-array
    specifier-space: inputmux
    required: true
    min-len: 2
    max-len: 2
    description: |
      INPUTMUX routing for the reference and target clock inputs. Each
      phandle-array entry is <&inputmuxN channel connection> where:
        - &inputmuxN is the INPUTMUX node providing the route
        - channel is the destination index (0 for FREQME)
        - connection is an inputmux_connection_t cookie from
          fsl_inputmux_connections.h. Use the NXP_FREQME_REF_* /
          NXP_FREQME_TAR_* macros in
          <zephyr/dt-bindings/clock-monitor/nxp-freqme.h>.

      Provide two entries: one reference route (...ToFreqmeasRef) and one
      target route (...ToFreqmeasTar).
```
