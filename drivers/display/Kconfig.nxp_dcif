## drivers/display/Kconfig.nxp_dcif
```kconfig
# SPDX-FileCopyrightText: Copyright 2026 NXP
# SPDX-License-Identifier: Apache-2.0

menuconfig DISPLAY_NXP_DCIF
	bool "NXP DCIF driver"
	default y
	depends on DT_HAS_NXP_DCIF_ENABLED
	select PINCTRL
	help
	  Enable support for NXP DCIF driver.


if DISPLAY_NXP_DCIF

config NXP_DCIF_FB_NUM
	int "Framebuffers to allocate in driver"
	default 1
	range 0 2
	help
	  Number of framebuffers to allocate in DCIF driver. Driver allocated
	  framebuffers are required to support partial display updates.
	  The driver has been validated to support 0 through 2 framebuffers.
	  Note that hardware will likely perform best if zero driver
	  framebuffers are allocated by the driver, and the application
	  implements double framebuffering by always calling display_write with
	  a buffer equal in size to the connected panel.


config NXP_DCIF_MAINTAIN_CACHE
	bool "Maintain cache coherency"
	default y
	help
	  Maintain cache coherency for DCIF framebuffer. This is generally
	  required, unless an external framebuffer is utilized with custom
	  caching settings, or caching is disabled.

config NXP_DCIF_QOS
	bool "Set the DCIF read QoS"
	default y
	depends on SOC_SERIES_IMXRT266X
	help
	  Program the DCIF AXI read QoS in the MEDIA MODCON. The reset value
	  is 0, the lowest priority.

if NXP_DCIF_QOS

config NXP_DCIF_ARQOS
	int "Normal read QoS"
	default 7
	range 0 15

config NXP_DCIF_PANIC_ARQOS
	int "Read QoS while in panic"
	default 15
	range 0 15

endif # NXP_DCIF_QOS

endif # DISPLAY_NXP_DCIF
```

## dts/bindings/mpipe/mpipe-element.yaml
```yaml
# Copyright 2026 NXP
# SPDX-License-Identifier: Apache-2.0

# Properties common to the elements of a pipeline

properties:
  sources:
    type: phandles
    description: |
      Element this one receives its buffers from, a sibling node. A source
      element has none. Several elements naming the same one take its source
      pads in node order.
```

## dts/bindings/mpipe/zephyr,mpipe-app-sink.yaml
```yaml
# Copyright 2026 NXP
# SPDX-License-Identifier: Apache-2.0

description: |
  Pipeline element handing the buffers of the stream to the application.

compatible: "zephyr,mpipe-app-sink"

include: mpipe-element.yaml

properties:
  callback:
    type: string
    description: |
      Name of the function called for every buffer, defined by the
      application as an mpipe_app_sink_cb_t with external linkage. The
      application pulls the buffers when absent.
```

## dts/bindings/mpipe/zephyr,mpipe-app-src.yaml
```yaml
# Copyright 2026 NXP
# SPDX-License-Identifier: Apache-2.0

description: |
  Pipeline element the application pushes buffers into.

compatible: "zephyr,mpipe-app-src"

include: mpipe-element.yaml
```

## dts/bindings/mpipe/zephyr,mpipe-aud-dmic-src.yaml
```yaml
# Copyright 2026 NXP
# SPDX-License-Identifier: Apache-2.0

description: |
  Pipeline element capturing audio blocks from a digital microphone.

compatible: "zephyr,mpipe-aud-dmic-src"

include: mpipe-element.yaml

properties:
  device:
    type: phandle
    description: |
      Digital microphone to capture from. The node labeled "dmic_dev" when
      absent.
```

## dts/bindings/mpipe/zephyr,mpipe-aud-gain.yaml
```yaml
# Copyright 2026 NXP
# SPDX-License-Identifier: Apache-2.0

description: Pipeline element amplifying or attenuating PCM audio.

compatible: "zephyr,mpipe-aud-gain"

include: mpipe-element.yaml

properties:
  gain:
    type: int
    description: Gain in percent, 100 leaving the samples unchanged.
```

## dts/bindings/mpipe/zephyr,mpipe-aud-i2s-codec-sink.yaml
```yaml
# Copyright 2026 NXP
# SPDX-License-Identifier: Apache-2.0

description: |
  Pipeline element playing PCM audio on a codec through an I2S controller.

compatible: "zephyr,mpipe-aud-i2s-codec-sink"

include: mpipe-element.yaml

properties:
  i2s-device:
    type: phandle
    description: |
      I2S controller the blocks are written to. The "i2s-codec-tx" alias when
      absent.

  codec-device:
    type: phandle
    description: |
      Audio codec playing the stream. The node labeled "audio_codec" when
      absent.

  clock-role:
    type: string
    default: "i2s-controller"
    enum:
      - "i2s-controller"
      - "codec-controller"
    description: |
      Which side generates the bit clock and the word select: the I2S
      controller, as most boards are wired, or the codec.
```

## dts/bindings/mpipe/zephyr,mpipe-aud-raw-parser.yaml
```yaml
# Copyright 2026 NXP
# SPDX-License-Identifier: Apache-2.0

description: |
  Pipeline element cutting a raw PCM byte stream into audio blocks of the
  format its properties declare.

compatible: "zephyr,mpipe-aud-raw-parser"

include: mpipe-element.yaml

properties:
  sample-rate:
    type: int
    required: true
    description: Sample rate of the stream in hertz.

  bit-width:
    type: int
    required: true
    enum:
      - 16
      - 24
      - 32
    description: Number of bits per sample.

  num-channels:
    type: int
    required: true
    description: Number of channels.

  frame-interval:
    type: int
    required: true
    description: Duration of an output block in microseconds.
```

## dts/bindings/mpipe/zephyr,mpipe-caps-filter.yaml
```yaml
# Copyright 2026 NXP
# SPDX-License-Identifier: Apache-2.0

description: |
  Pipeline element constraining the format negotiated on its link. A property
  that is absent constrains nothing.

compatible: "zephyr,mpipe-caps-filter"

include: mpipe-element.yaml

properties:
  media:
    type: string
    required: true
    enum:
      - "audio-pcm"
      - "video"
      - "tensor"
      - "nn-results"
    description: Media type of the stream.

  pixel-format:
    type: string
    description: Pixel format, a four-character code such as "RGBP" or "JPEG".

  width:
    type: int
    description: Frame width in pixels.

  height:
    type: int
    description: Frame height in pixels.

  frame-rate:
    type: int
    description: Frame rate in frames per second.

  frame-interval:
    type: int
    description: |
      Duration of a frame or of an audio block in microseconds. Not with
      frame-rate.

  sample-rate:
    type: int
    description: Audio sample rate in hertz.

  bit-width:
    type: int
    description: Number of bits per audio sample.

  num-channels:
    type: int
    description: Number of audio channels.
```

## dts/bindings/mpipe/zephyr,mpipe-disp-sink.yaml
```yaml
# Copyright 2026 NXP
# SPDX-License-Identifier: Apache-2.0

description: Pipeline element showing frames on a display.

compatible: "zephyr,mpipe-disp-sink"

include: mpipe-element.yaml

properties:
  device:
    type: phandle
    description: |
      Display to show the frames on. The chosen "zephyr,display" node when
      absent.

  plane:
    type: int
    description: |
      Display plane to show the frames on. The whole display is written when
      absent.

  x:
    type: int
    default: 0
    description: Horizontal position of the plane on the panel, in pixels.

  y:
    type: int
    default: 0
    description: Vertical position of the plane on the panel, in pixels.

  alpha:
    type: int
    default: 255
    description: |
      Opacity of the plane over the planes below it, 255 for opaque, which
      is the reset state of a plane.

  blend-mode:
    type: string
    default: "none"
    enum:
      - "none"
      - "coverage"
      - "premultiplied"
    description: |
      How the pixel alpha of the plane blends it over the planes below it.
      The pixel alpha is ignored by default, as a plane starts.
```

## dts/bindings/mpipe/zephyr,mpipe-erpc-channel.yaml
```yaml
# Copyright 2026 NXP
# SPDX-License-Identifier: Apache-2.0

description: |
  eRPC channel of a client element of a pipeline: what the element calls its
  server on another core through, over the IPC service.

compatible: "zephyr,mpipe-erpc-channel"

properties:
  endpoint:
    type: string
    required: true
    description: |
      Name of the IPC service endpoint the channel and its server meet on.
      Channels whose servers work at the same time name an endpoint each;
      channels that name the same endpoint share one server, which answers
      them one at a time.

  function:
    type: int
    default: 0
    description: |
      What the client element runs on the server, a number the server defines.
      A pipeline server gives function n to the n-th pipeline of its endpoint.
```

## dts/bindings/mpipe/zephyr,mpipe-file-sink.yaml
```yaml
# Copyright 2026 NXP
# SPDX-License-Identifier: Apache-2.0

description: Pipeline element writing its input stream to a file.

compatible: "zephyr,mpipe-file-sink"

include: mpipe-element.yaml

properties:
  path:
    type: string
    required: true
    description: Absolute path of the file to write.
```

## dts/bindings/mpipe/zephyr,mpipe-file-src.yaml
```yaml
# Copyright 2026 NXP
# SPDX-License-Identifier: Apache-2.0

description: Pipeline element reading a file in blocks.

compatible: "zephyr,mpipe-file-src"

include: mpipe-element.yaml

properties:
  path:
    type: string
    required: true
    description: Absolute path of the file to read.

  block-size:
    type: int
    description: |
      Number of bytes read at a time. The size the configuration sets when
      absent.
```

## dts/bindings/mpipe/zephyr,mpipe-img-jpeg-decoder.yaml
```yaml
# Copyright 2026 NXP
# SPDX-License-Identifier: Apache-2.0

description: Pipeline element decoding JPEG frames in software.

compatible: "zephyr,mpipe-img-jpeg-decoder"

include: mpipe-element.yaml
```

## dts/bindings/mpipe/zephyr,mpipe-img-jpeg-parser.yaml
```yaml
# Copyright 2026 NXP
# SPDX-License-Identifier: Apache-2.0

description: Pipeline element cutting a byte stream into JPEG frames.

compatible: "zephyr,mpipe-img-jpeg-parser"

include: mpipe-element.yaml
```

## dts/bindings/mpipe/zephyr,mpipe-nn-converter.yaml
```yaml
# Copyright 2026 NXP
# SPDX-License-Identifier: Apache-2.0

description: Pipeline element converting video frames to input tensors.

compatible: "zephyr,mpipe-nn-converter"

include: mpipe-element.yaml

properties:
  zero-point:
    type: int
    description: |
      Value added to each 8-bit sample before it is stored, the input zero
      point of the model. The samples are stored as raw bytes when absent.
```

## dts/bindings/mpipe/zephyr,mpipe-nn-decoder.yaml
```yaml
# Copyright 2026 NXP
# SPDX-License-Identifier: Apache-2.0

description: |
  Pipeline element decoding the output tensors of a neural network into
  results.

compatible: "zephyr,mpipe-nn-decoder"

include: mpipe-element.yaml

properties:
  type:
    type: string
    enum:
      - "classification"
      - "detection"
    description: Kind of results to decode. Classification when absent.

  score-threshold:
    type: int
    description: |
      Score in percent below which a result is not reported. 50 when absent.

  nms-iou:
    type: int
    description: |
      Overlap in percent above which the lower scoring of two boxes is
      dropped. 50 when absent.
```

## dts/bindings/mpipe/zephyr,mpipe-nn-runner.yaml
```yaml
# Copyright 2026 NXP
# SPDX-License-Identifier: Apache-2.0

description: Pipeline element running a neural network on its input tensors.

compatible: "zephyr,mpipe-nn-runner"

include: mpipe-element.yaml

properties:
  model:
    type: string
    required: true
    description: |
      Name of the model, a const struct mpipe_nn_model the application
      defines with external linkage.

  arena:
    type: string
    required: true
    description: |
      Name of the working memory of the backend, a const struct
      mpipe_nn_arena the application defines with external linkage.
```

## dts/bindings/mpipe/zephyr,mpipe-pipeline.yaml
```yaml
# Copyright 2026 NXP
# SPDX-License-Identifier: Apache-2.0

description: |
  Multimedia pipeline. Each child node is an element, linked to the element
  its "sources" property names. The pipeline and its elements are built at
  boot.

  Example:

    pipeline {
            compatible = "zephyr,mpipe-pipeline";
            autostart;

            camera_src: vid-src {
                    compatible = "zephyr,mpipe-vid-src";
            };

            disp-sink {
                    compatible = "zephyr,mpipe-disp-sink";
                    sources = <&camera_src>;
            };
    };

compatible: "zephyr,mpipe-pipeline"

properties:
  autostart:
    type: boolean
    description: Start playing the pipeline at boot.

  thread-priority:
    type: int
    description: |
      Priority of the thread the pipeline streams on. The priority the
      configuration sets when absent.
```

## dts/bindings/mpipe/zephyr,mpipe-queue.yaml
```yaml
# Copyright 2026 NXP
# SPDX-License-Identifier: Apache-2.0

description: |
  Pipeline element running the elements downstream of it on a thread of its
  own.

compatible: "zephyr,mpipe-queue"

include: mpipe-element.yaml

properties:
  size:
    type: int
    description: |
      Number of buffers the queue holds. The largest size the configuration
      allows when absent.

  leak:
    type: string
    default: "none"
    enum:
      - "none"
      - "oldest"
      - "newest"
    description: |
      What a full queue does with a new buffer: hold the producer, drop the
      oldest queued buffer or drop the new one. Holding the producer loses
      nothing, hence the default.

  thread-priority:
    type: int
    description: |
      Priority of the thread of the queue. The priority the configuration
      sets when absent.
```

## dts/bindings/mpipe/zephyr,mpipe-socket-sink.yaml
```yaml
# Copyright 2026 NXP
# SPDX-License-Identifier: Apache-2.0

description: |
  Pipeline element writing its stream to a connected socket, which the
  application hands over at run time.

compatible: "zephyr,mpipe-socket-sink"

include: mpipe-element.yaml
```

## dts/bindings/mpipe/zephyr,mpipe-socket-src.yaml
```yaml
# Copyright 2026 NXP
# SPDX-License-Identifier: Apache-2.0

description: |
  Pipeline element reading its stream from a connected socket, which the
  application hands over at run time.

compatible: "zephyr,mpipe-socket-src"

include: mpipe-element.yaml
```

## dts/bindings/mpipe/zephyr,mpipe-tee.yaml
```yaml
# Copyright 2026 NXP
# SPDX-License-Identifier: Apache-2.0

description: Pipeline element copying its input stream to several branches.

compatible: "zephyr,mpipe-tee"

include: mpipe-element.yaml

properties:
  num-src-pads:
    type: int
    description: Number of branches. Two when absent.
```

## dts/bindings/mpipe/zephyr,mpipe-vid-convert.yaml
```yaml
# Copyright 2026 NXP
# SPDX-License-Identifier: Apache-2.0

description: Pipeline element converting the pixel format of frames in software.

compatible: "zephyr,mpipe-vid-convert"

include: mpipe-element.yaml
```

## dts/bindings/mpipe/zephyr,mpipe-vid-h264-decoder.yaml
```yaml
# Copyright 2026 NXP
# SPDX-License-Identifier: Apache-2.0

description: Pipeline element decoding an H.264 byte stream in software.

compatible: "zephyr,mpipe-vid-h264-decoder"

include: mpipe-element.yaml
```
