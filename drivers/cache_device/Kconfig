## drivers/mux/Kconfig
```kconfig
# SPDX-FileCopyrightText: 2026 NXP
# SPDX-License-Identifier: Apache-2.0

# MUX (multiplexer) controller drivers configuration

menuconfig MUX
	bool "Multiplexer (MUX) drivers"
	help
	  Generic multiplexer controller subsystem. Provides a unified API
	  (mux_control_set, mux_state_apply) for signal routers.

if MUX

config MUX_INIT_PRIORITY
	int "MUX driver init priority"
	default 40
	help
	  Initialization priority for MUX controller drivers. MUX controllers
	  are providers that consumers (sensors, PWM, etc.) depend on through
	  devicetree, so this must be earlier (lower) than the init priority of
	  any consumer, e.g. KERNEL_INIT_PRIORITY_DEVICE.

config MUX_MAX_CELLS
	int "Maximum number of addressing cells in a mux specifier"
	default 4
	help
	  Upper bound on the addressing-cells length of a single mux-controls
	  or mux-states specifier. Used by the userspace syscall handlers to
	  allocate a fixed-size kernel-side copy of the cells array, avoiding
	  VLAs and capping the trusted-memory copy from userspace. Increase if
	  any controller binding requires more than this many addressing cells.

config MUX_LOCK_SUPPORTED
	bool "MUX control line locking"
	help
	  Enable the optional mux_control_set_lock() operation. Controllers
	  whose hardware can freeze a route (e.g. the NXP TRGMUX register lock)
	  compile their set_lock op only when this is set; otherwise
	  mux_control_set_lock() returns -ENOSYS. Leave disabled to drop the
	  lock code on builds that never freeze a route.

module = MUX
module-str = mux
source "subsys/logging/Kconfig.template.log_config"

comment "MUX Drivers"

rsource "Kconfig.nxp_inputmux"
rsource "Kconfig.nxp_trgmux"

endif # MUX
```

## drivers/nvmem/Kconfig
```kconfig
# Copyright 2025 NXP
# SPDX-License-Identifier: Apache-2.0

menuconfig NVMEM_DRIVER
	bool "Non-Volatile Memory (NVMEM) Driver Support"
	help
	  Non-Volatile Memory (NVMEM) driver configuration options.

if NVMEM_DRIVER

module = NVMEM_DRIVER
module-str = nvmem_driver
source "subsys/logging/Kconfig.template.log_config"

config NVMEM_DRIVER_INIT_PRIORITY
	int "NVMEM init priority"
	default KERNEL_INIT_PRIORITY_DEVICE
	help
	  NVMEM device driver initialization priority.

rsource "Kconfig.nvmem_nxp_ocotp"
rsource "Kconfig.nvmem_at2x"

endif # NVMEM_DRIVER
```

## drivers/nvmem/Kconfig.nvmem_at2x
```kconfig
# Copyright (c) 2019 Vestas Wind Systems A/S
# SPDX-License-Identifier: Apache-2.0

config NVMEM_AT2X
	bool
	help
	  Enable support for Atmel AT2x (and compatible) I2C/SPI
	  EEPROMs.

config NVMEM_AT24
	bool "I2C EEPROMs compatible with Atmel's AT24 family (NVMEM)"
	default y
	depends on DT_HAS_ATMEL_AT24_ENABLED
	depends on !EEPROM_AT24
	select I2C
	select NVMEM_AT2X
	help
	  Enable support for I2C EEPROMs compatible with Atmel's AT24 family.

	  There are multiple vendors manufacturing I2C EEPROMs compatible with
	  the programming model of the Atmel AT24.

	  Examples of compatible EEPROM families:
	  - Microchip AT24xxx
	  - ST M24xxx

config NVMEM_AT25
	bool "SPI EEPROMs compatible with Atmel's AT25 family (NVMEM)"
	default y
	depends on DT_HAS_ATMEL_AT25_ENABLED
	depends on !EEPROM_AT25
	select SPI
	select NVMEM_AT2X
	help
	  Enable support for SPI EEPROMs compatible with Atmel's AT25 family.

	  There are multiple vendors manufacturing SPI EEPROMs compatible with
	  the programming model of the Atmel AT25.

	  Examples of compatible EEPROM families:
	  - Microchip AT25xxx
	  - ST M95xxx
```

## drivers/nvmem/Kconfig.nvmem_lpc11u6x
```kconfig
# Copyright (c) 2020 Seagate Technology LLC
# Copyright 2025 NXP
# SPDX-License-Identifier: Apache-2.0

config NVMEM_LPC11U6X
	bool "LPC11U6x on-chip EEPROM (NVMEM provider)"
	default y
	depends on DT_HAS_NXP_LPC11U6X_EEPROM_ENABLED
	depends on !EEPROM_LPC11U6X
	help
	  Enable the LPC11U6x on-chip EEPROM as an NVMEM provider device.
```
