## drivers/cache_device/Kconfig
```kconfig
# Copyright (c) 2025 NXP
# SPDX-License-Identifier: Apache-2.0

menuconfig CACHE_DEVICE
	bool "Device-specific cache controller drivers"
	help
	  Enable support for device-specific cache controllers that can be
	  managed as individual device instances. This provides fine-grained
	  control over cache operations for different memory regions or purposes.

if CACHE_DEVICE

config CACHE_DEVICE_HAS_DRIVER
	bool

config CACHE_DEVICE_INIT_PRIORITY
	int "Cache device initialization priority"
	default 60
	help
	  Cache devices initialization priority. This should be high enough to
	  ensure that cache devices are initialized after basic system services
	  but before devices that may depend on cache coherency.

config DEVICE_CACHE_INFO
	bool "Expose device cache information API"
	depends on CACHE_DEVICE
	default y
	help
		Enable cache_device_get_info() to return populated struct cache_info
		data for device-side caches. When disabled, cache_device_get_info()
		will return -ENOTSUP regardless of driver implementation. Keeping
		this enabled by default surfaces useful metadata (line size, size,
		ways) for performance tuning and diagnostics.

module = CACHE_DEVICE
module-str = cache_device
source "subsys/logging/Kconfig.template.log_config"

comment "Device Drivers"

source "drivers/cache_device/Kconfig.nxp_cache64"

endif # CACHE_DEVICE
```

## drivers/cache_device/Kconfig.nxp_cache64
```kconfig
# Copyright 2025 NXP
# SPDX-License-Identifier: Apache-2.0

config CACHE_DEVICE_NXP_CACHE64
	bool "NXP Cache64 device-specific cache driver"
    default y
    depends on DT_HAS_ZEPHYR_CACHE_DEVICE_ENABLED
	help
	  This option enables the Cache64 device driver for NXP SOCs.
	  Cache64 is typically used for caching external flash memory
	  accessed via FlexSPI interface, providing improved performance
	  for external memory access.

	  The driver provides device-specific cache operations including:
	  - Enable/disable cache
	  - Flush and invalidate operations (all and range-based)
	  - Cache information retrieval
	  - FlexSPI memory region cache management
```

## drivers/clock_control/Kconfig.mcux_scg
```kconfig
# MCUXpresso SDK SCG

# Copyright 2024 NXP
# Copyright (c) 2019 Vestas Wind Systems A/S
# SPDX-License-Identifier: Apache-2.0

config CLOCK_CONTROL_MCUX_SCG
	bool "MCUX SCG driver"
	default y
	depends on DT_HAS_NXP_KINETIS_SCG_ENABLED
	help
	  Enable support for mcux scg driver.

config CLOCK_CONTROL_MCUX_SCG_K4
	bool "MCUX driver for K4 Generation SCG"
	default y
	depends on DT_HAS_NXP_SCG_K4_ENABLED
	help
	  Enable support for SCG K4 driver
```

## drivers/clock_mgmt/Kconfig
```kconfig
# Copyright 2024 NXP
# SPDX-License-Identifier: Apache-2.0

#
# Clock controller drivers
#
menuconfig CLOCK_MGMT
	bool "Clock management drivers"
	help
	  Enable support for clock management drivers. These drivers provide
	  clock configuration to the system via a series of setpoints, which
	  allow drivers to configure clocks based on their desired power
	  state

if CLOCK_MGMT

module = CLOCK_MGMT
module-str = clock management
source "subsys/logging/Kconfig.template.log_config"

config CLOCK_MGMT_SET_RATE
	bool "Support runtime rate setting"
	help
	  Allow clock consumers to request a given clock frequency via the
	  clock management framework. The framework will then configure the
	  clock tree so that the consumer is supplied with the closest
	  possible frequency to its request. Note that enabling this feature
	  will result in increased flash utilization

config CLOCK_MGMT_FIXED_SOURCE
	bool "Fixed clock source driver"
	default y
	depends on DT_HAS_FIXED_CLOCK_SOURCE_ENABLED
	help
	  Fixed clock source driver, for non configurable clock sources

source "drivers/clock_mgmt/nxp_syscon/Kconfig"

endif # CLOCK_MGMT
```

## drivers/clock_mgmt/nxp_syscon/Kconfig
```kconfig
# Copyright 2024 NXP
# SPDX-License-Identifier: Apache-2.0

config CLOCK_MGMT_NXP_SYSCON_SOURCE
	bool "NXP syscon clock source driver"
	default y
	depends on DT_HAS_NXP_SYSCON_CLOCK_SOURCE_ENABLED
	help
	  Enable support for NXP SYSCON clock source driver

config CLOCK_MGMT_NXP_SYSCON_GATE
	bool "NXP syscon clock gate driver"
	default y
	depends on DT_HAS_NXP_SYSCON_CLOCK_GATE_ENABLED
	help
	  Enable support for NXP SYSCON clock gate driver

config CLOCK_MGMT_NXP_SYSCON_DIV
	bool "NXP syscon clock divider driver"
	default y
	depends on DT_HAS_NXP_SYSCON_CLOCK_DIV_ENABLED
	help
	  Enable support for NXP SYSCON clock divider driver

config CLOCK_MGMT_NXP_SYSCON_MUX
	bool "NXP syscon clock multiplexer driver"
	default y
	depends on DT_HAS_NXP_SYSCON_CLOCK_MUX_ENABLED
	help
	  Enable support for NXP SYSCON clock multiplexer driver

config CLOCK_MGMT_NXP_SYSCON_FLEXFRG
	bool "NXP syscon Flexcomm fractional rate generator driver"
	default y
	depends on DT_HAS_NXP_SYSCON_CLOCK_FLEXFRG_ENABLED
	help
	  Enable support for NXP SYSCON FLEXFRG driver

config CLOCK_MGMT_NXP_SYSCON_RTCCLK
	bool "NXP syscon rtc clock divider driver"
	default y
	depends on DT_HAS_NXP_SYSCON_CLOCK_RTCCLK_ENABLED
	help
	  Enable support for NXP SYSCON RTCCLK driver

config CLOCK_MGMT_NXP_LPC55SXX_PLL
	bool "NXP LPC55Sxxx PLL drivers"
	default y
	depends on DT_HAS_NXP_LPC55SXX_PLL0_ENABLED || \
		DT_HAS_NXP_LPC55SXX_PLL1_ENABLED || \
		DT_HAS_NXP_LPC55SXX_PLL_PDEC_ENABLED
	help
	  Enable support for NXP LPC55Sxxx PLL drivers
```

## drivers/counter/Kconfig.mcux_lptmr_instance
```kconfig
# MCUXpresso SDK Low Power Timer (LPTMR)

# Copyright (c) 2020 Vestas Wind Systems A/S
# SPDX-License-Identifier: Apache-2.0

config COUNTER_MCUX_LPTMR
	bool "MCUX LPTMR driver"
	default y
	depends on DT_HAS_NXP_LPTMR_ENABLED
	select ZERO_LATENCY_IRQS if ($(dt_nodelabel_bool_prop,lptmr$(mcux_hw_lptmr_index),wakeup-source))
	help
	  Enable support for the MCUX Low Power Timer (LPTMR).
```

## drivers/display/Kconfig.mcux_imx93_ldb
```kconfig
# NXP MEDIAMIX LDB driver configuration options

# Copyright (c) 2023, NXP
# SPDX-License-Identifier: Apache-2.0

config MCUX_IMX93_LDB
	bool "NXP MCUX parallel display bus format driver"
	default y
	depends on HAS_MCUX_MEDIAMIX
	depends on DT_HAS_NXP_IMX93_LDB_ENABLED
	depends on CLOCK_CONTROL
	help
	  Enable driver for imx93 lvds bridge.
```

## drivers/display/Kconfig.mcux_imx93_parallel_disp
```kconfig
# NXP MEDIAMIX Parallel Display Format driver configuration options

# Copyright (c) 2023, NXP
# SPDX-License-Identifier: Apache-2.0

config MCUX_PARALLEL_DISP_FMT
	bool "NXP MCUX parallel display bus format driver"
	default y
	depends on HAS_MCUX_MEDIAMIX
	depends on DT_HAS_NXP_IMX93_PDI_ENABLED
	help
	  Enable driver for imx93 parallel display bus format.
```

## drivers/display/Kconfig.mcux_lvds_panel
```kconfig
# NXP MEDIAMIX LDB driver configuration options

# Copyright (c) 2023, NXP
# SPDX-License-Identifier: Apache-2.0

config MCUX_LVDS_PANEL
	bool "NXP MCUX LVDS Panel driver"
	default y
	depends on HAS_MCUX_MEDIAMIX
	depends on DT_HAS_NXP_IMX93_LDB_ENABLED
	depends on DT_HAS_NXP_LVDS_PANEL_ENABLED
	help
	  Enable driver for imx93 lvds panel.
```

## drivers/display/Kconfig.nxp_ldb
```kconfig
# SPDX-License-Identifier: Apache-2.0

config DISPLAY_LDB
	bool "LDB (LVDS Display Bridge) driver"
	default y
	depends on DT_HAS_NXP_IMX_LDB_ENABLED
	help
	  Enable LDB bridge driver.

config DISPLAY_LDB_INIT_PRIORITY
	int "LDB init priority"
	default 70
```

## drivers/display/Kconfig.nxp_lvds_panel_sequencer
```kconfig
# SPDX-License-Identifier: Apache-2.0

config NXP_LVDS_PANEL_SEQUENCER
	bool "NXP LVDS panel sequencer (enable/reset at boot)"
	default y
	depends on GPIO
	depends on DT_HAS_NXP_LVDS_PANEL_SEQUENCER_ENABLED
	help
	  LVDS panel helper for LDB setups.
	  Performs enable/reset GPIO sequencing during boot.
	  Optionally enables an LDB bridge device.
```

## drivers/dma/Kconfig.nxp_gdma
```kconfig
# Copyright (c) 2026 NXP
# SPDX-License-Identifier: Apache-2.0

config DMA_NXP_GDMA
	bool "NXP GDMA driver"
	default y
	depends on DT_HAS_NXP_GDMA_ENABLED
	help
	  DMA driver for NXP GDMA (General DMA) controller.
	  This driver supports memory-to-memory, memory-to-peripheral,
	  and peripheral-to-memory transfers.

if DMA_NXP_GDMA

config DMA_NXP_GDMA_NUMBER_OF_DESCRIPTORS
	int "Number of DMA descriptors to use per channel"
	default 4
	help
	  Each DMA descriptor can be used to transfer up to 8191 bytes of data.
	  Increase this value if the application needs to transfer larger amounts
	  of data using linked list mode.

endif # DMA_NXP_GDMA
```

## drivers/edac/Kconfig.nxp
```kconfig
config EDAC_NXP_ERM
	bool "NXP ERM driver"
	default y
	depends on DT_HAS_NXP_ERM_ENABLED
	help
	  Enable the NXP Error Reporting Module driver.

config EDAC_NXP_EIM
	bool "NXP EIM driver"
	default y
	depends on DT_HAS_NXP_EIM_ENABLED
	select EDAC_ERROR_INJECT
	help
	  Enable the NXP Error Injection Module driver.
```

## drivers/ethernet/Kconfig.dwmac
```kconfig
# Synopsys DesignWare MAC configuration options

# Copyright (c) 2021 BayLibre SAS
# SPDX-License-Identifier: Apache-2.0

menuconfig ETH_DWMAC
	bool "Synopsys DesignWare MAC driver"
	default y
	depends on NET_BUF_FIXED_DATA_SIZE
	depends on (SOC_SERIES_STM32H7X && !ETH_STM32_HAL) || MMU || SOC_FAMILY_NXP_S32
	depends on DT_HAS_SNPS_DESIGNWARE_ETHERNET_ENABLED
	help
	  This is a driver for the Synopsys DesignWare MAC, also referred to
	  as "DesignWare Cores Ethernet Quality-of-Service". Hardware versions
	  4.x and 5.x are supported.

	  Platform specific glue support is also required. This driver is
	  currently available on targets using the STM32H7X series as an
	  alternative to the eth_stm32_hal driver. Support for a generic DT
	  and MMU based platform is also provided.

	  Not yet implemented:
	  - MDIO (currently relying on default PHY config)
	  - PTP support
	  - VLAN support
	  - various hardware offloads (when available)

if ETH_DWMAC

config ETH_DWMAC_STM32H7X
	bool
	depends on SOC_SERIES_STM32H7X
	select NOCACHE_MEMORY if ARCH_HAS_NOCACHE_MEMORY_SUPPORT
	default y

config ETH_DWMAC_MMU
	bool
	depends on MMU
	default y

config ETH_DWMAC_NXP_S32
	bool
	depends on SOC_FAMILY_NXP_S32
	select NOCACHE_MEMORY if ARCH_HAS_NOCACHE_MEMORY_SUPPORT
	default y

config DWMAC_NB_TX_DESCS
	int "Number of entries in the transmit descriptor ring"
	default 16
	range 4 128
	help
	  A higher number allows for more packets to be queued which may
	  improve throughput, but that requires more transient memory.
	  However there must be enough descriptors to hold all fragments
	  of a full-size packet to be transmitted or the packet will be
	  dropped.

	  Fragment size is influenced by CONFIG_NET_BUF_DATA_SIZE.

config DWMAC_NB_RX_DESCS
	int "Number of entries in the receive descriptor ring"
	default 16
	range 4 128
	help
	  Received packets are spread across the required number of fragment
	  buffers. Each RX fragment has a size of CONFIG_NET_BUF_DATA_SIZE.
	  There is one descriptor entry per fragment.

	  A higher number allows for more packets to be received without
	  immediate intervention from the CPU but requires more transient
	  memory. A smaller number increases the risk of an overflow and
	  dropped packets.

config DWMAC_FILTER_MULTICAST
	bool "Multicast hash filter support"
	imply CRC
	default y # TODO: remove this line
	help
	  Enable support for multicast hash filtering in the MAC.
	  Once enabled the ethernet MAC performs imperfect filtering
	  based on a computed hash of the destination MAC address of
	  the multicast address. Only multicast with the computed
	  hash set in the multicast table will be received and all
	  other multicast is dropped by the MAC. If disabled then all
	  multicast is received by the MAC.

config DWMAC_FILTER_BLOCK_BROADCAST
	bool "Block all incoming broadcast packets"
	help
	  Block all incoming broadcast packets.

config DWMAC_FILTER_RECEIVE_ALL
	bool "Receive all packets"
	help
	  The MAC receiver module forward all received packets to the
	  application, irrespective of whether they pass the address filter or
	  not. If disabled, the receiver module forward only those packets to
	  the application that pass the source or destination address filter.

endif # ETH_DWMAC
```

## drivers/gpio/Kconfig.adp5585_gpio
```kconfig
# PCAL6408a GPIO configuration options

# Copyright (c) 2023, NXP
# SPDX-License-Identifier: Apache-2.0

menuconfig GPIO_ADP5585_GPIO
	bool "ADP5585_GPIO I2C GPIO chip"
	default y
	depends on DT_HAS_ADI_ADP5585_GPIO_ENABLED
	select I2C
	help
	  Enable driver for ADP5585 I2C chip as GPIO expander.

config GPIO_ADP5585_GPIO_INIT_PRIORITY
	int "Init priority"
	default 70
	depends on GPIO_ADP5585_GPIO
	help
	  Device driver initialization priority.
```

## drivers/gpio/Kconfig.mcux_rgpio
```kconfig
# MCUX RGPIO configuration options

# Copyright (c) 2023, NXP
# SPDX-License-Identifier: Apache-2.0

config GPIO_MCUX_RGPIO
	bool "MCUX RGPIO driver"
	default y
	depends on HAS_MCUX_RGPIO
	depends on DT_HAS_NXP_IMX_GPIO_ENABLED
	help
	  Enable the MCUX RGPIO driver.
```

## drivers/input/Kconfig.tma525b
```kconfig
# Copyright 2025 NXP
# SPDX-License-Identifier: Apache-2.0

menuconfig INPUT_TMA525B
	bool "TMA525B capacitive touch panel driver"
	default y
	depends on DT_HAS_INFINEON_TMA525B_ENABLED
	select I2C
	select INPUT_TOUCH
	help
	  Enable driver for multiple Focaltech capacitive touch panel

if INPUT_TMA525B

config INPUT_TMA525B_PERIOD
	int "Sample period"
	depends on !INPUT_TMA525B_INTERRUPT
	default 10
	help
	  Sample period in milliseconds when in polling mode.

config INPUT_TMA525B_INTERRUPT
	bool "Interrupt"
	default y if $(dt_compat_any_has_prop,$(DT_COMPAT_INFINEON_TMA525B),int-gpios)
	help
	  Enable interrupt support (requires GPIO).

endif # INPUT_TMA525B
```

## drivers/mdio/Kconfig.dwmac
```kconfig
# Synopsys DesignWare MDIO configuration options

# Copyright 2024 NXP
# SPDX-License-Identifier: Apache-2.0

menuconfig MDIO_DWMAC
	bool "Synopsys DesignWare MDIO driver"
	default y
	depends on DT_HAS_SNPS_DESIGNWARE_ETHERNET_MDIO_ENABLED
	select CLOCK_CONTROL
	help
	  This is a MDIO driver for the Synopsys DesignWare MAC, also referred
	  to as "DesignWare Cores Ethernet Quality-of-Service". Hardware
	  versions 4.x and 5.x are supported.

if MDIO_DWMAC

config MDIO_DWMAC_TIMEOUT
	int "Timeout for read/write operations in milliseconds"
	default 100
	help
	  Timeout (in milliseconds) for read/write operations over MDIO.

endif # MDIO_DWMAC
```

## drivers/misc/Kconfig.mcux_mediamix
```kconfig
# NXP MEDIAMIX Block Control driver configuration options

# Copyright (c) 2023, NXP
# SPDX-License-Identifier: Apache-2.0

config MCUX_MEDIAMIX_BLK_CTRL
	bool "NXP MCUX MEDIAMIX Block Control driver"
	default y
	depends on HAS_MCUX_MEDIAMIX
	depends on DT_HAS_NXP_IMX93_MEDIAMIX_ENABLED
	help
	  Enable driver for MEDIAMIX Block Control.

if MCUX_MEDIAMIX_BLK_CTRL

config MEDIAMIX_BLK_CTRL_INIT_PRIORITY
	int "MEDIAMIX initialization priority"
	default 50

endif # MCUX_MEDIAMIX_BLK_CTRL
```

## drivers/misc/nxp_evtg/Kconfig
```kconfig
# SPDX-FileCopyrightText: Copyright 2026 NXP
# SPDX-License-Identifier: Apache-2.0

config NXP_EVTG
	bool "NXP EVTG (Event Generator) driver"
	default y
	depends on DT_HAS_NXP_EVTG_ENABLED
	help
	  Enable the NXP HAL driver for the EVTG (Event Generator) peripheral
	  found on select NXP microcontrollers. The EVTG is configured through
	  the fsl_evtg HAL API; this option pulls the HAL driver into the build
	  when an evtg node is enabled in devicetree.
```

## drivers/mspi/Kconfig.nxp
```kconfig
# Copyright 2026 NXP
# SPDX-License-Identifier: Apache-2.0

config MSPI_MCUX_QSPI
	bool "NXP MCX QSPI controller driver"
	default y
	depends on DT_HAS_NXP_MCUX_QSPI_ENABLED
	select PINCTRL
	help
	  Enable MSPI driver for NXP MCUX QSPI controllers.
```
